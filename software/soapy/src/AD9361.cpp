#include "AD9361.hpp"

#define SYNTH_LUT_SIZE    53
static const AD9361::SynthLUT SynthLUT_FDD[3][SYNTH_LUT_SIZE] =
{
    {
        {12605, 13, 1, 4, 2, 15, 12, 7, 14, 6, 14, 5, 15},  // 40 MHz
        {12245, 13, 1, 4, 2, 15, 12, 7, 14, 6, 14, 5, 15},
        {11906, 13, 1, 4, 2, 15, 12, 7, 15, 6, 14, 5, 15},
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        {5997, 6, 2, 7, 3, 15, 13, 16, 15, 6, 14, 5, 15},
    }, {
        {12605, 13, 1, 4, 2, 15, 12, 13, 15, 12, 12, 5, 14},  // 60 MHz
        {12245, 13, 1, 4, 2, 15, 12, 13, 15, 12, 12, 5, 14},
        {11906, 13, 1, 4, 2, 15, 12, 13, 15, 13, 12, 5, 13},
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        {5997, 6, 2, 7, 3, 15, 13, 29, 15, 13, 12, 5, 13},
    }, {
        {12605, 13, 1, 4, 2, 15, 12, 7, 15, 6, 13, 5, 14},  // 80 MHz
        {12245, 13, 1, 4, 2, 15, 12, 7, 15, 6, 13, 5, 14},
        {11906, 13, 1, 4, 2, 15, 12, 7, 15, 6, 13, 5, 14},
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        {5997, 6, 2, 7, 3, 15, 13, 16, 15, 6, 13, 5, 14},
    }
};
static const AD9361::SynthLUT SynthLUT_TDD[3][SYNTH_LUT_SIZE] =
{
    {
        {12605, 13, 1, 4, 2, 15, 12, 27, 12, 15, 12, 4, 13},  // 40 MHz
        {12245, 13, 1, 4, 2, 15, 12, 27, 12, 15, 12, 4, 13},
        {11906, 13, 1, 4, 2, 15, 12, 26, 11, 15, 12, 4, 13},
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        {5997, 6, 2, 7, 3, 15, 13, 58, 12, 15, 12, 4, 13},
    }, {
        {12605, 13, 1, 4, 2, 15, 12, 26, 11, 15, 11, 4, 13},  // 60 MHz
        {12245, 13, 1, 4, 2, 15, 12, 26, 11, 15, 11, 4, 13},
        {11906, 13, 1, 4, 2, 15, 12, 26, 12, 15, 11, 4, 12},
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        {5997, 6, 2, 7, 3, 15, 13, 57, 12, 15, 10, 4, 12},
    }, {
        {12605, 13, 1, 4, 2, 15, 12, 21, 12, 15, 11, 4, 13},  // 80 MHz
        {12245, 13, 1, 4, 2, 15, 12, 21, 12, 15, 11, 4, 13},
        {11906, 13, 1, 4, 2, 15, 12, 20, 11, 15, 11, 4, 13},
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        {5997, 6, 2, 7, 3, 15, 13, 45, 12, 15, 11, 4, 12},
    }
};

// Rx Gain Tables
#define SIZE_FULL_TABLE        77
static const uint8_t full_gain_table[AD9361::RXGainTableName::MAX][SIZE_FULL_TABLE][3] =
{
    {  // 800 MHz
        {0x00, 0x00, 0x20}, {0x00, 0x00, 0x00}, {0x00, 0x00, 0x00},
        {0x00, 0x01, 0x00}, {0x00, 0x02, 0x00}, {0x00, 0x03, 0x00},
        {0x00, 0x04, 0x00}, {0x00, 0x05, 0x00}, {0x01, 0x03, 0x20},
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        {0x6E, 0x38, 0x20}, {0x6F, 0x38, 0x20}
    },{  // 2300 MHz
        {0x00, 0x00, 0x20}, {0x00, 0x00, 0x00}, {0x00, 0x00, 0x00},
        {0x00, 0x01, 0x00}, {0x00, 0x02, 0x00}, {0x00, 0x03, 0x00},
        {0x00, 0x04, 0x00}, {0x00, 0x05, 0x00}, {0x01, 0x03, 0x20},
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        {0x6E, 0x38, 0x20}, {0x6F, 0x38, 0x20},
    },{  // 5500 MHz
        {0x00, 0x00, 0x20}, {0x00, 0x00, 0x00}, {0x00, 0x00, 0x00},
        {0x00, 0x00, 0x00}, {0x00, 0x00, 0x00}, {0x00, 0x01, 0x00},
        {0x00, 0x02, 0x00}, {0x00, 0x03, 0x00}, {0x01, 0x01, 0x20},
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        {0x6E, 0x38, 0x20}, {0x6F, 0x38, 0x20}
    }
};
static const int8_t full_gain_table_abs_gain[AD9361::RXGainTableName::MAX][SIZE_FULL_TABLE] =
{
    {  // 800 MHz
        -1, -1, -1, 0, 1, 2, 3, 4,
            5, 6, 7, 8, 9, 10, 11, 12,
            13, 14, 15, 16, 17, 18, 19, 20,
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            69, 70, 71, 72, 73
        }, {  // 2300 MHz
        -3, -3, -3, -2, -1, 0, 1, 2,
            3, 4, 5, 6, 7, 8, 9, 10,
            11, 12, 13, 14, 15, 16, 17, 18,
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            67, 68, 69, 70, 71
        }, {  // 5500 MHz
        -10, -10, -10, -10, -10, -9, -8, -7,
            -6, -5, -4, -3, -2, -1, 0, 1,
            2, 3, 4, 5, 6, 7, 8, 9,
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            58, 59, 60, 61, 62
        }
};
#define SIZE_SPLIT_TABLE        41
static const uint8_t split_gain_table[AD9361::RXGainTableName::MAX][SIZE_SPLIT_TABLE][3] =
{
    {  // 800 MHz
        {0x00, 0x18, 0x20}, {0x00, 0x18, 0x00}, {0x00, 0x18, 0x00},
        {0x00, 0x18, 0x00}, {0x00, 0x18, 0x00}, {0x00, 0x18, 0x00},
        {0x00, 0x18, 0x20}, {0x01, 0x18, 0x20}, {0x02, 0x18, 0x20},
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        {0x6E, 0x38, 0x20}, {0x6F, 0x38, 0x20},
    },{  // 2300 MHz
        {0x00, 0x18, 0x20}, {0x00, 0x18, 0x00}, {0x00, 0x18, 0x00},
        {0x00, 0x18, 0x00}, {0x00, 0x18, 0x00}, {0x00, 0x18, 0x00},
        {0x00, 0x18, 0x00}, {0x00, 0x18, 0x20}, {0x01, 0x18, 0x20},
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        {0x6E, 0x38, 0x20}, {0x6F, 0x38, 0x20},
    },{  // 5500 MHz
        {0x00, 0x18, 0x20}, {0x00, 0x18, 0x00}, {0x00, 0x18, 0x00},
        {0x00, 0x18, 0x00}, {0x00, 0x18, 0x00}, {0x00, 0x18, 0x00},
        {0x00, 0x18, 0x00}, {0x00, 0x18, 0x00}, {0x00, 0x18, 0x00},
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        {0x6E, 0x38, 0x20}, {0x6F, 0x38, 0x20},
    }
};
static const int8_t split_gain_table_abs_gain[AD9361::RXGainTableName::MAX][SIZE_SPLIT_TABLE] =
{
    {  // 800 MHz
        -1, -1, -1, -1, -1, -1, -1, 2,
            8, 13, 19, 20, 21, 22, 23, 24,
            25, 26, 27, 28, 29, 30, 31, 32,
            33, 34, 35, 36, 37, 38, 39, 40,
            41, 42, 43, 44, 45, 46, 47, 48,
            49
        }, {  // 2300 MHz
        -3, -3, -3, -3, -3, -3, -3, -3,
            0, 6, 12, 18, 19, 20, 21, 22,
            23, 24, 25, 26, 27, 28, 29, 30,
            31, 32, 33, 34, 35, 36, 37, 38,
            39, 40, 41, 42, 43, 44, 45, 46,
            47
        }, {  // 5500 MHz
        -10, -10, -10, -10, -10, -10, -10, -10,
            -10, -10, -7, -2, 3, 9, 10, 11,
            12, 13, 14, 15, 16, 17, 18, 19,
            20, 22, 24, 25, 26, 27, 28, 29,
            30, 31, 32, 33, 34, 35, 36, 37,
            38
        }
};

AD9361::RXGainTableInfo adi_gt_info[] =
{
    {
        .start = 0,
        .end = 1300000000ULL,
        .max_index = SIZE_FULL_TABLE,
        .split_table = false,
        .abs_gain_tbl = (int8_t*)&full_gain_table_abs_gain[AD9361::RXGainTableName::TBL_200_1300_MHZ],
        .tab = (uint8_t(*)[3]) full_gain_table[AD9361::RXGainTableName::TBL_200_1300_MHZ],
    },
    {
        .start = 1300000000ULL,
        .end = 4000000000ULL,
        .max_index = SIZE_FULL_TABLE,
        .split_table = false,
        .abs_gain_tbl = (int8_t*)&full_gain_table_abs_gain[AD9361::RXGainTableName::TBL_1300_4000_MHZ],
        .tab = (uint8_t(*)[3]) full_gain_table[AD9361::RXGainTableName::TBL_1300_4000_MHZ],
    },
    {
        .start = 4000000000ULL,
        .end = 6000000000ULL,
        .max_index = SIZE_FULL_TABLE,
        .split_table = false,
        .abs_gain_tbl = (int8_t*)&full_gain_table_abs_gain[AD9361::RXGainTableName::TBL_4000_6000_MHZ],
        .tab = (uint8_t(*)[3]) full_gain_table[AD9361::RXGainTableName::TBL_4000_6000_MHZ],
    },
    {
        .start = 0,
        .end = 1300000000ULL,
        .max_index = SIZE_SPLIT_TABLE,
        .split_table = true,
        .abs_gain_tbl = (int8_t*)&split_gain_table_abs_gain[AD9361::RXGainTableName::TBL_200_1300_MHZ],
        .tab = (uint8_t(*)[3]) split_gain_table[AD9361::RXGainTableName::TBL_200_1300_MHZ],
    },
    {
        .start = 1300000000ULL,
        .end = 4000000000ULL,
        .max_index = SIZE_SPLIT_TABLE,
        .split_table = true,
        .abs_gain_tbl = (int8_t*)&split_gain_table_abs_gain[AD9361::RXGainTableName::TBL_1300_4000_MHZ],
        .tab = (uint8_t(*)[3]) split_gain_table[AD9361::RXGainTableName::TBL_1300_4000_MHZ],
    },
    {
        .start = 4000000000ULL,
        .end = 6000000000ULL,
        .max_index = SIZE_SPLIT_TABLE,
        .split_table = true,
        .abs_gain_tbl = (int8_t*)&split_gain_table_abs_gain[AD9361::RXGainTableName::TBL_4000_6000_MHZ],
        .tab = (uint8_t(*)[3]) split_gain_table[AD9361::RXGainTableName::TBL_4000_6000_MHZ],
    },
    {
        .start = 0,
        .end = 0,
        .max_index = 0,
        .split_table = false,
        .abs_gain_tbl = NULL,
        .tab = NULL,
    }, // Don't Remove
};

// Mixer GM Sub-table
static const uint8_t gm_st_gain[16] = {0x78, 0x74, 0x70, 0x6C, 0x68, 0x64, 0x60, 0x5C, 0x58, 0x54, 0x50, 0x4C, 0x48, 0x30, 0x18, 0x0};
static const uint8_t gm_st_ctrl[16] = {0x0, 0xD, 0x15, 0x1B, 0x21, 0x25, 0x29, 0x2C, 0x2F, 0x31, 0x33, 0x34, 0x35, 0x3A, 0x3D, 0x3E};

static const int8_t lna_table[AD9361::RXGainTableName::MAX][4] =
{
    {5, 17, 19, 24},
    {3, 14, 17, 21},
    {-4, 10, 13, 14}
};
static const int8_t tia_table[] = {-6, 0};
static const int8_t mixer_table[AD9361::RXGainTableName::MAX][16] =
{
    {0, 3, 9, 13, 14, 15, 16, 17, 18, 19, 20, 21, 22, 23, 24, 25},
    {0, 3, 9, 14, 15, 16, 17, 18, 19, 20, 21, 22, 23, 24, 25, 26},
    {0, 3, 8, 12, 13, 14, 15, 16, 17, 18, 19, 20, 21, 22, 23, 24}
};
static const uint32_t gain_step_calib_reg_val[4][5] =
{
    {0xC0, 0x2E, 0x10, 0x06, 0x00},    // LO Frequency Range: 600 to 1300 MHz
    {0xC0, 0x2C, 0x10, 0x06, 0x00},    // LO Frequency Range: 1300 to 3300 MHz
    {0xB8, 0x2C, 0x10, 0x06, 0x00},    // LO Frequency Range: 2700 to 4100 MHz
    {0xA0, 0x24, 0x10, 0x06, 0x00},    // LO Frequency Range: 4000 to 6000 MHz
};

// static const char* ensm_states[] = {"SLEEP", "ENSM_RSVD_1", "ENSM_RSVD_2", "ENSM_RSVD_3", "ENSM_RSVD_4", "ALERT", "TX", "TX Flush", "RX", "RX Flush", "FDD", "FDD Flush"};

void AD9361::readReg(uint16_t reg, uint8_t *dst, uint8_t count)
{
    if(this->spi.controller == nullptr)
        throw std::runtime_error("AD9361: SPI not initialized");

    if(reg > 0x3FF)
        throw std::runtime_error("AD9361: Invalid register address");

    if(!count)
        return;

    if(dst == nullptr)
        throw std::runtime_error("AD9361: Invalid destination buffer");

    if(count > MAX_MBYTE_SPI)
        throw std::runtime_error("AD9361: Max SPI size exceeded");

    uint16_t cmd = AD_READ | AD_CNT(count) | AD_ADDR(reg);

    this->spi.controller->slaveSelect(this->spi.ss_mask, true); // This locks mutex

    this->spi.controller->write(cmd >> 8, false);
    this->spi.controller->write(cmd & 0xFF, true);
    this->spi.controller->read(dst, count);

    this->spi.controller->slaveSelect(this->spi.ss_mask, false); // This unlocks mutex
}
uint8_t AD9361::readRegField(uint16_t reg, uint8_t mask, int8_t offset)
{
    if(mask == 0x00 || offset > 7)
        return 0;

    uint8_t val = this->readReg(reg);

    if(offset < 0)
        offset = Utils::FindFirstSetBit(mask);

    return (val & mask) >> offset;
}
void AD9361::writeReg(uint16_t reg, uint8_t *src, uint8_t count)
{
    if(this->spi.controller == nullptr)
        throw std::runtime_error("AD9361: SPI not initialized");

    if(reg > 0x3FF)
        throw std::runtime_error("AD9361: Invalid register address");

    if(!count)
        return;

    if(src == nullptr)
        throw std::runtime_error("AD9361: Invalid source buffer");

    if(count > MAX_MBYTE_SPI)
        throw std::runtime_error("AD9361: Max SPI size exceeded");

    uint16_t cmd = AD_WRITE | AD_CNT(count) | AD_ADDR(reg);

    this->spi.controller->slaveSelect(this->spi.ss_mask, true); // This locks mutex

    this->spi.controller->write(cmd >> 8, false);
    this->spi.controller->write(cmd & 0xFF, false);
    this->spi.controller->write(src, count, true);

    this->spi.controller->slaveSelect(this->spi.ss_mask, false); // This unlocks mutex
}
void AD9361::writeRegField(uint16_t reg, uint8_t mask, uint8_t val, int8_t offset)
{
    if(mask == 0x00 || offset > 7)
        return;

    uint8_t tmp = this->readReg(reg);

    if(offset < 0)
        offset = Utils::FindFirstSetBit(mask);

    tmp &= ~mask;
    tmp |= (val << offset) & mask;

    this->writeReg(reg, tmp);
}

void AD9361::reset()
{
    if(this->reset_gpio.controller == nullptr)
        throw std::runtime_error("AD9361: RESET GPIO not initialized, soft reset is disabled");

    this->reset_gpio.controller->setValue(this->reset_gpio.gpio, this->reset_gpio.invert ? AXIGPIO::Value::HIGH : AXIGPIO::Value::LOW);
    usleep(1000);
    this->reset_gpio.controller->setValue(this->reset_gpio.gpio, this->reset_gpio.invert ? AXIGPIO::Value::LOW : AXIGPIO::Value::HIGH);
    usleep(1000);

    /* SPI Soft Reset was removed from the register map, since it doesn't
     * work reliably. Without a prober HW reset randomness may happen.
     * Please specify a RESET GPIO.
     */

    // this->writeReg(REG_SPI_CONF, SOFT_RESET | _SOFT_RESET);
    // this->writeReg(REG_SPI_CONF, 0x0);
    // DBGPRINTLN_CTX("Reset by SPI, this may cause unpredicted behavior!");

    // return -ENODEV;
}

void AD9361::setup()
{
    this->pdata->rf_rx_bandwidth_Hz = this->clampRFBandwidth(this->pdata->rf_rx_bandwidth_Hz);
    this->pdata->rf_tx_bandwidth_Hz = this->clampRFBandwidth(this->pdata->rf_tx_bandwidth_Hz);

    uint32_t real_rx_bandwidth = this->pdata->rf_rx_bandwidth_Hz / 2;
    uint32_t real_tx_bandwidth = this->pdata->rf_tx_bandwidth_Hz / 2;

    if(this->pdata->fdd)
    {
        this->pdata->tdd_skip_vco_cal = false;

        if(this->pdata->ensm_pin_ctrl && this->pdata->fdd_independent_mode)
            this->pdata->ensm_pin_ctrl = false;
    }

    this->setupAuxDAC(&this->pdata->auxdac_ctrl);
    this->setupGPO(&this->pdata->gpo_ctrl);

    if(this->pdata->port_ctrl.pp_conf[2] & FDD_RX_RATE_2TX_RATE)
        this->rx_eq_2tx = true;

    this->writeReg(REG_CTRL, CTRL_ENABLE);
    this->writeReg(REG_BANDGAP_CONFIG0, MASTER_BIAS_TRIM(0x0E)); // Enable Master Bias
    this->writeReg(REG_BANDGAP_CONFIG1, BANDGAP_TEMP_TRIM(0x0E)); // Set Bandgap Trim

    this->setDCXOTune(this->pdata->dcxo_coarse, this->pdata->dcxo_fine);

    uint32_t ref_freq = this->maxReferenceFreq(this->clk_refin->rate, MAX_BBPLL_FREF);

    this->writeRegField(REG_REF_DIVIDE_CONFIG_1, RX_REF_RESET_BAR, 1);
    this->writeRegField(REG_REF_DIVIDE_CONFIG_2, TX_REF_RESET_BAR, 1);
    this->writeRegField(REG_REF_DIVIDE_CONFIG_2, TX_REF_DOUBLER_FB_DELAY(~0), 3); // FB DELAY
    this->writeRegField(REG_REF_DIVIDE_CONFIG_2, RX_REF_DOUBLER_FB_DELAY(~0), 3); // FB DELAY

    this->writeReg(REG_CLOCK_ENABLE, DIGITAL_POWER_UP | CLOCK_ENABLE_DFLT | BBPLL_ENABLE | (this->pdata->use_extclk ? XO_BYPASS : 0)); // Enable Clocks

    this->setClockRate(this->ref_clk_scale[BB_REFCLK], ref_freq);

    this->writeReg(REG_FRACT_BB_FREQ_WORD_2, 0x12);
    this->writeReg(REG_FRACT_BB_FREQ_WORD_3, 0x34);

    this->setClockChain(this->pdata->rx_clocks, this->pdata->tx_clocks);

    if(!this->pdata->rx2tx2)
    {
        this->pdata->rx1tx1_mode_use_tx_num = CLAMP_T(uint32_t, this->pdata->rx1tx1_mode_use_tx_num, TX_1, TX_2);
        this->pdata->rx1tx1_mode_use_rx_num = CLAMP_T(uint32_t, this->pdata->rx1tx1_mode_use_rx_num, RX_1, RX_2);

        this->enableTX(TX_1 | TX_2, this->pdata->rx1tx1_mode_use_tx_num);
        this->enableRX(RX_1 | RX_2, this->pdata->rx1tx1_mode_use_rx_num);
    }
    else
    {
        this->enableTX(TX_1 | TX_2, TX_1 | TX_2);
        this->enableRX(RX_1 | RX_2, RX_1 | RX_2);
    }

    this->setupRFPort(true, this->pdata->rf_rx_input_sel, this->pdata->rf_tx_output_sel);
    this->setupParallelPort(false);

    this->setupAuxADC(&this->pdata->auxadc_ctrl);
    this->setupControlOutBus(&this->pdata->ctrl_outs_ctrl);
    this->writeReg(REG_REFERENCE_CLOCK_CYCLES, REFERENCE_CLOCK_CYCLES_PER_US((this->clk_refin->rate / 1000000UL) - 1));
    this->setupExternalLNA(&this->pdata->elna_ctrl);

    /*
     * This allows forcing a lower F_REF window
     * (worse phase noise, better fractional spurs)
     */
    this->pdata->trx_synth_max_fref = CLAMP_T(uint32_t, this->pdata->trx_synth_max_fref, MIN_SYNTH_FREF, MAX_SYNTH_FREF);

    ref_freq = this->maxReferenceFreq(this->clk_refin->rate, this->pdata->trx_synth_max_fref);

    this->setClockRate(this->ref_clk_scale[RX_REFCLK], ref_freq);
    this->setClockRate(this->ref_clk_scale[TX_REFCLK], ref_freq);

    this->calibrateRFPLLChargePump(false); // RXCP
    this->calibrateRFPLLChargePump(true); // TXCP

    bool tmp_use_ext_rx_lo = this->pdata->use_ext_rx_lo;
    bool tmp_use_ext_tx_lo = this->pdata->use_ext_tx_lo;

    this->pdata->use_ext_rx_lo = false;
    this->pdata->use_ext_tx_lo = false;

    this->setClockRate(this->ref_clk_scale[RX_RFPLL], this->pdata->rx_synth_freq);

    // Skip quad cal here we do it later again
    this->last_tx_quad_cal_freq = this->pdata->tx_synth_freq;
    this->setClockRate(this->ref_clk_scale[TX_RFPLL], this->pdata->tx_synth_freq);

    this->pdata->use_ext_rx_lo = tmp_use_ext_rx_lo;
    this->pdata->use_ext_tx_lo = tmp_use_ext_tx_lo;

    this->setClockMuxParent(this->ref_clk_scale[RX_RFPLL], this->pdata->use_ext_rx_lo);
    this->setClockMuxParent(this->ref_clk_scale[TX_RFPLL], this->pdata->use_ext_tx_lo);

    this->loadMixerGMSubTable();

    this->setupGainControl(&this->pdata->gain_ctrl);

    this->calibrateRXBasebandAnalogFilter(real_rx_bandwidth);
    this->calibrateTXBasebandAnalogFilter(real_tx_bandwidth);
    this->calibrateRXTIA(real_rx_bandwidth);
    this->calibrateTXSecBasebandAnalogFilter(real_tx_bandwidth);
    this->setupRXADC();
    this->calibrateBasebandDCOffset();
    this->calibrateRFDCOffset();

    this->current_rx_bw_Hz = this->pdata->rf_rx_bandwidth_Hz;
    this->current_tx_bw_Hz = this->pdata->rf_tx_bandwidth_Hz;
    this->last_tx_quad_cal_phase = ~0;

    this->calibrateTXQuadrature(-1);
    this->controlRXTracking(this->bbdc_track_en, this->rfdc_track_en, this->quad_track_en);

    this->setupParallelPort(true);

    this->setENSMMode(this->pdata->fdd, this->pdata->ensm_pin_ctrl);

    this->writeRegField(REG_TX_ATTEN_OFFSET, MASK_CLR_ATTEN_UPDATE, 0);

    this->setTXAttenuation(this->pdata->tx_atten, this->pdata->rx2tx2 ? true : this->pdata->rx1tx1_mode_use_tx_num == 1, this->pdata->rx2tx2 ? true : this->pdata->rx1tx1_mode_use_tx_num == 2, true);

    if(!this->pdata->rx2tx2)
        this->setTXAttenuation(MAX_TX_ATTENUATION_DB, this->pdata->rx1tx1_mode_use_tx_num == 2, this->pdata->rx1tx1_mode_use_tx_num == 1, true);

    this->setupRSSI(&this->pdata->rssi_ctrl, false);

    this->controlClockOutput(this->pdata->clkout_mode);
    this->setupTXMonitor(&this->pdata->txmon_ctrl);

    this->curr_ensm_state = this->readRegField(REG_STATE, ENSM_STATE(~0));

    this->setENSMState(this->pdata->fdd ? ENSM_STATE_FDD : ENSM_STATE_RX, this->pdata->ensm_pin_ctrl);

    this->auto_cal_en = true;
    this->cal_threshold_freq = 100000000ULL; // 100 MHz
}

void AD9361::setDCXOTune(uint8_t coarse, uint16_t fine)
{
    if(this->pdata->use_extclk)
        throw std::runtime_error("AD9361: DCXO tune is not supported when using external clock");

    if(coarse >= 64)
        throw std::invalid_argument("AD9361: DCXO coarse tune value must be between 0 and 63");

    if(fine >= 8192)
        throw std::invalid_argument("AD9361: DCXO fine tune value must be between 0 and 8191");

    this->writeReg(REG_DCXO_COARSE_TUNE, DCXO_TUNE_COARSE(coarse));
    this->writeReg(REG_DCXO_FINE_TUNE_LOW, DCXO_TUNE_FINE_LOW(fine));
    this->writeReg(REG_DCXO_FINE_TUNE_HIGH, DCXO_TUNE_FINE_HIGH(fine));
}

void AD9361::setupGPO(AD9361::GPOControl *ctrl)
{
    if(ctrl == nullptr)
        throw std::invalid_argument("AD9361: GPO control structure is null");

    std::lock_guard<std::mutex> lock(this->gpo_mutex);

    this->writeReg(REG_AUTO_GPO, GPO_ENABLE_AUTO_RX(ctrl->gpo0_slave_rx_en | (ctrl->gpo1_slave_rx_en << 1) | (ctrl->gpo2_slave_rx_en << 2) | (ctrl->gpo3_slave_rx_en << 3)) | GPO_ENABLE_AUTO_TX(ctrl->gpo0_slave_tx_en | (ctrl->gpo1_slave_tx_en << 1) | (ctrl->gpo2_slave_tx_en << 2) | (ctrl->gpo3_slave_tx_en << 3)));

    this->writeReg(REG_GPO_FORCE_AND_INIT, GPO_MANUAL_CTRL(ctrl->gpo_manual_mode_enable_mask) | GPO_INIT_STATE(ctrl->gpo0_inactive_state_high_en | (ctrl->gpo1_inactive_state_high_en << 1) | (ctrl->gpo2_inactive_state_high_en << 2) | (ctrl->gpo3_inactive_state_high_en << 3)));

    this->writeReg(REG_GPO0_RX_DELAY, ctrl->gpo0_rx_delay_us);
    this->writeReg(REG_GPO0_TX_DELAY, ctrl->gpo0_tx_delay_us);

    this->writeReg(REG_GPO1_RX_DELAY, ctrl->gpo1_rx_delay_us);
    this->writeReg(REG_GPO1_TX_DELAY, ctrl->gpo1_tx_delay_us);

    this->writeReg(REG_GPO2_RX_DELAY, ctrl->gpo2_rx_delay_us);
    this->writeReg(REG_GPO2_TX_DELAY, ctrl->gpo2_tx_delay_us);

    this->writeReg(REG_GPO3_RX_DELAY, ctrl->gpo3_rx_delay_us);
    this->writeReg(REG_GPO3_TX_DELAY, ctrl->gpo3_tx_delay_us);

    this->writeRegField(REG_EXTERNAL_LNA_CTRL, GPO_MANUAL_SELECT, ctrl->gpo_manual_mode_en);
}
void AD9361::setGPOValue(uint8_t gpo, AD9361::GPOValue value)
{
    if(gpo > 3)
        throw std::invalid_argument("AD9361: GPO number must be between 0 and 3");

    std::lock_guard<std::mutex> lock(this->gpo_mutex);

    if(!this->readRegField(REG_EXTERNAL_LNA_CTRL, GPO_MANUAL_SELECT))
        throw std::runtime_error("AD9361: GPOs are enslaved to the ENSM");

    this->writeRegField(REG_GPO_FORCE_AND_INIT, BIT(4 + gpo), value == AD9361::GPOValue::HIGH ? 1 : 0);

    if(value == AD9361::GPOValue::HIGH)
        this->pdata->gpo_ctrl.gpo_manual_mode_enable_mask |= BIT(gpo);
    else
        this->pdata->gpo_ctrl.gpo_manual_mode_enable_mask &= ~BIT(gpo);
}
AD9361::GPOValue AD9361::getGPOValue(uint8_t gpo)
{
    if(gpo > 3)
        throw std::invalid_argument("AD9361: GPO number must be between 0 and 3");

    std::lock_guard<std::mutex> lock(this->gpo_mutex);

    if(!this->readRegField(REG_EXTERNAL_LNA_CTRL, GPO_MANUAL_SELECT))
        throw std::runtime_error("AD9361: GPOs are enslaved to the ENSM");

    return this->readRegField(REG_GPO_FORCE_AND_INIT, BIT(4 + gpo)) ? AD9361::GPOValue::HIGH : AD9361::GPOValue::LOW;
}

void AD9361::setupAuxDAC(AD9361::AUXDACControl *ctrl)
{
    if(ctrl == nullptr)
        throw std::invalid_argument("AD9361: AuxDAC control structure is null");

    std::lock_guard<std::mutex> lock(this->auxdac_mutex);

    this->setAuxDACValue(1, ctrl->dac1_default_value);
    this->setAuxDACValue(2, ctrl->dac2_default_value);

    this->writeRegField(REG_AUXDAC_ENABLE_CTRL, AUXDAC_AUTO_TX_BAR(~0) | AUXDAC_AUTO_RX_BAR(~0) | AUXDAC_INIT_BAR(~0), ~(AUXDAC_AUTO_TX_BAR(ctrl->dac2_in_tx_en << 1 | ctrl->dac1_in_tx_en) | AUXDAC_AUTO_RX_BAR(ctrl->dac2_in_rx_en << 1 | ctrl->dac1_in_rx_en) | AUXDAC_INIT_BAR(ctrl->dac2_in_alert_en << 1 | ctrl->dac1_in_alert_en))); // Auto Control

    this->writeRegField(REG_EXTERNAL_LNA_CTRL, AUXDAC_MANUAL_SELECT, ctrl->auxdac_manual_mode_en);
    this->writeReg(REG_AUXDAC1_RX_DELAY, ctrl->dac1_rx_delay_us);
    this->writeReg(REG_AUXDAC1_TX_DELAY, ctrl->dac1_tx_delay_us);
    this->writeReg(REG_AUXDAC2_RX_DELAY, ctrl->dac2_rx_delay_us);
    this->writeReg(REG_AUXDAC2_TX_DELAY, ctrl->dac2_tx_delay_us);
}
void AD9361::setAuxDACValue(uint8_t dac, double value)
{
    if(dac < 1 || dac > 2)
        throw std::invalid_argument("AD9361: AuxDAC number must 1 or 2");

    if(value < 0)
        throw std::invalid_argument("AD9361: AuxDAC value must be positive");

    std::lock_guard<std::mutex> lock(this->auxdac_mutex);

    // Disable DAC if val == 0, Ignored in ENSM Auto Mode
    this->writeRegField(REG_AUXDAC_ENABLE_CTRL, AUXDAC_MANUAL_BAR(dac), (value > 0) ? 0 : 1);

    if(value < 306)
        value = 306;

    uint16_t val;
    uint8_t ref;

    if(value < 1888)
    {
        val = ((value - 306) * 1000) / 1469; // Vref = 1V, Step = 2
        ref = AUXDAC_1_VREF(0);
    }
    else
    {
        val = ((value - 1761) * 1000) / 1512; // Vref = 2.5V, Step = 2
        ref = AUXDAC_1_VREF(3);
    }

    val = CLAMP_T(uint16_t, val, 0, 1023);

    switch(dac)
    {
        case 1:
            this->writeReg(REG_AUXDAC_1_WORD, val >> 2);
            this->writeReg(REG_AUXDAC_1_CONFIG, AUXDAC_1_WORD_LSB(val) | ref);

            this->auxdac1_value = value;
        break;
        case 2:
            this->writeReg(REG_AUXDAC_2_WORD, val >> 2);
            this->writeReg(REG_AUXDAC_2_CONFIG, AUXDAC_2_WORD_LSB(val) | ref);

            this->auxdac2_value = value;
        break;
    }
}
double AD9361::getAuxDACValue(uint8_t dac)
{
    if(dac < 1 || dac > 2)
        throw std::invalid_argument("AD9361: DAC number must 1 or 2");

    std::lock_guard<std::mutex> lock(this->auxdac_mutex);

    // TODO: Get actual value from registers

    switch(dac)
    {
        case 1:
            return this->auxdac1_value;
        case 2:
            return this->auxdac2_value;
        default:
            return 0;
    }
}

void AD9361::setupAuxADC(AD9361::AUXADCControl *ctrl)
{
    uint32_t bbpll_freq = this->getClockRate(this->ref_clk_scale[BBPLL_CLK]);

    this->writeReg(REG_TEMP_OFFSET, ctrl->offset);
    this->writeReg(REG_START_TEMP_READING, 0x00);
    this->writeReg(REG_TEMP_SENSE2, MEASUREMENT_TIME_INTERVAL(DIV_ROUND(ctrl->temp_time_inteval_ms * (bbpll_freq / 1000UL), (1 << 29))) | (ctrl->periodic_temp_measuremnt ? TEMP_SENSE_PERIODIC_ENABLE : 0));
    this->writeReg(REG_TEMP_SENSOR_CONFIG, TEMP_SENSOR_DECIMATION(Utils::Ilog2(ctrl->temp_sensor_decimation) - 8));
    this->writeReg(REG_AUXADC_CLOCK_DIVIDER, bbpll_freq / ctrl->auxadc_clock_rate);
    this->writeReg(REG_AUXADC_CONFIG, AUX_ADC_DECIMATION(Utils::Ilog2(ctrl->auxadc_decimation) - 8));
}
double AD9361::getAuxADCValue()
{
    uint8_t buf[2];

    this->writeRegField(REG_AUXADC_CONFIG, AUXADC_POWER_DOWN, 1);
    this->readReg(REG_AUXADC_LSB, buf, 2);
    this->writeRegField(REG_AUXADC_CONFIG, AUXADC_POWER_DOWN, 0);

    uint16_t code = (buf[1] << 4) | AUXADC_WORD_LSB(buf[0]);

    return (double)code * 1300.0 / 4096.0;
}

void AD9361::setupTXMonitor(AD9361::TXMonitorControl *ctrl)
{
    this->writeReg(REG_TPM_MODE_ENABLE, (ctrl->one_shot_mode_en ? ONE_SHOT_MODE : 0) | TX_MON_DURATION(Utils::Ilog2(ctrl->tx_mon_duration / 16)));
    this->writeReg(REG_TX_MON_DELAY, ctrl->tx_mon_delay & 0xFF);
    this->writeRegField(REG_TX_LEVEL_THRESH, TX_MON_DELAY_COUNTER(~0), ctrl->tx_mon_delay >> 8);
    this->writeReg(REG_TX_MON_1_CONFIG, TX_MON_1_LO_CM(ctrl->tx1_mon_lo_cm) | TX_MON_1_GAIN(ctrl->tx1_mon_front_end_gain));
    this->writeReg(REG_TX_MON_2_CONFIG, TX_MON_2_LO_CM(ctrl->tx2_mon_lo_cm) | TX_MON_2_GAIN(ctrl->tx2_mon_front_end_gain));
    this->writeReg(REG_TX_ATTEN_THRESH, ctrl->low_high_gain_threshold_mdB / 250);
    this->writeReg(REG_TX_MON_HIGH_GAIN, TX_MON_HIGH_GAIN(ctrl->high_gain_dB));
    this->writeReg(REG_TX_MON_LOW_GAIN, (ctrl->tx_mon_track_en ? TX_MON_TRACK : 0) | TX_MON_LOW_GAIN(ctrl->low_gain_dB));
}
void AD9361::controlTXMonitor(uint8_t en)
{
    this->writeRegField(REG_ANALOG_POWER_DOWN_OVERRIDE, TX_MONITOR_POWER_DOWN(~0), ~en);

    this->writeRegField(REG_TPM_MODE_ENABLE, TX1_MON_ENABLE, !!(en & TX_1));
    this->writeRegField(REG_TPM_MODE_ENABLE, TX2_MON_ENABLE, !!(en & TX_2));
}

void AD9361::setupExternalLNA(AD9361::ExtLNAControl *ctrl)
{
    this->writeRegField(REG_EXTERNAL_LNA_CTRL, EXTERNAL_LNA1_CTRL, ctrl->elna_1_control_en);
    this->writeRegField(REG_EXTERNAL_LNA_CTRL, EXTERNAL_LNA2_CTRL, ctrl->elna_2_control_en);

    this->writeReg(REG_EXT_LNA_HIGH_GAIN, EXT_LNA_HIGH_GAIN(ctrl->gain_mdB / 500));
    this->writeReg(REG_EXT_LNA_LOW_GAIN, EXT_LNA_LOW_GAIN(ctrl->bypass_loss_mdB / 500));
}

void AD9361::setupRFPort(bool tx_out, uint8_t rx_inputs, uint8_t tx_outputs)
{
    uint32_t val;

    if(rx_inputs > 11)
        throw std::invalid_argument("AD9361: Invalid RX input");

    if(!tx_out)
    {
        if(rx_inputs > 8)
            return this->controlTXMonitor(rx_inputs & (TX_1 | TX_2));
        else
            this->controlTXMonitor(0);
    }

    if(rx_inputs < 3)
        val = 3 << (rx_inputs * 2);
    else
        val = 1 << (rx_inputs - 3);

    if(tx_outputs)
        val |= TX_OUTPUT; // Select TX1B, TX2B

    return this->writeReg(REG_INPUT_SELECT, val);
}
void AD9361::setupParallelPort(bool restore_c3)
{
    if(restore_c3)
        return this->writeReg(REG_PARALLEL_PORT_CONF_3, this->pdata->port_ctrl.pp_conf[2]);

    // Sanity check
    if(this->pdata->port_ctrl.pp_conf[2] & LVDS_MODE)
        this->pdata->port_ctrl.pp_conf[2] &= ~(HALF_DUPLEX_MODE | SINGLE_DATA_RATE | SINGLE_PORT_MODE);

    if(this->pdata->port_ctrl.pp_conf[2] & FULL_PORT)
        this->pdata->port_ctrl.pp_conf[2] &= ~(HALF_DUPLEX_MODE | SINGLE_PORT_MODE);

    this->writeReg(REG_PARALLEL_PORT_CONF_1, this->pdata->port_ctrl.pp_conf[0]);
    this->writeReg(REG_PARALLEL_PORT_CONF_2, this->pdata->port_ctrl.pp_conf[1]);
    this->writeReg(REG_PARALLEL_PORT_CONF_3, this->pdata->port_ctrl.pp_conf[2]);
    this->writeReg(REG_RX_CLOCK_DATA_DELAY, this->pdata->port_ctrl.rx_clk_data_delay);
    this->writeReg(REG_TX_CLOCK_DATA_DELAY, this->pdata->port_ctrl.tx_clk_data_delay);

    this->writeReg(REG_LVDS_BIAS_CTRL, this->pdata->port_ctrl.lvds_bias_ctrl);
    //this->writeReg(REG_DIGITAL_IO_CTRL, this->pdata->port_ctrl.digital_io_ctrl);
    this->writeReg(REG_LVDS_INVERT_CTRL1, this->pdata->port_ctrl.lvds_invert[0]);
    this->writeReg(REG_LVDS_INVERT_CTRL2, this->pdata->port_ctrl.lvds_invert[1]);

    if(this->pdata->rx1rx2_phase_inversion_en || (this->pdata->port_ctrl.pp_conf[1] & INVERT_RX2))
    {
        this->writeRegField(REG_PARALLEL_PORT_CONF_2, INVERT_RX2, 1);
        this->writeRegField(REG_INVERT_BITS, INVERT_RX2_RF_DC_CGOUT_WORD, 0);
    }
}

void AD9361::setupControlOutBus(AD9361::CtrlOutControl *ctrl)
{
    this->writeReg(REG_CTRL_OUTPUT_POINTER, ctrl->index);
    this->writeReg(REG_CTRL_OUTPUT_ENABLE, ctrl->en_mask);
}

void AD9361::setupGainControl(AD9361::GainControl *ctrl)
{
    uint8_t reg = DEC_PWR_FOR_GAIN_LOCK_EXIT | DEC_PWR_FOR_LOCK_LEVEL | DEC_PWR_FOR_LOW_PWR;

    if(ctrl->rx1_mode == RF_GAIN_HYBRID_AGC || ctrl->rx2_mode == RF_GAIN_HYBRID_AGC)
        reg |= SLOW_ATTACK_HYBRID_MODE;

    reg |= RX1_GAIN_CTRL_SETUP(ctrl->rx1_mode) | RX2_GAIN_CTRL_SETUP(ctrl->rx2_mode);

    this->agc_mode[0] = ctrl->rx1_mode;
    this->agc_mode[1] = ctrl->rx2_mode;

    this->writeReg(REG_AGC_CONFIG_1, reg); // Gain Control Mode Select

    // AGC_USE_FULL_GAIN_TABLE handled in this->loadGainTable()
    this->writeRegField(REG_AGC_CONFIG_2, MAN_GAIN_CTRL_RX1, ctrl->mgc_rx1_ctrl_inp_en);
    this->writeRegField(REG_AGC_CONFIG_2, MAN_GAIN_CTRL_RX2, ctrl->mgc_rx2_ctrl_inp_en);
    this->writeRegField(REG_AGC_CONFIG_2, DIG_GAIN_EN, ctrl->dig_gain_en);

    ctrl->adc_ovr_sample_size = CLAMP_T(uint8_t, ctrl->adc_ovr_sample_size, 1U, 8U);
    reg = ADC_OVERRANGE_SAMPLE_SIZE(ctrl->adc_ovr_sample_size - 1);

    if(this->pdata->split_gt && (ctrl->mgc_rx1_ctrl_inp_en || ctrl->mgc_rx2_ctrl_inp_en))
    {
        switch(ctrl->mgc_split_table_ctrl_inp_gain_mode)
        {
            case 1:
                reg &= ~INCDEC_LMT_GAIN;
            break;
            case 2:
                reg |= INCDEC_LMT_GAIN;
            break;
            default:
                reg |= USE_AGC_FOR_LMTLPF_GAIN;
            break;
        }
    }

    ctrl->mgc_inc_gain_step = CLAMP_T(uint8_t, ctrl->mgc_inc_gain_step, 1U, 8U);
    reg |= MANUAL_INCR_STEP_SIZE(ctrl->mgc_inc_gain_step - 1);
    this->writeReg(REG_AGC_CONFIG_3, reg); // Incr Step Size, ADC Overrange Size

    ctrl->mgc_dec_gain_step = CLAMP_T(uint8_t, ctrl->mgc_dec_gain_step, 1U, 8U);
    reg = MANUAL_CTRL_IN_DECR_GAIN_STP_SIZE(ctrl->mgc_dec_gain_step - 1);
    this->writeReg(REG_PEAK_WAIT_TIME, reg); // Decr Step Size, Peak Overload Time

    if(ctrl->dig_gain_en)
        this->writeReg(REG_DIGITAL_GAIN, MAXIMUM_DIGITAL_GAIN(ctrl->max_dig_gain) | DIG_GAIN_STP_SIZE(ctrl->dig_gain_step_size));

    if(ctrl->adc_large_overload_thresh >= ctrl->adc_small_overload_thresh)
    {
        this->writeReg(REG_ADC_SMALL_OVERLOAD_THRESH, ctrl->adc_small_overload_thresh); // ADC Small Overload Threshold
        this->writeReg(REG_ADC_LARGE_OVERLOAD_THRESH, ctrl->adc_large_overload_thresh); // ADC Large Overload Threshold
    }
    else
    {
        this->writeReg(REG_ADC_SMALL_OVERLOAD_THRESH, ctrl->adc_large_overload_thresh); // ADC Small Overload Threshold
        this->writeReg(REG_ADC_LARGE_OVERLOAD_THRESH, ctrl->adc_small_overload_thresh); // ADC Large Overload Threshold
    }

    reg = (ctrl->lmt_overload_high_thresh / 16) - 1;
    reg = CLAMP(reg, 0U, 63U);
    this->writeReg(REG_LARGE_LMT_OVERLOAD_THRESH, reg);
    reg = (ctrl->lmt_overload_low_thresh / 16) - 1;
    reg = CLAMP(reg, 0U, 63U);
    this->writeRegField(REG_SMALL_LMT_OVERLOAD_THRESH, SMALL_LMT_OVERLOAD_THRESH(~0), reg);

    if(this->pdata->split_gt)
    {
        // REVIST
        this->writeReg(REG_RX1_MANUAL_LPF_GAIN, 0x58); // Rx1 LPF Gain Index
        this->writeReg(REG_RX2_MANUAL_LPF_GAIN, 0x18); // Rx2 LPF Gain Index
        this->writeReg(REG_FAST_INITIAL_LMT_GAIN_LIMIT, 0x27); // Initial LMT Gain Limit
    }

    this->writeReg(REG_RX1_MANUAL_DIGITALFORCED_GAIN, 0x00); // Rx1 Digital Gain Index
    this->writeReg(REG_RX2_MANUAL_DIGITALFORCED_GAIN, 0x00); // Rx2 Digital Gain Index

    reg = CLAMP_T(uint8_t, ctrl->low_power_thresh, 0U, 64U) * 2;
    this->writeReg(REG_FAST_LOW_POWER_THRESH, reg); // Low Power Threshold
    this->writeReg(REG_TX_SYMBOL_ATTEN_CONFIG, 0x00); // Tx Symbol Gain Control

    this->writeRegField(REG_DEC_POWER_MEASURE_DURATION_0, USE_HB1_OUT_FOR_DEC_PWR_MEAS, !ctrl->use_rx_fir_out_for_dec_pwr_meas); // USE HB1 or FIR output for power measurements

    this->writeRegField(REG_DEC_POWER_MEASURE_DURATION_0, ENABLE_DEC_PWR_MEAS, 1); // Power Measurement Duration

    if(ctrl->rx1_mode == RF_GAIN_FASTATTACK_AGC || ctrl->rx2_mode == RF_GAIN_FASTATTACK_AGC)
        reg = Utils::Ilog2(ctrl->f_agc_dec_pow_measuremnt_duration / 16);
    else
        reg = Utils::Ilog2(ctrl->dec_pow_measuremnt_duration / 16);

    this->writeRegField(REG_DEC_POWER_MEASURE_DURATION_0, DEC_POWER_MEASUREMENT_DURATION(~0), reg); // Power Measurement Duration

    // AGC
    uint8_t tmp1 = reg = CLAMP_T(uint8_t, ctrl->agc_inner_thresh_high, 0U, 127U);
    this->writeRegField(REG_AGC_LOCK_LEVEL, AGC_LOCK_LEVEL_FAST_AGC_INNER_HIGH_THRESH_SLOW(~0), reg);

    uint8_t tmp2 = reg = CLAMP_T(uint8_t, ctrl->agc_inner_thresh_low, 0U, 127U);
    reg |= (ctrl->adc_lmt_small_overload_prevent_gain_inc ? PREVENT_GAIN_INC : 0);
    this->writeReg(REG_AGC_INNER_LOW_THRESH, reg);

    reg = AGC_OUTER_HIGH_THRESH(tmp1 - ctrl->agc_outer_thresh_high) | AGC_OUTER_LOW_THRESH(ctrl->agc_outer_thresh_low - tmp2);
    this->writeReg(REG_OUTER_POWER_THRESHS, reg);

    reg = AGC_OUTER_HIGH_THRESH_EXED_STP_SIZE(ctrl->agc_outer_thresh_high_dec_steps) | AGC_OUTER_LOW_THRESH_EXED_STP_SIZE(ctrl->agc_outer_thresh_low_inc_steps);
    this->writeReg(REG_GAIN_STP_2, reg);

    reg = ((ctrl->immed_gain_change_if_large_adc_overload) ? IMMED_GAIN_CHANGE_IF_LG_ADC_OVERLOAD : 0) | ((ctrl->immed_gain_change_if_large_lmt_overload) ? IMMED_GAIN_CHANGE_IF_LG_LMT_OVERLOAD : 0) | AGC_INNER_HIGH_THRESH_EXED_STP_SIZE(ctrl->agc_inner_thresh_high_dec_steps) | AGC_INNER_LOW_THRESH_EXED_STP_SIZE(ctrl->agc_inner_thresh_low_inc_steps);
    this->writeReg(REG_GAIN_STP1, reg);

    reg = LARGE_ADC_OVERLOAD_EXED_COUNTER(ctrl->adc_large_overload_exceed_counter) | SMALL_ADC_OVERLOAD_EXED_COUNTER(ctrl->adc_small_overload_exceed_counter);
    this->writeReg(REG_ADC_OVERLOAD_COUNTERS, reg);

    reg = DECREMENT_STP_SIZE_FOR_SMALL_LPF_GAIN_CHANGE(ctrl->f_agc_large_overload_inc_steps) | LARGE_LPF_GAIN_STEP(ctrl->adc_large_overload_inc_steps);
    this->writeReg(REG_GAIN_STP_CONFIG_2, reg);

    reg = LARGE_LMT_OVERLOAD_EXED_COUNTER(ctrl->lmt_overload_large_exceed_counter) | SMALL_LMT_OVERLOAD_EXED_COUNTER(ctrl->lmt_overload_small_exceed_counter);
    this->writeReg(REG_LMT_OVERLOAD_COUNTERS, reg);

    this->writeRegField(REG_GAIN_STP_CONFIG1, DEC_STP_SIZE_FOR_LARGE_LMT_OVERLOAD(~0), ctrl->lmt_overload_large_inc_steps);

    reg = DIG_SATURATION_EXED_COUNTER(ctrl->dig_saturation_exceed_counter) | (ctrl->sync_for_gain_counter_en ? ENABLE_SYNC_FOR_GAIN_COUNTER : 0);
    this->writeReg(REG_DIGITAL_SAT_COUNTER, reg);

    // Fast AGC

    // Fast AGC - Low Power
    this->writeRegField(REG_FAST_CONFIG_1, ENABLE_INCR_GAIN, ctrl->f_agc_allow_agc_gain_increase);

    this->writeReg(REG_FAST_INCREMENT_TIME, ctrl->f_agc_lp_thresh_increment_time);

    reg = ctrl->f_agc_lp_thresh_increment_steps - 1;
    reg = CLAMP_T(uint32_t, reg, 0U, 7U);
    this->writeRegField(REG_FAST_ENERGY_DETECT_COUNT, INCREMENT_GAIN_STP_LPFLMT(~0), reg);

    // Fast AGC - Lock Level
    // Dual use see also agc_inner_thresh_high
    this->writeRegField(REG_FAST_CONFIG_2_SETTLING_DELAY, ENABLE_LMT_GAIN_INC_FOR_LOCK_LEVEL, ctrl->f_agc_lock_level_lmt_gain_increase_en);

    reg = ctrl->f_agc_lock_level_gain_increase_upper_limit;
    reg = CLAMP_T(uint32_t, reg, 0U, 63U);
    this->writeRegField(REG_FAST_AGCLL_UPPER_LIMIT, AGCLL_MAX_INCREASE(~0), reg);

    // Fast AGC - Peak Detectors and Final Settling
    reg = ctrl->f_agc_lpf_final_settling_steps;
    reg = CLAMP_T(uint32_t, reg, 0U, 3U);
    this->writeRegField(REG_FAST_ENERGY_LOST_THRESH, POST_LOCK_LEVEL_STP_SIZE_FOR_LPF_TABLE_FULL_TABLE(~0), reg);

    reg = ctrl->f_agc_lmt_final_settling_steps;
    reg = CLAMP_T(uint32_t, reg, 0U, 3U);
    this->writeRegField(REG_FAST_STRONGER_SIGNAL_THRESH, POST_LOCK_LEVEL_STP_FOR_LMT_TABLE(~0), reg);

    reg = ctrl->f_agc_final_overrange_count;
    reg = CLAMP_T(uint32_t, reg, 0U, 7U);
    this->writeRegField(REG_FAST_FINAL_OVER_RANGE_AND_OPT_GAIN, FINAL_OVER_RANGE_COUNT(~0), reg);

    // Fast AGC - Final Power Test
    this->writeRegField(REG_FAST_CONFIG_1, ENABLE_GAIN_INC_AFTER_GAIN_LOCK, ctrl->f_agc_gain_increase_after_gain_lock_en);

    // Fast AGC - Unlocking the Gain
    // 0 = MAX Gain, 1 = Optimized Gain, 2 = Set Gain
    reg = ctrl->f_agc_gain_index_type_after_exit_rx_mode;
    this->writeRegField(REG_FAST_CONFIG_1, GOTO_SET_GAIN_IF_EXIT_RX_STATE, reg == SET_GAIN);
    this->writeRegField(REG_FAST_CONFIG_1, GOTO_OPTIMIZED_GAIN_IF_EXIT_RX_STATE, reg == OPTIMIZED_GAIN);

    this->writeRegField(REG_FAST_CONFIG_2_SETTLING_DELAY, USE_LAST_LOCK_LEVEL_FOR_SET_GAIN, ctrl->f_agc_use_last_lock_level_for_set_gain_en);

    reg = ctrl->f_agc_optimized_gain_offset;
    reg = CLAMP_T(uint32_t, reg, 0U, 15U);
    this->writeRegField(REG_FAST_FINAL_OVER_RANGE_AND_OPT_GAIN, OPTIMIZE_GAIN_OFFSET(~0), reg);

    tmp1 = !ctrl->f_agc_rst_gla_stronger_sig_thresh_exceeded_en || !ctrl->f_agc_rst_gla_engergy_lost_sig_thresh_exceeded_en || !ctrl->f_agc_rst_gla_large_adc_overload_en || !ctrl->f_agc_rst_gla_large_lmt_overload_en || ctrl->f_agc_rst_gla_en_agc_pulled_high_en;

    this->writeRegField(REG_AGC_CONFIG_2, AGC_GAIN_UNLOCK_CTRL, tmp1);

    reg = !ctrl->f_agc_rst_gla_stronger_sig_thresh_exceeded_en;
    this->writeRegField(REG_FAST_STRONG_SIGNAL_FREEZE, DONT_UNLOCK_GAIN_IF_STRONGER_SIGNAL, reg);

    reg = ctrl->f_agc_rst_gla_stronger_sig_thresh_above_ll;
    reg = CLAMP_T(uint32_t, reg, 0U, 63U);
    this->writeRegField(REG_FAST_STRONGER_SIGNAL_THRESH, STRONGER_SIGNAL_THRESH(~0), reg);

    reg = ctrl->f_agc_rst_gla_engergy_lost_sig_thresh_below_ll;
    reg = CLAMP_T(uint32_t, reg, 0U, 63U);
    this->writeRegField(REG_FAST_ENERGY_LOST_THRESH, ENERGY_LOST_THRESH(~0), reg);

    reg = ctrl->f_agc_rst_gla_engergy_lost_goto_optim_gain_en;
    this->writeRegField(REG_FAST_CONFIG_1, GOTO_OPT_GAIN_IF_ENERGY_LOST_OR_EN_AGC_HIGH, reg);

    reg = !ctrl->f_agc_rst_gla_engergy_lost_sig_thresh_exceeded_en;
    this->writeRegField(REG_FAST_CONFIG_1, DONT_UNLOCK_GAIN_IF_ENERGY_LOST, reg);

    reg = ctrl->f_agc_energy_lost_stronger_sig_gain_lock_exit_cnt;
    reg = CLAMP_T(uint32_t, reg, 0U, 63U);
    this->writeRegField(REG_FAST_GAIN_LOCK_EXIT_COUNT, GAIN_LOCK_EXIT_COUNT(~0), reg);

    reg = !ctrl->f_agc_rst_gla_large_adc_overload_en || !ctrl->f_agc_rst_gla_large_lmt_overload_en;
    this->writeRegField(REG_FAST_CONFIG_1, DONT_UNLOCK_GAIN_IF_LG_ADC_OR_LMT_OVRG, reg);

    reg = !ctrl->f_agc_rst_gla_large_adc_overload_en;
    this->writeRegField(REG_FAST_LOW_POWER_THRESH, DONT_UNLOCK_GAIN_IF_ADC_OVRG, reg);

    // 0 = Max Gain, 1 = Set Gain, 2 = Optimized Gain, 3 = No Gain Change
    if(ctrl->f_agc_rst_gla_en_agc_pulled_high_en)
    {
        switch(ctrl->f_agc_rst_gla_if_en_agc_pulled_high_mode)
        {
            case MAX_GAIN:
                this->writeRegField(REG_FAST_CONFIG_2_SETTLING_DELAY, GOTO_MAX_GAIN_OR_OPT_GAIN_IF_EN_AGC_HIGH, 1);
                this->writeRegField(REG_FAST_CONFIG_1, GOTO_SET_GAIN_IF_EN_AGC_HIGH, 0);
                this->writeRegField(REG_FAST_CONFIG_1, GOTO_OPT_GAIN_IF_ENERGY_LOST_OR_EN_AGC_HIGH, 0);
            break;
            case SET_GAIN:
                this->writeRegField(REG_FAST_CONFIG_2_SETTLING_DELAY, GOTO_MAX_GAIN_OR_OPT_GAIN_IF_EN_AGC_HIGH, 0);
                this->writeRegField(REG_FAST_CONFIG_1, GOTO_SET_GAIN_IF_EN_AGC_HIGH, 1);
            break;
            case OPTIMIZED_GAIN:
                this->writeRegField(REG_FAST_CONFIG_2_SETTLING_DELAY, GOTO_MAX_GAIN_OR_OPT_GAIN_IF_EN_AGC_HIGH, 1);
                this->writeRegField(REG_FAST_CONFIG_1, GOTO_SET_GAIN_IF_EN_AGC_HIGH, 0);
                this->writeRegField(REG_FAST_CONFIG_1, GOTO_OPT_GAIN_IF_ENERGY_LOST_OR_EN_AGC_HIGH, 1);
            break;
            case NO_GAIN_CHANGE:
                this->writeRegField(REG_FAST_CONFIG_1, GOTO_SET_GAIN_IF_EN_AGC_HIGH, 0);
                this->writeRegField(REG_FAST_CONFIG_2_SETTLING_DELAY, GOTO_MAX_GAIN_OR_OPT_GAIN_IF_EN_AGC_HIGH, 0);
            break;
        }
    }
    else
    {
        this->writeRegField(REG_FAST_CONFIG_1, GOTO_SET_GAIN_IF_EN_AGC_HIGH, 0);
        this->writeRegField(REG_FAST_CONFIG_2_SETTLING_DELAY, GOTO_MAX_GAIN_OR_OPT_GAIN_IF_EN_AGC_HIGH, 0);
    }

    reg = Utils::Ilog2(ctrl->f_agc_power_measurement_duration_in_state5 / 16);
    reg = CLAMP_T(uint32_t, reg, 0U, 15U);
    this->writeRegField(REG_RX1_MANUAL_LPF_GAIN, POWER_MEAS_IN_STATE_5(~0), reg);
    this->writeRegField(REG_RX1_MANUAL_LMT_FULL_GAIN, POWER_MEAS_IN_STATE_5_MSB, reg >> 3);

    return this->updateGainControl();
}
void AD9361::updateGainControl()
{
    uint32_t clkrf = this->getClockRate(this->ref_clk_scale[CLKRF_CLK]);
    uint32_t delay_lna = this->pdata->elna_ctrl.settling_delay_ns;

    /*
     * AGC Attack Delay (us)=ceiling((((0.2+Delay_LNA)*ClkRF+14))/(2*ClkRF))+1
     * ClkRF in MHz, delay in us
     */
    uint32_t reg = (200 + delay_lna) / 2 + (14000000UL / (clkrf / 500U));
    reg = DIV_CEIL(reg, 1000UL) + this->pdata->gain_ctrl.agc_attack_delay_extra_margin_us;
    reg = CLAMP_T(uint8_t, reg, 0U, 31U);
    this->writeRegField(REG_AGC_ATTACK_DELAY, AGC_ATTACK_DELAY(~0), reg);

    /*
     * Peak Overload Wait Time (ClkRF cycles)=ceiling((0.1+Delay_LNA) *clkRF+1)
     */
    reg = (delay_lna + 100UL) * (clkrf / 1000UL);
    reg = DIV_CEIL(reg, 1000000UL) + 1;
    reg = CLAMP_T(uint8_t, reg, 0U, 31U);
    this->writeRegField(REG_PEAK_WAIT_TIME, PEAK_OVERLOAD_WAIT_TIME(~0), reg);

    /*
     * Settling Delay in 0x111.  Applies to all gain control modes:
     * 0x111[D4:D0]= ceiling(((0.2+Delay_LNA)*clkRF
     */
    reg = (delay_lna + 200UL) * (clkrf / 2000UL);
    reg = DIV_CEIL(reg, 1000000UL) + 7;
    reg = CLAMP_T(uint8_t, reg, 0U, 31U);
    this->writeRegField(REG_FAST_CONFIG_2_SETTLING_DELAY, SETTLING_DELAY(~0), reg);

    /*
     * Gain Update Counter [15:0]= round((((time*ClkRF-0x111[D4:D0]*2)-2))/2)
     */
    reg = this->pdata->gain_ctrl.gain_update_interval_us * (clkrf / 1000UL) - reg * 2000UL - 2000UL;

    reg = DIV_ROUND(reg, 2000UL);
    reg = CLAMP_T(uint32_t, reg, 0U, 131071UL);

    uint32_t dec_pow_meas_dur;

    if(this->agc_mode[0] == RF_GAIN_FASTATTACK_AGC || this->agc_mode[1] == RF_GAIN_FASTATTACK_AGC)
    {
        dec_pow_meas_dur = this->pdata->gain_ctrl.f_agc_dec_pow_measuremnt_duration;
    }
    else
    {
        uint8_t fir_div = DIV_ROUND(clkrf, this->getClockRate(this->ref_clk_scale[RX_SAMPL_CLK]));
        dec_pow_meas_dur = this->pdata->gain_ctrl.dec_pow_measuremnt_duration;

        if(((reg * 2 / fir_div) / dec_pow_meas_dur) < 2)
            dec_pow_meas_dur = reg / fir_div;
    }

    // Power Measurement Duration
    this->writeRegField(REG_DEC_POWER_MEASURE_DURATION_0, DEC_POWER_MEASUREMENT_DURATION(~0), Utils::Ilog2(dec_pow_meas_dur / 16));

    this->writeRegField(REG_DIGITAL_SAT_COUNTER, DOUBLE_GAIN_COUNTER, reg > 65535);

    if(reg > 65535)
        reg >>= 1;

    this->writeReg(REG_GAIN_UPDATE_COUNTER1, reg & 0xFF);
    this->writeReg(REG_GAIN_UPDATE_COUNTER2, reg >> 8);

    /*
     * Fast AGC State Wait Time - Energy Detect Count
     */
    reg = DIV_ROUND(this->pdata->gain_ctrl.f_agc_state_wait_time_ns * (clkrf / 1000UL), 1000000UL);
    reg = CLAMP_T(uint32_t, reg, 0U, 31U);
    this->writeRegField(REG_FAST_ENERGY_DETECT_COUNT, ENERGY_DETECT_COUNT(~0), reg);
}

void AD9361::setupRXADC()
{
    uint8_t c3_msb = this->readReg(REG_RX_BBF_C3_MSB);
    uint8_t c3_lsb = this->readReg(REG_RX_BBF_C3_LSB);
    uint8_t r2346 = this->readReg(REG_RX_BBF_R2346);

    /*
    * BBBW = (BBPLL / RxTuneDiv) * ln(2) / (1.4 * 2PI )
    * We assume this->calibrateRXBasebandAnalogFilter() is always run prior
    */
    uint64_t tmp = this->getClockRate(this->ref_clk_scale[BBPLL_CLK]) * 10000ULL;
    Utils::DoDiv(&tmp, 126906UL * this->rxbbf_div);
    uint32_t bb_bw_Hz = CLAMP(tmp, 200000UL, 28000000UL);

    uint32_t adc_sampl_freq_Hz = this->getClockRate(this->ref_clk_scale[ADC_CLK]);
    uint16_t scale_snr_1e3;

    if(adc_sampl_freq_Hz < 80000000)
        scale_snr_1e3 = 1000;
    else
        scale_snr_1e3 = 1585; // pow(10, scale_snr_dB/10);

    uint64_t invrc_tconst_1e6;

    if(bb_bw_Hz >= 18000000)
    {
        invrc_tconst_1e6 = (160975ULL * r2346 * (160 * c3_msb + 10 * c3_lsb + 140) * (bb_bw_Hz) * (1000 + (10 * (bb_bw_Hz - 18000000) / 1000000)));

        Utils::DoDiv(&invrc_tconst_1e6, 1000UL);
    }
    else
    {
        invrc_tconst_1e6 = (160975ULL * r2346 * (160 * c3_msb + 10 * c3_lsb + 140) * (bb_bw_Hz));
    }

    Utils::DoDiv(&invrc_tconst_1e6, 1000000000UL);

    uint32_t sqrt_inv_rc_tconst_1e3 = Utils::IntSqrt((uint32_t)invrc_tconst_1e6);
    uint32_t maxsnr = 640 / 160;
    uint32_t scaled_adc_clk_1e6 = DIV_ROUND(adc_sampl_freq_Hz, 640);
    uint32_t inv_scaled_adc_clk_1e3 = DIV_ROUND(640000000, DIV_ROUND(adc_sampl_freq_Hz, 1000));
    uint32_t tmp_1e3 = DIV_ROUND(980000 + 20 * MAX_T(uint32_t, 1000U, DIV_ROUND(inv_scaled_adc_clk_1e3, maxsnr)), 1000);
    uint32_t sqrt_term_1e3 = Utils::IntSqrt(scaled_adc_clk_1e6);
    uint32_t min_sqrt_term_1e3 = MIN_T(uint32_t, 1000U, Utils::IntSqrt(maxsnr * scaled_adc_clk_1e6));

    uint8_t data[40];

    data[0] = 0;
    data[1] = 0;
    data[2] = 0;
    data[3] = 0x24;
    data[4] = 0x24;
    data[5] = 0;
    data[6] = 0;

    tmp = -50000000 + 8ULL * scale_snr_1e3 * sqrt_inv_rc_tconst_1e3 * min_sqrt_term_1e3;
    Utils::DoDiv(&tmp, 100000000UL);
    data[7] = MIN_T(uint64_t, 124U, tmp);

    tmp = (invrc_tconst_1e6 >> 1) + 20 * inv_scaled_adc_clk_1e3 * data[7] / 80 * 1000ULL;
    Utils::DoDiv(&tmp, invrc_tconst_1e6);
    data[8] = MIN_T(uint64_t, 255U, tmp);

    tmp = (-500000 + 77ULL * sqrt_inv_rc_tconst_1e3 * min_sqrt_term_1e3);
    Utils::DoDiv(&tmp, 1000000UL);
    data[10] = MIN_T(uint64_t, 127U, tmp);

    data[9] = MIN_T(uint32_t, 127U, ((800 * data[10]) / 1000));
    tmp = ((invrc_tconst_1e6 >> 1) + (20 * inv_scaled_adc_clk_1e3 * data[10] * 1000ULL));
    Utils::DoDiv(&tmp, invrc_tconst_1e6 * 77);
    data[11] = MIN_T(uint64_t, 255U, tmp);
    data[12] = MIN_T(uint32_t, 127U, (-500000 + 80 * sqrt_inv_rc_tconst_1e3 * min_sqrt_term_1e3) / 1000000UL);

    tmp = -3 * (int64_t)(invrc_tconst_1e6 >> 1) + inv_scaled_adc_clk_1e3 * data[12] * (1000ULL * 20 / 80);
    Utils::DoDiv(&tmp, invrc_tconst_1e6);
    data[13] = MIN_T(uint64_t, 255, tmp);

    data[14] = 21 * (inv_scaled_adc_clk_1e3 / 10000);
    data[15] = MIN_T(uint32_t, 127U, (500 + 1025 * data[7]) / 1000);
    data[16] = MIN_T(uint32_t, 127U, (data[15] * tmp_1e3) / 1000);
    data[17] = data[15];
    data[18] = MIN_T(uint32_t, 127U, (500 + 975 * data[10]) / 1000);
    data[19] = MIN_T(uint32_t, 127U, (data[18] * tmp_1e3) / 1000);
    data[20] = data[18];
    data[21] = MIN_T(uint32_t, 127U, (500 + 975 * data[12]) / 1000);
    data[22] = MIN_T(uint32_t, 127, (data[21] * tmp_1e3) / 1000);
    data[23] = data[21];
    data[24] = 0x2E;
    data[25] = (128 + MIN_T(uint32_t, 63000U, DIV_ROUND(63 * scaled_adc_clk_1e6, 1000)) / 1000);
    data[26] = MIN_T(uint32_t, 63U, 63 * scaled_adc_clk_1e6 / 1000000 * (920 + 80 * inv_scaled_adc_clk_1e3 / 1000) / 1000);
    data[27] = MIN_T(uint32_t, 63, (32 * sqrt_term_1e3) / 1000);
    data[28] = data[25];
    data[29] = data[26];
    data[30] = data[27];
    data[31] = data[25];
    data[32] = data[26];
    data[33] = MIN_T(uint32_t, 63U, 63 * sqrt_term_1e3 / 1000);
    data[34] = MIN_T(uint32_t, 127U, 64 * sqrt_term_1e3 / 1000);
    data[35] = 0x40;
    data[36] = 0x40;
    data[37] = 0x2C;
    data[38] = 0x00;
    data[39] = 0x00;

    for(uint8_t i = 0; i < 40; i++)
        this->writeReg(0x200 + i, data[i]);
}

void AD9361::setupRSSI(AD9361::RSSIControl *ctrl, bool is_update)
{
    uint32_t rssi_delay;
    uint32_t rssi_wait;
    int32_t rssi_duration;

    if(ctrl->rssi_unit_is_rx_samples)
    {
        if(is_update)
            return; // no update required

        rssi_delay = ctrl->rssi_delay;
        rssi_wait = ctrl->rssi_wait;
        rssi_duration = ctrl->rssi_duration;
    }
    else
    {
        // update sample based on RX rate
        uint32_t rate = DIV_ROUND(this->getClockRate(this->ref_clk_scale[RX_SAMPL_CLK]), 1000);
        // units are in us
        rssi_delay = DIV_ROUND(ctrl->rssi_delay * rate, 1000);
        rssi_wait = DIV_ROUND(ctrl->rssi_wait * rate, 1000);
        rssi_duration = DIV_ROUND(ctrl->rssi_duration * rate, 1000);
    }

    if(ctrl->restart_mode == EN_AGC_PIN_IS_PULLED_HIGH)
        rssi_delay = 0;

    rssi_delay = CLAMP(rssi_delay / 8, 0U, 255U);
    rssi_wait = CLAMP(rssi_wait / 4, 0U, 255U);

    uint8_t j = 0;
    uint8_t dur_buf[4] = {0, 0, 0, 0};
    uint32_t total_dur = 0;

    do
    {
        for(int8_t i = 14; rssi_duration > 0 && i >= 0; i--)
        {
            int32_t val = 1 << i;

            if((int64_t)rssi_duration >= val)
            {
                dur_buf[j++] = i;
                total_dur += val;
                rssi_duration -= val;

                break;
            }
        }

    }
    while(j < 4 && rssi_duration > 0);

    uint32_t total_weight = 0;
    uint32_t weight[4];

    for(uint8_t i = 0; i < 4; i++)
        if(i < j)
            total_weight += weight[i] = DIV_ROUND(RSSI_MAX_WEIGHT * (1 << dur_buf[i]), total_dur);
        else
            total_weight += weight[i] = 0;

    // total of all weights must be 0xFF
    int32_t val = total_weight - 0xFF;
    weight[j - 1] -= val;

    this->writeReg(REG_MEASURE_DURATION_01, (dur_buf[1] << 4) | dur_buf[0]); // RSSI Measurement Duration 0, 1
    this->writeReg(REG_MEASURE_DURATION_23, (dur_buf[3] << 4) | dur_buf[2]); // RSSI Measurement Duration 2, 3
    this->writeReg(REG_RSSI_WEIGHT_0, weight[0]); // RSSI Weighted Multiplier 0
    this->writeReg(REG_RSSI_WEIGHT_1, weight[1]); // RSSI Weighted Multiplier 1
    this->writeReg(REG_RSSI_WEIGHT_2, weight[2]); // RSSI Weighted Multiplier 2
    this->writeReg(REG_RSSI_WEIGHT_3, weight[3]); // RSSI Weighted Multiplier 3
    this->writeReg(REG_RSSI_DELAY, rssi_delay); // RSSI Delay
    this->writeReg(REG_RSSI_WAIT_TIME, rssi_wait); // RSSI Wait

    uint8_t temp = RSSI_MODE_SELECT(ctrl->restart_mode);

    if(ctrl->restart_mode == SPI_WRITE_TO_REGISTER)
        temp |= START_RSSI_MEAS;

    if(rssi_duration == 0 && j == 1) // Power of two
        temp |= DEFAULT_RSSI_MEAS_MODE;

    this->writeReg(REG_RSSI_CONFIG, temp); // RSSI Mode Select
}

double AD9361::getTemperature()
{
    uint32_t val;

    this->writeRegField(REG_AUXADC_CONFIG, AUXADC_POWER_DOWN, 1);
    val = this->readReg(REG_TEMPERATURE);
    this->writeRegField(REG_AUXADC_CONFIG, AUXADC_POWER_DOWN, 0);

    return (double)val / 1.14;
}

void AD9361::registerClocks()
{
    // Scaled Reference Clocks
    this->registerClock(AD9361::ClockIndex::TX_REFCLK, AD9361::ClockIndex::EXT_REF_CLK);
    this->registerClock(AD9361::ClockIndex::RX_REFCLK, AD9361::ClockIndex::EXT_REF_CLK);
    this->registerClock(AD9361::ClockIndex::BB_REFCLK, AD9361::ClockIndex::EXT_REF_CLK);

    // Base Band PLL Clock
    this->registerClock(AD9361::ClockIndex::BBPLL_CLK, AD9361::ClockIndex::BB_REFCLK);

    this->registerClock(AD9361::ClockIndex::ADC_CLK, AD9361::ClockIndex::BBPLL_CLK);
    this->registerClock(AD9361::ClockIndex::R2_CLK, AD9361::ClockIndex::ADC_CLK);
    this->registerClock(AD9361::ClockIndex::R1_CLK, AD9361::ClockIndex::R2_CLK);
    this->registerClock(AD9361::ClockIndex::CLKRF_CLK, AD9361::ClockIndex::R1_CLK);
    this->registerClock(AD9361::ClockIndex::RX_SAMPL_CLK, AD9361::ClockIndex::CLKRF_CLK);

    this->registerClock(AD9361::ClockIndex::DAC_CLK, AD9361::ClockIndex::ADC_CLK);
    this->registerClock(AD9361::ClockIndex::T2_CLK, AD9361::ClockIndex::DAC_CLK);
    this->registerClock(AD9361::ClockIndex::T1_CLK, AD9361::ClockIndex::T2_CLK);
    this->registerClock(AD9361::ClockIndex::CLKTF_CLK, AD9361::ClockIndex::T1_CLK);
    this->registerClock(AD9361::ClockIndex::TX_SAMPL_CLK, AD9361::ClockIndex::CLKTF_CLK);

    this->registerClock(AD9361::ClockIndex::RX_RFPLL_INT, AD9361::ClockIndex::RX_REFCLK);
    this->registerClock(AD9361::ClockIndex::TX_RFPLL_INT, AD9361::ClockIndex::TX_REFCLK);
    this->registerClock(AD9361::ClockIndex::RX_RFPLL_DUMMY);
    this->registerClock(AD9361::ClockIndex::TX_RFPLL_DUMMY);
    this->registerClock(AD9361::ClockIndex::RX_RFPLL);
    this->registerClock(AD9361::ClockIndex::TX_RFPLL);
}
void AD9361::unregisterClocks()
{
    for(uint8_t i = 0; i < NUM_AD9361_CLKS; i++)
    {
        if(this->clks[i] != nullptr)
            delete this->clks[i];

        this->clks[i] = nullptr;

        if(this->ref_clk_scale[i] != nullptr)
            delete this->ref_clk_scale[i];

        this->ref_clk_scale[i] = nullptr;
    }
}
void AD9361::registerClock(AD9361::ClockIndex source, AD9361::ClockIndex psource)
{
    AD9361::ClockScale *clk_scale = new AD9361::ClockScale();

    if(!clk_scale)
        throw std::runtime_error("AD9361: Failed to allocate memory for clock scale");

    AD9361::Clock *clk = new AD9361::Clock();

    if(!clk)
    {
        delete clk_scale;

        throw std::runtime_error("AD9361: Failed to allocate memory for clock");
    }

    clk_scale->source = source;
    clk_scale->parent_source = psource;

    switch(source)
    {
        case TX_REFCLK:
        case RX_REFCLK:
        case BB_REFCLK:
            clk->rate = this->getClockFactorRate(clk_scale, this->clk_refin->rate);
        break;
        case BBPLL_CLK:
            clk->rate = this->getBBPLLRate(clk_scale, this->clks[BB_REFCLK]->rate);
        break;
        case ADC_CLK:
            clk->rate = this->getClockFactorRate(clk_scale, this->clks[BBPLL_CLK]->rate);
        break;
        case R2_CLK:
            clk->rate = this->getClockFactorRate(clk_scale, this->clks[ADC_CLK]->rate);
        break;
        case R1_CLK:
            clk->rate = this->getClockFactorRate(clk_scale, this->clks[R2_CLK]->rate);
        break;
        case CLKRF_CLK:
            clk->rate = this->getClockFactorRate(clk_scale, this->clks[R1_CLK]->rate);
        break;
        case RX_SAMPL_CLK:
            clk->rate = this->getClockFactorRate(clk_scale, this->clks[CLKRF_CLK]->rate);
        break;
        case DAC_CLK:
            clk->rate = this->getClockFactorRate(clk_scale, this->clks[ADC_CLK]->rate);
        break;
        case T2_CLK:
            clk->rate = this->getClockFactorRate(clk_scale, this->clks[DAC_CLK]->rate);
        break;
        case T1_CLK:
            clk->rate = this->getClockFactorRate(clk_scale, this->clks[T2_CLK]->rate);
        break;
        case CLKTF_CLK:
            clk->rate = this->getClockFactorRate(clk_scale, this->clks[T1_CLK]->rate);
        break;
        case TX_SAMPL_CLK:
            clk->rate = this->getClockFactorRate(clk_scale, this->clks[CLKTF_CLK]->rate);
        break;
        case RX_RFPLL_INT:
            clk->rate = this->getIntRFPLLRate(clk_scale, this->clks[RX_REFCLK]->rate);
        break;
        case TX_RFPLL_INT:
            clk->rate = this->getIntRFPLLRate(clk_scale, this->clks[TX_REFCLK]->rate);
        break;
        case RX_RFPLL_DUMMY:
            clk->rate = this->pdata->rx_synth_freq;
        break;
        case TX_RFPLL_DUMMY:
            clk->rate = this->pdata->tx_synth_freq;
        break;
        case RX_RFPLL:
        case TX_RFPLL:
            clk->rate = this->getRFPLLRate(clk_scale);
        break;
        default:
            throw std::runtime_error("AD9361: Invalid clock source");
    }

    this->ref_clk_scale[source] = clk_scale;
    this->clks[source] = clk;
}
uint64_t AD9361::getClockRate(AD9361::ClockScale *clk_scale)
{
    switch(clk_scale->source)
    {
        case TX_REFCLK:
        case RX_REFCLK:
        case BB_REFCLK:
            return this->getClockFactorRate(clk_scale, this->clk_refin->rate);
        break;
        case TX_RFPLL_INT:
        case RX_RFPLL_INT:
            return this->getIntRFPLLRate(clk_scale, this->clks[clk_scale->parent_source]->rate);
        break;
        case RX_RFPLL_DUMMY:
        case TX_RFPLL_DUMMY:
            return this->getDummyRFPLLRate(clk_scale);
        break;
        case TX_RFPLL:
        case RX_RFPLL:
            return this->getRFPLLRate(clk_scale);
        break;
        case BBPLL_CLK:
            return this->getBBPLLRate(clk_scale, this->clks[clk_scale->parent_source]->rate);
        break;
        case ADC_CLK:
        case R2_CLK:
        case R1_CLK:
        case CLKRF_CLK:
        case RX_SAMPL_CLK:
        case DAC_CLK:
        case T2_CLK:
        case T1_CLK:
        case CLKTF_CLK:
        case TX_SAMPL_CLK:
            return this->getClockFactorRate(clk_scale, this->clks[clk_scale->parent_source]->rate);
        break;
        default:
            throw std::runtime_error("AD9361: Invalid clock source");
    }
}
void AD9361::setClockRate(AD9361::ClockScale *clk_scale, uint64_t rate)
{
    if(this->clks[clk_scale->source]->rate != rate || (clk_scale->source == BBPLL_CLK && !this->bbpll_initialized))
    {
        switch(clk_scale->source)
        {
            case TX_REFCLK:
            case RX_REFCLK:
            case BB_REFCLK:
            {
                uint64_t round_rate = this->roundClockFactorRate(clk_scale, rate, this->clk_refin->rate);

                this->setClockFactorRate(clk_scale, round_rate, this->clk_refin->rate);

                this->clks[clk_scale->source]->rate = this->getClockFactorRate(clk_scale, this->clk_refin->rate);
            }
            break;
            case TX_RFPLL_INT:
            case RX_RFPLL_INT:
            {
                uint64_t round_rate = this->roundIntRFPLLRate(clk_scale, rate, this->clks[clk_scale->parent_source]->rate);

                this->setIntRFPLLRate(clk_scale, round_rate, this->clks[clk_scale->parent_source]->rate);

                this->clks[clk_scale->source]->rate = this->getIntRFPLLRate(clk_scale, this->clks[clk_scale->parent_source]->rate);
            }
            break;
            case RX_RFPLL_DUMMY:
            case TX_RFPLL_DUMMY:
                this->setDummyRFPLLRate(clk_scale, rate);
            break;
            case TX_RFPLL:
            case RX_RFPLL:
            {
                uint64_t round_rate = this->roundRFPLLRate(clk_scale, rate);

                this->setRFPLLRate(clk_scale, round_rate);

                this->clks[clk_scale->source]->rate = this->getRFPLLRate(clk_scale);
            }
            break;
            case BBPLL_CLK:
            {
                uint64_t round_rate = this->roundBBPLLRate(clk_scale, rate, this->clks[clk_scale->parent_source]->rate);

                this->setBBPLLRate(clk_scale, round_rate, this->clks[clk_scale->parent_source]->rate);

                this->clks[clk_scale->source]->rate = this->getBBPLLRate(clk_scale, this->clks[clk_scale->parent_source]->rate);

                this->bbpll_initialized = true;
            }
            break;
            case ADC_CLK:
            case R2_CLK:
            case R1_CLK:
            case CLKRF_CLK:
            case RX_SAMPL_CLK:
            case DAC_CLK:
            case T2_CLK:
            case T1_CLK:
            case CLKTF_CLK:
            case TX_SAMPL_CLK:
            {
                uint64_t round_rate = this->roundClockFactorRate(clk_scale, rate, this->clks[clk_scale->parent_source]->rate);

                this->setClockFactorRate(clk_scale, round_rate, this->clks[clk_scale->parent_source]->rate);

                this->clks[clk_scale->source]->rate = this->getClockFactorRate(clk_scale, this->clks[clk_scale->parent_source]->rate);
            }
            break;
            default:
                throw std::runtime_error("AD9361: Invalid clock source");
        }

        for(AD9361::ClockIndex i = BB_REFCLK; i < BBPLL_CLK; i = (AD9361::ClockIndex)(i + 1))
            this->clks[i]->rate = this->getClockFactorRate(this->ref_clk_scale[i], this->clk_refin->rate);

        this->clks[BBPLL_CLK]->rate = this->getBBPLLRate(this->ref_clk_scale[BBPLL_CLK], this->clks[this->ref_clk_scale[BBPLL_CLK]->parent_source]->rate);

        for(AD9361::ClockIndex i = ADC_CLK; i < RX_RFPLL_INT; i = (AD9361::ClockIndex)(i + 1))
            this->clks[i]->rate = this->getClockFactorRate(this->ref_clk_scale[i], this->clks[this->ref_clk_scale[i]->parent_source]->rate);

        for(AD9361::ClockIndex i = RX_RFPLL_INT; i < RX_RFPLL_DUMMY; i = (AD9361::ClockIndex)(i + 1))
            this->clks[i]->rate = this->getIntRFPLLRate(this->ref_clk_scale[i], this->clks[this->ref_clk_scale[i]->parent_source]->rate);

        for(AD9361::ClockIndex i = RX_RFPLL_DUMMY; i < RX_RFPLL; i = (AD9361::ClockIndex)(i + 1))
            this->clks[i]->rate = this->getDummyRFPLLRate(this->ref_clk_scale[i]);

        for(AD9361::ClockIndex i = RX_RFPLL; i < NUM_AD9361_CLKS; i = (AD9361::ClockIndex)(i + 1))
            this->clks[i]->rate = this->getRFPLLRate(this->ref_clk_scale[i]);
    }
}

uint32_t AD9361::roundClockFactorRate(AD9361::ClockScale *clk_scale, uint32_t rate, uint32_t prate)
{
    if(rate >= prate)
    {
        clk_scale->mult = DIV_ROUND(rate, prate);
        clk_scale->div = 1;
    }
    else
    {
        clk_scale->mult = 1;
        clk_scale->div = DIV_ROUND(prate, rate);

        if(!clk_scale->div)
            clk_scale->div = 1;
    }

    this->setClockScaler(clk_scale, false);

    return (prate / clk_scale->div) * clk_scale->mult;
}
uint32_t AD9361::getClockFactorRate(AD9361::ClockScale *clk_scale, uint32_t prate)
{
    this->getClockScaler(clk_scale);

    return ((uint64_t)prate * clk_scale->mult) / clk_scale->div;
}
void AD9361::setClockFactorRate(AD9361::ClockScale *clk_scale, uint32_t rate, uint32_t prate)
{
    if(rate >= prate)
    {
        clk_scale->mult = DIV_ROUND(rate, prate);
        clk_scale->div = 1;
    }
    else
    {
        clk_scale->mult = 1;
        clk_scale->div = DIV_ROUND(prate, rate);

        if(!clk_scale->div)
            clk_scale->div = 1;
    }

    this->setClockScaler(clk_scale, true);
}

uint32_t AD9361::roundBBPLLRate(AD9361::ClockScale *clk_scale, uint32_t rate, uint32_t prate)
{
    (void)clk_scale;

    this->validateBBPLLFrequency(rate);

    uint64_t temp = rate;
    uint64_t tmp = Utils::DoDiv(&temp, prate);
    tmp = tmp * BBPLL_MODULUS + (prate >> 1);
    Utils::DoDiv(&tmp, prate);

    uint8_t integer = temp;
    uint32_t fract = tmp;

    tmp = (uint64_t)prate * fract;
    Utils::DoDiv(&tmp, BBPLL_MODULUS);
    tmp += (uint64_t)prate * integer;

    return tmp;
}
uint32_t AD9361::getBBPLLRate(AD9361::ClockScale *clk_scale, uint32_t prate)
{
    uint8_t buf[4];

    this->readReg(REG_INTEGER_BB_FREQ_WORD, buf, REG_INTEGER_BB_FREQ_WORD - REG_FRACT_BB_FREQ_WORD_1 + 1);

    uint8_t integer = buf[0];
    uint32_t fract = (buf[3] << 16) | (buf[2] << 8) | buf[1];

    uint64_t rate = (uint64_t)prate * fract;
    Utils::DoDiv(&rate, BBPLL_MODULUS);
    rate += (uint64_t)prate * integer;

    return (uint32_t)rate;
}
void AD9361::setBBPLLRate(AD9361::ClockScale *clk_scale, uint32_t rate, uint32_t prate)
{
    int32_t icp_val;
    uint8_t lf_defaults[3] = { 0x35, 0x5B, 0xE8 };

    /*
    * Setup Loop Filter and CP Current
    * Scale is 150uA @ (1280MHz BBPLL, 40MHz REFCLK)
    */
    uint64_t tmp = (rate >> 7) * 150ULL;
    Utils::DoDiv(&tmp, (prate >> 7) * 32UL);

    // 25uA/LSB, Offset 25uA
    icp_val = DIV_ROUND((uint32_t)tmp, 25U) - 1;
    icp_val = CLAMP(icp_val, 1, 64);

    this->writeReg(REG_CP_CURRENT, icp_val);
    this->writeReg(REG_LOOP_FILTER_3, lf_defaults, ARRAY_SIZE(lf_defaults));

    // Allow calibration to occur and set cal count to 1024 for max accuracy
    this->writeReg(REG_VCO_CTRL, FREQ_CAL_ENABLE | FREQ_CAL_COUNT_LENGTH(3));

    // Set calibration clock to REFCLK/4 for more accuracy
    this->writeReg(REG_SDM_CTRL, 0x10);

    // Calculate and set BBPLL frequency word
    uint64_t temp = rate;
    tmp = Utils::DoDiv(&temp, prate);
    tmp = tmp * BBPLL_MODULUS + (prate >> 1);
    Utils::DoDiv(&tmp, prate);

    uint8_t integer = temp;
    uint32_t fract = tmp;

    this->writeReg(REG_INTEGER_BB_FREQ_WORD, integer);
    this->writeReg(REG_FRACT_BB_FREQ_WORD_3, fract);
    this->writeReg(REG_FRACT_BB_FREQ_WORD_2, fract >> 8);
    this->writeReg(REG_FRACT_BB_FREQ_WORD_1, fract >> 16);

    this->writeReg(REG_SDM_CTRL_1, INIT_BB_FO_CAL | BBPLL_RESET_BAR); // Start BBPLL Calibration
    this->writeReg(REG_SDM_CTRL_1, BBPLL_RESET_BAR); // Clear BBPLL start calibration bit

    this->writeReg(REG_VCO_PROGRAM_1, 0x86); // Increase BBPLL KV and phase margin
    this->writeReg(REG_VCO_PROGRAM_2, 0x01); // Increase BBPLL KV and phase margin
    this->writeReg(REG_VCO_PROGRAM_2, 0x05); // Increase BBPLL KV and phase margin

    return this->checkCalibrationDone(REG_CH_1_OVERFLOW, BBPLL_LOCK, 1);
}

uint64_t AD9361::roundIntRFPLLRate(AD9361::ClockScale *clk_scale, uint64_t rate, uint32_t prate)
{
    (void)clk_scale;

    this->validateRFPLLFrequency(rate);

    uint8_t div = 0;
    rate <<= 1;

    while(rate < MIN_VCO_FREQ_HZ)
    {
        div++;
        rate <<= 1;
    }

    uint64_t tmp = Utils::DoDiv(&rate, prate);
    tmp = tmp * RFPLL_MODULUS + (prate >> 1);
    Utils::DoDiv(&tmp, prate);

    uint16_t integer = rate;
    uint32_t fract = tmp;

    tmp = (uint64_t)prate * fract;
    Utils::DoDiv(&tmp, RFPLL_MODULUS);
    tmp += (uint64_t)prate * integer;

    return tmp >> (div + 1);
}
uint64_t AD9361::getIntRFPLLRate(AD9361::ClockScale *clk_scale, uint32_t prate)
{
    uint16_t reg;
    uint8_t div_mask;
    uint8_t profile;

    switch(clk_scale->source)
    {
        case RX_RFPLL_INT:
            reg = REG_RX_FRACT_BYTE_2;
            div_mask = RX_VCO_DIVIDER(~0);

            profile = this->fastlock.current_profile[0];
        break;
        case TX_RFPLL_INT:
            reg = REG_TX_FRACT_BYTE_2;
            div_mask = TX_VCO_DIVIDER(~0);

            profile = this->fastlock.current_profile[1];
        break;
        default:
            throw std::invalid_argument("AD9361: Invalid RF PLL");
        break;
    }

    uint8_t buf[5];
    uint8_t div;

    if(profile)
    {
        bool tx = clk_scale->source == TX_RFPLL_INT;
        profile--;

        buf[0] = this->readFastLockVal(tx, profile, 4);
        buf[1] = this->readFastLockVal(tx, profile, 3);
        buf[2] = this->readFastLockVal(tx, profile, 2);
        buf[3] = this->readFastLockVal(tx, profile, 1);
        buf[4] = this->readFastLockVal(tx, profile, 0);

        div = this->readFastLockVal(tx, profile, 12) & 0xF;
    }
    else
    {
        this->readReg(reg, buf, ARRAY_SIZE(buf));

        div = this->readRegField(REG_RFPLL_DIVIDERS, div_mask);
    }

    uint16_t integer = (SYNTH_INTEGER_WORD(buf[3]) << 8) | buf[4];
    uint32_t fract = (SYNTH_FRACT_WORD(buf[0]) << 16) | (buf[1] << 8) | buf[2];

    uint64_t rate = (uint64_t)prate * fract;
    Utils::DoDiv(&rate, RFPLL_MODULUS);
    rate += (uint64_t)prate * integer;

    return rate >> (div + 1);
}
void AD9361::setIntRFPLLRate(AD9361::ClockScale *clk_scale, uint64_t rate, uint32_t prate)
{
    this->validateRFPLLFrequency(rate);

    uint8_t div = 0;
    uint64_t vco = rate << 1;

    while(vco < MIN_VCO_FREQ_HZ)
    {
        div++;
        vco <<= 1;
    }

    uint64_t temp = vco;
    uint64_t tmp = Utils::DoDiv(&temp, prate);
    tmp = tmp * RFPLL_MODULUS + (prate >> 1);
    Utils::DoDiv(&tmp, prate);

    uint16_t integer = temp;
    uint32_t fract = tmp;

    this->prepareFastLockProfile(clk_scale->source == TX_RFPLL_INT, 0, false);

    uint16_t reg;
    uint16_t lock_reg;
    uint8_t div_mask;

    switch(clk_scale->source)
    {
        case RX_RFPLL_INT:
            reg = REG_RX_FRACT_BYTE_2;
            lock_reg = REG_RX_CP_OVERRANGE_VCO_LOCK;
            div_mask = RX_VCO_DIVIDER(~0);

            this->cached_rx_rfpll_div = div;
            this->current_rx_lo_freq = rate;
        break;
        case TX_RFPLL_INT:
            reg = REG_TX_FRACT_BYTE_2;
            lock_reg = REG_TX_CP_OVERRANGE_VCO_LOCK;
            div_mask = TX_VCO_DIVIDER(~0);

            this->cached_tx_rfpll_div = div;
            this->current_tx_lo_freq = rate;
        break;
        default:
            throw std::invalid_argument("AD9361: Invalid RF PLL");
    }

    // Option to skip VCO cal in TDD mode when moving from TX/RX to Alert
    if(this->pdata->tdd_skip_vco_cal)
        this->controlVCOCalibration(clk_scale->source == TX_RFPLL_INT, true);

    uint8_t fixup_other;

    do
    {
        fixup_other = 0;

        this->initRFPLLVCO(div_mask == TX_VCO_DIVIDER(~0), vco, prate);

        uint8_t buf[5];

        buf[0] = SYNTH_FRACT_WORD(fract >> 16);
        buf[1] = fract >> 8;
        buf[2] = fract & 0xFF;
        buf[3] = SYNTH_INTEGER_WORD(integer >> 8) | (~SYNTH_INTEGER_WORD(~0) & this->readReg(reg - 3));
        buf[4] = integer & 0xFF;

        this->writeReg(reg, buf, 5);
        this->writeRegField(REG_RFPLL_DIVIDERS, div_mask, div);

        this->checkCalibrationDone(lock_reg, VCO_LOCK, 1);

        // In FDD mode with RX LO == TX LO frequency we use TDD tables to reduce VCO pulling
        if(((this->pdata->fdd && !this->pdata->fdd_independent_mode) && (this->current_tx_lo_freq == this->current_rx_lo_freq) && (this->current_tx_use_tdd_table != this->current_rx_use_tdd_table)) || ((this->pdata->fdd && !this->pdata->fdd_independent_mode) && (this->current_tx_lo_freq != this->current_rx_lo_freq) && (this->current_tx_use_tdd_table || this->current_rx_use_tdd_table)))
        {
            uint64_t _rate;

            switch(clk_scale->source)
            {
                case RX_RFPLL_INT:
                    reg = REG_TX_FRACT_BYTE_2;
                    lock_reg = REG_TX_CP_OVERRANGE_VCO_LOCK;
                    div_mask = TX_VCO_DIVIDER(~0);
                    _rate = this->current_tx_lo_freq;
                break;
                case TX_RFPLL_INT:
                    reg = REG_RX_FRACT_BYTE_2;
                    lock_reg = REG_RX_CP_OVERRANGE_VCO_LOCK;
                    div_mask = RX_VCO_DIVIDER(~0);
                    _rate = this->current_rx_lo_freq;
                break;
                default:
                    throw std::invalid_argument("AD9361: Invalid RF PLL");
            }

            if(_rate != rate)
            {
                div = 0;
                vco = _rate << 1;

                while(vco < MIN_VCO_FREQ_HZ)
                {
                    div++;
                    vco <<= 1;
                }

                uint64_t temp = vco;
                uint64_t tmp = Utils::DoDiv(&temp, prate);
                tmp = tmp * RFPLL_MODULUS + (prate >> 1);
                Utils::DoDiv(&tmp, prate);

                integer = temp;
                fract = tmp;

                this->prepareFastLockProfile(clk_scale->source == RX_RFPLL_INT, 0, false);
            }

            fixup_other = 1;
        }

    }
    while(fixup_other);

    if(this->pdata->tdd_skip_vco_cal)
        this->controlVCOCalibration(clk_scale->source == TX_RFPLL_INT, false);
}

uint64_t AD9361::getDummyRFPLLRate(AD9361::ClockScale *clk_scale)
{
    return this->clks[clk_scale->source]->rate;
}
void AD9361::setDummyRFPLLRate(AD9361::ClockScale *clk_scale, uint64_t rate)
{
    this->clks[clk_scale->source]->rate = rate;
}

uint64_t AD9361::roundRFPLLRate(AD9361::ClockScale *clk_scale, uint64_t rate)
{
    switch(clk_scale->source)
    {
        case RX_RFPLL:
            if(this->pdata->use_ext_rx_lo)
                // if(this->ad9361_rfpll_ext_round_rate)
                //     return this->ad9361_rfpll_ext_round_rate(clk_scale, rate);
                // else
                    return rate;
            else
                return this->roundIntRFPLLRate(this->ref_clk_scale[RX_RFPLL_INT], rate, this->clks[this->ref_clk_scale[RX_RFPLL_INT]->parent_source]->rate);
        break;
        case TX_RFPLL:
            if(this->pdata->use_ext_tx_lo)
                // if(this->ad9361_rfpll_ext_round_rate)
                //     return this->ad9361_rfpll_ext_round_rate(clk_scale, rate);
                // else
                    return rate;
            else
                return this->roundIntRFPLLRate(this->ref_clk_scale[TX_RFPLL_INT], rate, this->clks[this->ref_clk_scale[TX_RFPLL_INT]->parent_source]->rate);
        break;
        default:
            throw std::invalid_argument("AD9361: Invalid RF PLL");
        break;
    }
}
uint64_t AD9361::getRFPLLRate(AD9361::ClockScale *clk_scale)
{
    switch(clk_scale->source)
    {
        case RX_RFPLL:
            if(this->pdata->use_ext_rx_lo)
                // if(this->ad9361_rfpll_ext_recalc_rate)
                //     return this->ad9361_rfpll_ext_recalc_rate(clk_scale);
                // else
                    return this->getDummyRFPLLRate(this->ref_clk_scale[RX_RFPLL_DUMMY]);
            else
                return this->getIntRFPLLRate(this->ref_clk_scale[RX_RFPLL_INT], this->clks[RX_REFCLK]->rate);
        break;
        case TX_RFPLL:
            if(this->pdata->use_ext_tx_lo)
                // if(this->ad9361_rfpll_ext_recalc_rate)
                //     rate = this->ad9361_rfpll_ext_recalc_rate(clk_scale);
                // else
                    return this->getDummyRFPLLRate(this->ref_clk_scale[TX_RFPLL_DUMMY]);
            else
                return this->getIntRFPLLRate(this->ref_clk_scale[TX_RFPLL_INT], this->clks[TX_REFCLK]->rate);
        break;
        default:
            throw std::invalid_argument("AD9361: Invalid RF PLL");
        break;
    }
}
void AD9361::setRFPLLRate(AD9361::ClockScale *clk_scale, uint64_t rate)
{
    switch(clk_scale->source)
    {
        case RX_RFPLL:
            if(this->pdata->use_ext_rx_lo)
                // if(this->ad9361_rfpll_ext_set_rate)
                //     this->ad9361_rfpll_ext_set_rate(clk_scale, rate);
                // else
                    this->setDummyRFPLLRate(this->ref_clk_scale[RX_RFPLL_DUMMY], rate);
            else
                this->setIntRFPLLRate(this->ref_clk_scale[RX_RFPLL_INT], rate, this->clks[this->ref_clk_scale[RX_RFPLL_INT]->parent_source]->rate);

            // Load Gain Table
            this->loadGainTable(rate, GT_RX1 | GT_RX2);
        break;
        case TX_RFPLL:
            if(this->pdata->use_ext_tx_lo)
                // if(this->ad9361_rfpll_ext_set_rate)
                //     this->ad9361_rfpll_ext_set_rate(clk_scale, rate);
                // else
                    this->setDummyRFPLLRate(this->ref_clk_scale[TX_RFPLL_DUMMY], rate);
            else
                this->setIntRFPLLRate(this->ref_clk_scale[TX_RFPLL_INT], rate, this->clks[this->ref_clk_scale[TX_RFPLL_INT]->parent_source]->rate);

            // For RX LO we typically have the tracking option enabled so for now do nothing here.
            if(this->auto_cal_en && !this->pdata->use_ext_tx_lo)
            {
                if((D_ABS(this->last_tx_quad_cal_freq, rate)) > this->cal_threshold_freq)
                {
                    try
                    {
                        this->controlRXTracking(false, false, false);
                        this->forceENSMState(ENSM_STATE_ALERT);

                        this->calibrateTXQuadrature(-1);

                        this->controlRXTracking(this->bbdc_track_en, this->rfdc_track_en, this->quad_track_en);
                        this->restorePrevENSMState();
                    }
                    catch(std::exception &e)
                    {
                        // TODO: Log error
                    }

                    this->last_tx_quad_cal_freq = rate;
                }
            }
        break;
        default:
            throw std::invalid_argument("AD9361: Invalid RF PLL");
        break;
    }
}

void AD9361::setClockMuxParent(AD9361::ClockScale *clk_scale, uint8_t index)
{
    this->forceENSMState(ENSM_STATE_ALERT);

    this->controlExternalLO(clk_scale->source == TX_RFPLL, index == 1);

    clk_scale->mult = index;

    this->restorePrevENSMState();
}

void AD9361::setClockScaler(AD9361::ClockScale *clk_scale, bool set)
{
    switch(clk_scale->source)
    {
        case BB_REFCLK:
        {
            uint8_t val = this->getRefClockScaler(clk_scale);

            if(set)
                this->writeRegField(REG_CLOCK_CTRL, REF_FREQ_SCALER(~0), val);
        }
        break;
        case RX_REFCLK:
        {
            uint8_t val = this->getRefClockScaler(clk_scale);

            if(set)
            {
                this->writeRegField(REG_REF_DIVIDE_CONFIG_1, RX_REF_DIVIDER_MSB, val >> 1);
                this->writeRegField(REG_REF_DIVIDE_CONFIG_2, RX_REF_DIVIDER_LSB, val & 1);
            }
        }
        break;
        case TX_REFCLK:
        {
            uint8_t val = this->getRefClockScaler(clk_scale);

            if(set)
                this->writeRegField(REG_REF_DIVIDE_CONFIG_2, TX_REF_DIVIDER(~0), val);
        }
        break;
        case ADC_CLK:
        {
            uint8_t val = Utils::Ilog2((uint8_t)clk_scale->div);

            if(clk_scale->mult != 1 || val > 6 || val < 1)
                throw std::invalid_argument("AD9361: ADC clock divider must be a power of two between 2 and 64");

            if(set)
                this->writeRegField(REG_BBPLL, 0x7, val);
        }
        break;
        case R2_CLK:
        {
            if(clk_scale->mult != 1 || clk_scale->div > 3 || clk_scale->div < 1)
                throw std::invalid_argument("AD9361: R2 clock divider must be 1, 2 or 3");

            if(set)
                this->writeRegField(REG_RX_ENABLE_FILTER_CTRL, DEC3_ENABLE_DECIMATION(~0), clk_scale->div - 1);
        }
        break;
        case R1_CLK:
        {
            if(clk_scale->mult != 1 || clk_scale->div > 2 || clk_scale->div < 1)
                throw std::invalid_argument("AD9361: R1 clock divider must be 1 or 2");

            if(set)
                this->writeRegField(REG_RX_ENABLE_FILTER_CTRL, RHB2_EN, clk_scale->div - 1);
        }
        break;
        case CLKRF_CLK:
        {
            if(clk_scale->mult != 1 || clk_scale->div > 2 || clk_scale->div < 1)
                throw std::invalid_argument("AD9361: CLKRF clock divider must be 1 or 2");

            if(set)
                this->writeRegField(REG_RX_ENABLE_FILTER_CTRL, RHB1_EN, clk_scale->div - 1);
        }
        break;
        case RX_SAMPL_CLK:
        {
            if(clk_scale->mult != 1 || clk_scale->div > 4 || clk_scale->div < 1 || clk_scale->div == 3)
                throw std::invalid_argument("AD9361: RX_SAMPL clock divider must be 1, 2 or 4");

            uint8_t val = this->bypass_rx_fir ? 0 : (Utils::Ilog2((uint8_t)clk_scale->div) + 1);

            if(set)
                this->writeRegField(REG_RX_ENABLE_FILTER_CTRL, RX_FIR_ENABLE_DECIMATION(~0), val);
        }
        break;
        case DAC_CLK:
        {
            if(clk_scale->mult != 1 || clk_scale->div > 2 || clk_scale->div < 1)
                throw std::invalid_argument("AD9361: DAC clock divider must be 1 or 2");

            if(set)
                this->writeRegField(REG_BBPLL, BIT(3), clk_scale->div - 1);
        }
        break;
        case T2_CLK:
        {
            if(clk_scale->mult != 1 || clk_scale->div > 3 || clk_scale->div < 1)
                throw std::invalid_argument("AD9361: T2 clock divider must be 1, 2 or 3");

            if(set)
                this->writeRegField(REG_TX_ENABLE_FILTER_CTRL, THB3_ENABLE_INTERP(~0), clk_scale->div - 1);
        }
        break;
        case T1_CLK:
        {
            if(clk_scale->mult != 1 || clk_scale->div > 2 || clk_scale->div < 1)
                throw std::invalid_argument("AD9361: T1 clock divider must be 1 or 2");

            if(set)
                this->writeRegField(REG_TX_ENABLE_FILTER_CTRL, THB2_EN, clk_scale->div - 1);
        }
        break;
        case CLKTF_CLK:
        {
            if(clk_scale->mult != 1 || clk_scale->div > 2 || clk_scale->div < 1)
                throw std::invalid_argument("AD9361: CLKTF clock divider must be 1 or 2");

            if(set)
                this->writeRegField(REG_TX_ENABLE_FILTER_CTRL, THB1_EN, clk_scale->div - 1);
        }
        break;
        case TX_SAMPL_CLK:
        {
            if(clk_scale->mult != 1 || clk_scale->div > 4 || clk_scale->div < 1 || clk_scale->div == 3)
                throw std::invalid_argument("AD9361: TX_SAMPL clock divider must be 1, 2 or 4");

            uint8_t val = this->bypass_tx_fir ? 0 : (Utils::Ilog2((uint8_t)clk_scale->div) + 1);

            if(set)
                this->writeRegField(REG_TX_ENABLE_FILTER_CTRL, TX_FIR_ENABLE_INTERPOLATION(~0), val);
        }
        break;
        default:
            throw std::invalid_argument("AD9361: Invalid clock source");
        break;
    }
}
void AD9361::getClockScaler(AD9361::ClockScale *clk_scale)
{
    switch(clk_scale->source)
    {
        case BB_REFCLK:
        {
            uint8_t tmp = this->readRegField(REG_CLOCK_CTRL, 0x03);

            if(tmp > 2)
            {
                clk_scale->mult = 2;
                clk_scale->div = 1;
            }
            else
            {
                clk_scale->mult = 1;
                clk_scale->div = 1 << tmp;
            }
        }
        break;
        case RX_REFCLK:
        {
            uint8_t tmp = (this->readRegField(REG_REF_DIVIDE_CONFIG_1, RX_REF_DIVIDER_MSB) << 1) | this->readRegField(REG_REF_DIVIDE_CONFIG_2, RX_REF_DIVIDER_LSB);

            if(tmp > 2)
            {
                clk_scale->mult = 2;
                clk_scale->div = 1;
            }
            else
            {
                clk_scale->mult = 1;
                clk_scale->div = 1 << tmp;
            }
        }
        break;
        case TX_REFCLK:
        {
            uint8_t tmp = this->readRegField(REG_REF_DIVIDE_CONFIG_2, TX_REF_DIVIDER(~0));

            if(tmp > 2)
            {
                clk_scale->mult = 2;
                clk_scale->div = 1;
            }
            else
            {
                clk_scale->mult = 1;
                clk_scale->div = 1 << tmp;
            }
        }
        break;
        case ADC_CLK:
        {
            uint8_t tmp = this->readRegField(REG_BBPLL, 0x07);

            clk_scale->mult = 1;
            clk_scale->div = 1 << tmp;
        }
        break;
        case R2_CLK:
        {
            uint8_t tmp = this->readRegField(REG_RX_ENABLE_FILTER_CTRL, DEC3_ENABLE_DECIMATION(~0));

            clk_scale->mult = 1;
            clk_scale->div = tmp + 1;
        }
        break;
        case R1_CLK:
        {
            uint8_t tmp = this->readRegField(REG_RX_ENABLE_FILTER_CTRL, RHB2_EN);

            clk_scale->mult = 1;
            clk_scale->div = tmp + 1;
        }
        break;
        case CLKRF_CLK:
        {
            uint8_t tmp = this->readRegField(REG_RX_ENABLE_FILTER_CTRL, RHB1_EN);

            clk_scale->mult = 1;
            clk_scale->div = tmp + 1;
        }
        break;
        case RX_SAMPL_CLK:
        {
            uint8_t tmp = this->readRegField(REG_RX_ENABLE_FILTER_CTRL, RX_FIR_ENABLE_DECIMATION(~0));

            if(!tmp)
                tmp = 1; // bypass filter
            else
                tmp = (1 << (tmp - 1));

            clk_scale->mult = 1;
            clk_scale->div = tmp;
        }
        break;
        case DAC_CLK:
        {
            uint8_t tmp = this->readRegField(REG_BBPLL, BIT(3));

            clk_scale->mult = 1;
            clk_scale->div = tmp + 1;
        }
        break;
        case T2_CLK:
        {
            uint8_t tmp = this->readRegField(REG_TX_ENABLE_FILTER_CTRL, THB3_ENABLE_INTERP(~0));

            clk_scale->mult = 1;
            clk_scale->div = tmp + 1;
        }
        break;
        case T1_CLK:
        {
            uint8_t tmp = this->readRegField(REG_TX_ENABLE_FILTER_CTRL, THB2_EN);

            clk_scale->mult = 1;
            clk_scale->div = tmp + 1;
        }
        break;
        case CLKTF_CLK:
        {
            uint8_t tmp = this->readRegField(REG_TX_ENABLE_FILTER_CTRL, THB1_EN);

            clk_scale->mult = 1;
            clk_scale->div = tmp + 1;
        }
        break;
        case TX_SAMPL_CLK:
        {
            uint8_t tmp = this->readRegField(REG_TX_ENABLE_FILTER_CTRL, TX_FIR_ENABLE_INTERPOLATION(~0));

            if(!tmp)
                tmp = 1; // bypass filter
            else
                tmp = (1 << (tmp - 1));

            clk_scale->mult = 1;
            clk_scale->div = tmp;
        }
        break;
        default:
            throw std::invalid_argument("AD9361: Invalid clock source");
        break;
    }
}

void AD9361::calcClockChain(uint32_t tx_sample_rate, uint32_t rate_governor, uint32_t *rx_clocks, uint32_t *tx_clocks)
{
    const uint8_t clk_dividers[][4] =
    {
        {12, 3, 2, 2},
        {8, 2, 2, 2},
        {6, 3, 1, 2},
        {4, 2, 2, 1},
        {3, 3, 1, 1},
        {2, 2, 1, 1},
        {1, 1, 1, 1},
    };

    uint8_t tx_int = this->bypass_tx_fir ? 1 : this->tx_fir_int;
    uint8_t rx_dec = this->bypass_rx_fir ? 1 : this->rx_fir_dec;

    bool recursion = true;

    if((rate_governor == 1) && ((rx_dec * tx_sample_rate * 8) < MIN_ADC_CLK))
    {
        recursion = false;
        rate_governor = 0;
    }

    if(tx_sample_rate > MAX_BASEBAND_RATE)
        throw std::invalid_argument("AD9361: TX sample rate exceeds maximum baseband rate");

    uint32_t clktf = tx_sample_rate * tx_int;
    uint32_t clkrf = tx_sample_rate * rx_dec * (this->rx_eq_2tx ? 2 : 1);
    uint32_t adc_rate = 0;
    uint32_t dac_rate = 0;
    int8_t index_rx = -1;
    int8_t index_tx = -1;

    for(uint32_t i = rate_governor; i < 7; i++)
    {
        adc_rate = clkrf * clk_dividers[i][0];
        dac_rate = clktf * clk_dividers[i][0];

        if((adc_rate <= MAX_ADC_CLK) && (adc_rate >= MIN_ADC_CLK))
        {
            int8_t tmp;

            if(dac_rate > adc_rate)
                tmp = (dac_rate / adc_rate) * -1;
            else
                tmp = adc_rate / dac_rate;

            if(adc_rate <= MAX_DAC_CLK)
            {
                index_rx = i;
                index_tx = i - ((tmp == 1) ? 0 : tmp);
                dac_rate = adc_rate; // ADC_CLK

                break;
            }
            else
            {
                dac_rate = adc_rate / 2;  // ADC_CLK/2
                index_rx = i;

                if(i == 4 && tmp >= 0)
                    index_tx = 7; // STOP: 3/2 != 1
                else
                    index_tx = i + ((i == 5 && tmp >= 0) ? 1 : 2) - ((tmp == 1) ? 0 : tmp);

                break;
            }
        }
    }

    if((index_tx < 0 || index_tx > 6 || index_rx < 0 || index_rx > 6) && rate_governor < 7 && recursion)
        return this->calcClockChain(tx_sample_rate, ++rate_governor, rx_clocks, tx_clocks);
    else if((index_tx < 0 || index_tx > 6 || index_rx < 0 || index_rx > 6))
        throw std::invalid_argument("AD9361: Failed to find suitable dividers: " + ((adc_rate < MIN_ADC_CLK) ? std::string("ADC clock below limit") : std::string("BBPLL rate above limit")));

    // Calculate target BBPLL rate
    uint64_t bbpll_rate;
    uint8_t div = MAX_BBPLL_DIV;

    do
    {
        bbpll_rate = (uint64_t)adc_rate * div;
        div >>= 1;

    }
    while((bbpll_rate > MAX_BBPLL_FREQ) && (div >= MIN_BBPLL_DIV));

    rx_clocks[BBPLL_FREQ] = bbpll_rate;
    rx_clocks[ADC_FREQ] = adc_rate;
    rx_clocks[R2_FREQ] = rx_clocks[ADC_FREQ] / clk_dividers[index_rx][1];
    rx_clocks[R1_FREQ] = rx_clocks[R2_FREQ] / clk_dividers[index_rx][2];
    rx_clocks[CLKRF_FREQ] = rx_clocks[R1_FREQ] / clk_dividers[index_rx][3];
    rx_clocks[RX_SAMPL_FREQ] = rx_clocks[CLKRF_FREQ] / rx_dec;

    tx_clocks[BBPLL_FREQ] = bbpll_rate;
    tx_clocks[DAC_FREQ] = dac_rate;
    tx_clocks[T2_FREQ] = tx_clocks[DAC_FREQ] / clk_dividers[index_tx][1];
    tx_clocks[T1_FREQ] = tx_clocks[T2_FREQ] / clk_dividers[index_tx][2];
    tx_clocks[CLKTF_FREQ] = tx_clocks[T1_FREQ] / clk_dividers[index_tx][3];
    tx_clocks[TX_SAMPL_FREQ] = tx_clocks[CLKTF_FREQ] / tx_int;
}
void AD9361::validateClockChain(uint32_t *rx_clocks, uint32_t *tx_clocks)
{
    static const uint32_t max_rx_rates[] = {MAX_BBPLL_FREQ, MAX_ADC_CLK, MAX_RX_HB3, MAX_RX_HB2, MAX_RX_HB1, MAX_BASEBAND_RATE};
    static const uint32_t max_tx_rates[] = {MAX_BBPLL_FREQ, MAX_DAC_CLK, MAX_TX_HB3, MAX_TX_HB2, MAX_TX_HB1, MAX_BASEBAND_RATE};

    uint32_t data_clk = (this->pdata->rx2tx2 ? 4 : 2) / ((this->pdata->port_ctrl.pp_conf[2] & LVDS_MODE) ? 1 : 2) * rx_clocks[RX_SAMPL_FREQ];

    // CMOS Mode
    if(!(this->pdata->port_ctrl.pp_conf[2] & LVDS_MODE) && (data_clk > MAX_BASEBAND_RATE))
        throw std::invalid_argument("AD9361: CMOS mode DATA_CLK > MAX_BASEBAND_RATE");

    // Validate MAX PLL, ADC, DAC and HB filter rates
    for(uint8_t i = 0; i < ARRAY_SIZE(max_rx_rates); i++)
    {
        if(rx_clocks[i] > max_rx_rates[i])
            throw std::invalid_argument("AD9361: Failed RX max rate check at " + std::to_string(i) + " (" + std::to_string(rx_clocks[i]) + " > " + std::to_string(max_rx_rates[i]) + ")");

        if(tx_clocks[i] > max_tx_rates[i])
            throw std::invalid_argument("AD9361: Failed TX max rate check at " + std::to_string(i) + " (" + std::to_string(tx_clocks[i]) + " > " + std::to_string(max_tx_rates[i]) + ")");
    }

    // Validate that DATA_CLK exist within the clock chain
    for(uint8_t i = 1; i <= 3; i++)
        if(D_ABS(rx_clocks[ADC_FREQ] / i, data_clk) < 4)
            return;

    for(uint8_t i = 1; i <= 4; i++)
        if(D_ABS((rx_clocks[R2_FREQ] >> i), data_clk) < 4)
            return;

    throw std::invalid_argument("AD9361: DATA_CLK (LVDS) rate not found in the clock chain");
}
void AD9361::setClockChain(uint32_t *rx_clocks, uint32_t *tx_clocks)
{
    if(rx_clocks == nullptr)
        throw std::invalid_argument("AD9361: Invalid RX clock chain");

    if(tx_clocks == nullptr)
        throw std::invalid_argument("AD9361: Invalid TX clock chain");

    this->validateClockChain(rx_clocks, tx_clocks);

    this->setClockRate(this->ref_clk_scale[BBPLL_CLK], rx_clocks[BBPLL_FREQ]);

    this->current_rx_path_clks[BBPLL_FREQ] = rx_clocks[BBPLL_FREQ];

    for(uint8_t i = ADC_CLK, j = DAC_CLK, n = ADC_FREQ; i <= RX_SAMPL_CLK; i++, j++, n++)
    {
        this->setClockRate(this->ref_clk_scale[i], rx_clocks[n]);

        this->current_rx_path_clks[n] = rx_clocks[n];

        this->setClockRate(this->ref_clk_scale[j], tx_clocks[n]);

        this->current_tx_path_clks[n] = tx_clocks[n];
    }

    /*
     * Workaround for clock framework since clocks don't change we
     * manually need to enable the filter
     */

    if(this->rx_fir_dec == 1 || this->bypass_rx_fir)
        this->writeRegField(REG_RX_ENABLE_FILTER_CTRL, RX_FIR_ENABLE_DECIMATION(~0), !this->bypass_rx_fir);

    if(this->tx_fir_int == 1 || this->bypass_tx_fir)
        this->writeRegField(REG_TX_ENABLE_FILTER_CTRL, TX_FIR_ENABLE_INTERPOLATION(~0), !this->bypass_tx_fir);

    /* The FIR filter once enabled causes the interface timing to change.
     * It's typically not a problem if the timing margin is big enough.
     * However at 61.44 MSPS it causes problems on some systems.
     * So we always run the digital tune in case the filter is enabled.
     * If it is disabled we restore the values from the initial calibration.
     */
    // TODO: Re-enable this
    // if(!this->pdata->dig_interface_tune_fir_disable && !(this->bypass_tx_fir && this->bypass_rx_fir))
    //     ad9361_util_dig_tune(0, SKIP_STORE_RESULT);

    //ad9361_bb_clk_change_handler(); TODO
    this->updateGainControl();
    this->setupRSSI(&this->pdata->rssi_ctrl, true);
    this->setupAuxADC(&this->pdata->auxadc_ctrl);
}
void AD9361::getClockChain(uint32_t *rx_clocks, uint32_t *tx_clocks)
{
    uint32_t bbpll_freq;

    if(rx_clocks == nullptr && tx_clocks == nullptr)
        throw std::invalid_argument("AD9361: Provide at least one clock chain");

    bbpll_freq = this->getClockRate(this->ref_clk_scale[BBPLL_CLK]);

    if(rx_clocks != nullptr)
        rx_clocks[BBPLL_FREQ] = bbpll_freq;

    if(tx_clocks != nullptr)
        tx_clocks[BBPLL_FREQ] = bbpll_freq;

    for(uint8_t i = ADC_CLK, j = DAC_CLK, n = ADC_FREQ; i <= RX_SAMPL_CLK; i++, j++, n++)
    {
        if(rx_clocks != nullptr)
            rx_clocks[n] = this->getClockRate(this->ref_clk_scale[i]);

        if(tx_clocks != nullptr)
            tx_clocks[n] = this->getClockRate(this->ref_clk_scale[j]);
    }
}

void AD9361::checkCalibrationDone(uint16_t reg, uint8_t mask, uint8_t done_val, uint32_t timeout_ms)
{
    uint32_t timeout_us = timeout_ms * 1000;

    do
    {
        uint8_t val = this->readRegField(reg, mask);

        if(val == done_val)
            return;

        if(reg == REG_CALIBRATION_CTRL)
        {
            timeout_us -= 1000;

            usleep(1000);
        }
        else
        {
            timeout_us -= 100;

            usleep(100);
        }
    }
    while(timeout_us);

    throw std::runtime_error("AD9361: Calibration timeout (reg: " + std::to_string(reg) + ", mask: " + std::to_string(mask) + ", done_val: " + std::to_string(done_val) + ")");
}
void AD9361::calibrateRFPLLChargePump(bool tx)
{
    uint32_t offs = tx ? 0x40 : 0;
    uint32_t vco_cal_cnt;

    // REVIST:
    this->writeReg(REG_RX_CP_LEVEL_DETECT + offs, 0x17);

    this->writeReg(REG_RX_DSM_SETUP_1 + offs, 0x0);

    this->writeReg(REG_RX_LO_GEN_POWER_MODE + offs, 0x00);
    this->writeReg(REG_RX_VCO_LDO + offs, 0x0B);
    this->writeReg(REG_RX_VCO_PD_OVERRIDES + offs, 0x02);
    this->writeReg(REG_RX_CP_CURRENT + offs, 0x80);
    this->writeReg(REG_RX_CP_CONFIG + offs, CP_OFFSET_OFF);

    // see Table 70 Example Calibration Times for RF VCO Cal
    if(this->pdata->fdd)
    {
        vco_cal_cnt = VCO_CAL_EN | VCO_CAL_COUNT(3) | FB_CLOCK_ADV(2);
    }
    else
    {
        uint32_t ref_clk_hz = this->getClockRate(this->ref_clk_scale[tx ? TX_REFCLK : RX_REFCLK]);

        if(ref_clk_hz > 40000000UL)
            vco_cal_cnt = VCO_CAL_EN | VCO_CAL_COUNT(1) | FB_CLOCK_ADV(2);
        else
            vco_cal_cnt = VCO_CAL_EN | VCO_CAL_COUNT(0) | FB_CLOCK_ADV(2);
    }

    this->writeReg(REG_RX_VCO_CAL + offs, vco_cal_cnt);

    // Enable FDD mode during calibrations
    if(!this->pdata->fdd)
        this->writeRegField(REG_PARALLEL_PORT_CONF_3, HALF_DUPLEX_MODE, 0);

    this->writeReg(REG_ENSM_CONFIG_2, DUAL_SYNTH_MODE);
    this->writeReg(REG_ENSM_CONFIG_1, FORCE_ALERT_STATE | TO_ALERT);
    this->writeReg(REG_ENSM_MODE, FDD_MODE);

    this->writeReg(REG_RX_CP_CONFIG + offs, CP_OFFSET_OFF | CP_CAL_ENABLE);

    this->checkCalibrationDone(REG_RX_CAL_STATUS + offs, CP_CAL_VALID, 1);
}
void AD9361::calibrateRXBasebandAnalogFilter(uint32_t bw)
{
    bw = CLAMP(bw, 200000UL, 28000000UL);

    // 1.4 * BBBW * 2PI / ln(2)
    uint32_t target = 126906UL * (bw / 10000UL);
    this->rxbbf_div = MIN_T(uint32_t, 511UL, DIV_CEIL(this->getClockRate(this->ref_clk_scale[BBPLL_CLK]), target));

    // Set RX baseband filter divide value
    this->writeReg(REG_RX_BBF_TUNE_DIVIDE, this->rxbbf_div);
    this->writeRegField(REG_RX_BBF_TUNE_CONFIG, BIT(0), this->rxbbf_div >> 8);

    // Write the BBBW into registers 0x1FB and 0x1FC
    this->writeReg(REG_RX_BBBW_MHZ, bw / 1000000UL);

    uint8_t tmp = DIV_ROUND((bw % 1000000UL) * 128, 1000000UL);
    this->writeReg(REG_RX_BBBW_KHZ, MIN_T(uint8_t, 127, tmp));

    this->writeReg(REG_RX_MIX_LO_CM, RX_MIX_LO_CM(0x3F)); // Set Rx Mix LO CM
    this->writeReg(REG_RX_MIX_GM_CONFIG, RX_MIX_GM_PLOAD(3)); // Set GM common mode

    // Enable the RX BBF tune circuit by writing 0x1E2=0x02 and 0x1E3=0x02
    this->writeReg(REG_RX1_TUNE_CTRL, RX1_TUNE_RESAMPLE);
    this->writeReg(REG_RX2_TUNE_CTRL, RX2_TUNE_RESAMPLE);

    // Start the RX Baseband Filter calibration in register 0x016[7]
    // Calibration is complete when register 0x016[7] self clears
    this->runCalibration(RX_BB_TUNE_CAL);

    // Disable the RX baseband filter tune circuit, write 0x1E2=3, 0x1E3=3
    this->writeReg(REG_RX1_TUNE_CTRL, RX1_TUNE_RESAMPLE | RX1_PD_TUNE);
    this->writeReg(REG_RX2_TUNE_CTRL, RX2_TUNE_RESAMPLE | RX2_PD_TUNE);
}
void AD9361::calibrateRXTIA(uint32_t bw)
{
    uint8_t reg1EB = this->readReg(REG_RX_BBF_C3_MSB);
    uint8_t reg1EC = this->readReg(REG_RX_BBF_C3_LSB);
    uint8_t reg1E6 = this->readReg(REG_RX_BBF_R2346);

    bw = CLAMP(bw, 200000UL, 20000000UL);

    uint32_t Cbbf = (reg1EB * 160) + (reg1EC * 10) + 140; // fF
    uint32_t R2346 = 18300 * RX_BBF_R2346(reg1E6);

    uint64_t CTIA_fF = Cbbf * R2346 * 560ULL;
    Utils::DoDiv(&CTIA_fF, 3500000UL);

    uint8_t reg1DB;

    if(bw <= 3000000UL)
        reg1DB = 0xE0;
    else if(bw <= 10000000UL)
        reg1DB = 0x60;
    else
        reg1DB = 0x20;

    uint8_t reg1DC;
    uint8_t reg1DE;
    uint8_t reg1DD;
    uint8_t reg1DF;

    if(CTIA_fF > 2920ULL)
    {
        reg1DC = 0x40;
        reg1DE = 0x40;
        uint8_t temp = MIN(127U, DIV_ROUND((uint32_t)CTIA_fF - 400, 320U));
        reg1DD = temp;
        reg1DF = temp;
    }
    else
    {
        uint8_t temp = DIV_ROUND((uint32_t)CTIA_fF - 400, 40U) + 0x40;
        reg1DC = temp;
        reg1DE = temp;
        reg1DD = 0;
        reg1DF = 0;
    }

    this->writeReg(REG_RX_TIA_CONFIG, reg1DB);
    this->writeReg(REG_TIA1_C_LSB, reg1DC);
    this->writeReg(REG_TIA1_C_MSB, reg1DD);
    this->writeReg(REG_TIA2_C_LSB, reg1DE);
    this->writeReg(REG_TIA2_C_MSB, reg1DF);
}
void AD9361::calibrateTXBasebandAnalogFilter(uint32_t bw)
{
    bw = CLAMP(bw, 625000UL, 20000000UL);

    // 1.6 * BBBW * 2PI / ln(2)
    uint32_t target = 145036 * (bw / 10000UL);
    uint32_t txbbf_div = MIN_T(uint32_t, 511UL, DIV_CEIL(this->getClockRate(this->ref_clk_scale[BBPLL_CLK]), target));

    // Set TX baseband filter divide value
    this->writeReg(REG_TX_BBF_TUNE_DIVIDER, txbbf_div);
    this->writeRegField(REG_TX_BBF_TUNE_MODE, TX_BBF_TUNE_DIVIDER, txbbf_div >> 8);

    // Enable the TX baseband filter tune circuit by setting 0x0CA=0x22.
    this->writeReg(REG_TX_TUNE_CTRL, TUNER_RESAMPLE | TUNE_CTRL(1));

    // Start the TX Baseband Filter calibration in register 0x016[6]
    // Calibration is complete when register 0x016[] self clears
    this->runCalibration(TX_BB_TUNE_CAL);

    // Disable the TX baseband filter tune circuit by writing 0x0CA=0x26.
    this->writeReg(REG_TX_TUNE_CTRL, TUNER_RESAMPLE | TUNE_CTRL(1) | PD_TUNE);
}
void AD9361::calibrateTXSecBasebandAnalogFilter(uint32_t bw)
{
    bw = CLAMP(bw, 530000UL, 20000000UL);

    // BBBW * 5PI
    uint32_t corner = 15708 * (bw / 10000UL);
    uint32_t res = 1;
    uint32_t div;
    uint64_t cap;

    for(uint8_t i = 0; i < 4; i++)
    {
        div = corner * res;
        cap = (500000000ULL) + (div >> 1);
        Utils::DoDiv(&cap, div);
        cap -= 12ULL;

        if(cap < 64ULL)
            break;

        res <<= 1;
    }

    if(cap > 63ULL)
        cap = 63ULL;

    uint8_t reg_conf;

    if(bw <= 4500000UL)
        reg_conf = 0x59;
    else if(bw <= 12000000UL)
        reg_conf = 0x56;
    else
        reg_conf = 0x57;

    uint8_t reg_res;

    switch(res)
    {
        case 1:
            reg_res = 0x0C;
        break;
        case 2:
            reg_res = 0x04;
        break;
        case 4:
            reg_res = 0x03;
        break;
        case 8:
            reg_res = 0x01;
        break;
        default:
            reg_res = 0x01;
        break;
    }

    this->writeReg(REG_CONFIG0, reg_conf);
    this->writeReg(REG_RESISTOR, reg_res);
    this->writeReg(REG_CAPACITOR, (uint8_t)cap);
}
void AD9361::calibrateBasebandDCOffset()
{
    this->writeReg(REG_BB_DC_OFFSET_COUNT, 0x3F);
    this->writeReg(REG_BB_DC_OFFSET_SHIFT, BB_DC_M_SHIFT(0xF));
    this->writeReg(REG_BB_DC_OFFSET_ATTEN, BB_DC_OFFSET_ATTEN(1));

    this->runCalibration(BBDC_CAL);
}
void AD9361::calibrateRFDCOffset()
{
    this->writeReg(REG_WAIT_COUNT, 0x20);

    if(this->getClockRate(this->ref_clk_scale[RX_RFPLL]) <= 4000000000ULL)
    {
        this->writeReg(REG_RF_DC_OFFSET_COUNT, this->pdata->rf_dc_offset_count_low);
        this->writeReg(REG_RF_DC_OFFSET_CONFIG_1, RF_DC_CALIBRATION_COUNT(4) | DAC_FS(2));
        this->writeReg(REG_RF_DC_OFFSET_ATTEN, RF_DC_OFFSET_ATTEN(this->pdata->dc_offset_attenuation_low));
    }
    else
    {
        this->writeReg(REG_RF_DC_OFFSET_COUNT, this->pdata->rf_dc_offset_count_high);
        this->writeReg(REG_RF_DC_OFFSET_CONFIG_1, RF_DC_CALIBRATION_COUNT(4) | DAC_FS(3));
        this->writeReg(REG_RF_DC_OFFSET_ATTEN, RF_DC_OFFSET_ATTEN(this->pdata->dc_offset_attenuation_high));
    }

    this->writeReg(REG_DC_OFFSET_CONFIG2, USE_WAIT_COUNTER_FOR_RF_DC_INIT_CAL | DC_OFFSET_UPDATE(3));

    if(this->pdata->rx1rx2_phase_inversion_en || (this->pdata->port_ctrl.pp_conf[1] & INVERT_RX2))
        this->writeReg(REG_INVERT_BITS, INVERT_RX1_RF_DC_CGOUT_WORD);
    else
        this->writeReg(REG_INVERT_BITS, INVERT_RX1_RF_DC_CGOUT_WORD | INVERT_RX2_RF_DC_CGOUT_WORD);

    this->runCalibration(RFDC_CAL);
}
void AD9361::calibrateTXQuadrature(int32_t rx_phase)
{
    if(this->cached_synth_pd[0] & TX_LO_POWER_DOWN)
    {
        if(this->pdata->lo_powerdown_managed_en)
            this->writeRegField(REG_TX_SYNTH_POWER_DOWN_OVERRIDE, TX_LO_POWER_DOWN, 0);
        else
            throw std::runtime_error("AD9361: Tx QUAD Cal abort due to TX LO in powerdown");
    }

    /*
    * Find NCO frequency that matches this equation:
    * BW / 4 = Rx NCO freq = Tx NCO freq:
    * Rx NCO = ClkRF * (rxNCO <1:0> + 1) / 32
    * Tx NCO = ClkTF * (txNCO <1:0> + 1) / 32
    */
    uint32_t clkrf = this->getClockRate(this->ref_clk_scale[CLKRF_CLK]);
    uint32_t clktf = this->getClockRate(this->ref_clk_scale[CLKTF_CLK]);

    int32_t txnco_word = DIV_ROUND((this->current_tx_bw_Hz / 2) * 8, clktf) - 1;
    txnco_word = CLAMP_T(int, txnco_word, 0, 3);
    int32_t rxnco_word = txnco_word;

    uint8_t decim;

    if(clktf <= 4000000UL)
        decim = 2;
    else
        decim = 3;

    uint8_t __rx_phase = 0;

    if(clkrf == (2 * clktf))
    {
        __rx_phase = 0x0E;

        switch(txnco_word)
        {
            case 0:
                txnco_word++;
            break;
            case 1:
                rxnco_word--;
            break;
            case 2:
                rxnco_word -= 2;
                txnco_word--;
            break;
            case 3:
                rxnco_word -= 2;    // REVISIT
                __rx_phase = 0x08;
            break;
        }
    }
    else if(clkrf == clktf)
    {
        switch(txnco_word)
        {
            case 0:
            case 3:
                __rx_phase = 0x15;
            break;
            case 2:
                __rx_phase = 0x1F;
            break;
            case 1:
                if(this->readRegField(REG_TX_ENABLE_FILTER_CTRL, 0x3F) == 0x22)
                    __rx_phase = 0x15;     // REVISIT
                else
                    __rx_phase = 0x1A;
            break;
        }
    }

    if(rx_phase >= 0)
        __rx_phase = rx_phase;

    int32_t txnco_freq = clktf * (txnco_word + 1) / 32;

    if(txnco_freq > (int32_t)((this->current_rx_bw_Hz / 2) / 4) || txnco_freq > (int32_t)((this->current_tx_bw_Hz / 2) / 4))
    {
        try
        {
            this->__setRFBandwidth(txnco_freq * 8, txnco_freq * 8);
        }
        catch (const std::exception& e)
        {
            if(this->pdata->lo_powerdown_managed_en && (this->cached_synth_pd[0] & TX_LO_POWER_DOWN))
                this->controlLOPowerDown(LO_DONTCARE, LO_DONTCARE);

            throw e;
        }
    }

    bool phase_inversion_en = this->pdata->rx1rx2_phase_inversion_en || (this->pdata->port_ctrl.pp_conf[1] & INVERT_RX2);
    uint8_t reg_inv_bits = 0;

    if(phase_inversion_en)
    {
        this->writeRegField(REG_PARALLEL_PORT_CONF_2, INVERT_RX2, 0);

        reg_inv_bits = this->readReg(REG_INVERT_BITS);

        this->writeReg(REG_INVERT_BITS, INVERT_RX1_RF_DC_CGOUT_WORD | INVERT_RX2_RF_DC_CGOUT_WORD);
    }

    this->writeRegField(REG_KEXP_2, TX_NCO_FREQ(~0), txnco_word);
    this->writeReg(REG_QUAD_CAL_COUNT, 0xFF);
    this->writeReg(REG_KEXP_1, KEXP_TX(1) | KEXP_TX_COMP(3) | KEXP_DC_I(3) | KEXP_DC_Q(3));
    this->writeReg(REG_MAG_FTEST_THRESH, 0x03);
    this->writeReg(REG_MAG_FTEST_THRESH_2, 0x03);

    if(this->tx_quad_lpf_tia_match >= 0)
        this->writeReg(REG_TX_QUAD_FULL_LMT_GAIN, this->tx_quad_lpf_tia_match);

    this->writeReg(REG_QUAD_SETTLE_COUNT, 0xF0);
    this->writeReg(REG_TX_QUAD_LPF_GAIN, 0x00);

    uint8_t val = 0;

    if(rx_phase != -2)
    {
        this->__calibrateTXQuadrature(__rx_phase, rxnco_word, decim, &val);

        // Calibration failed -> try last phase offset
        if(val != (TX1_LO_CONV | TX1_SSB_CONV))
        {
            if(this->last_tx_quad_cal_phase < 31)
                this->__calibrateTXQuadrature(this->last_tx_quad_cal_phase, rxnco_word, decim, &val);
        }
        else
        {
            this->last_tx_quad_cal_phase = __rx_phase;
        }
    }

    // Calibration failed -> loop through all 32 phase offsets
    if(val != (TX1_LO_CONV | TX1_SSB_CONV))
        this->searchTXQuadraturePhase(rxnco_word, decim);

    if(phase_inversion_en)
    {
        this->writeRegField(REG_PARALLEL_PORT_CONF_2, INVERT_RX2, 1);
        this->writeReg(REG_INVERT_BITS, reg_inv_bits);
    }

    if(txnco_freq > (int32_t)((this->current_rx_bw_Hz / 2) / 4) || txnco_freq > (int32_t)((this->current_tx_bw_Hz / 2) / 4))
        this->__setRFBandwidth(this->current_rx_bw_Hz, this->current_tx_bw_Hz);
}
void AD9361::__calibrateTXQuadrature(uint32_t phase, uint32_t rxnco_word, uint32_t decim, uint8_t *res)
{
    this->writeReg(REG_QUAD_CAL_NCO_FREQ_PHASE_OFFSET, RX_NCO_FREQ(rxnco_word) | RX_NCO_PHASE_OFFSET(phase));
    this->writeReg(REG_QUAD_CAL_CTRL, SETTLE_MAIN_ENABLE | DC_OFFSET_ENABLE | QUAD_CAL_SOFT_RESET | GAIN_ENABLE | PHASE_ENABLE | M_DECIM(decim));
    this->writeReg(REG_QUAD_CAL_CTRL, SETTLE_MAIN_ENABLE | DC_OFFSET_ENABLE | GAIN_ENABLE | PHASE_ENABLE | M_DECIM(decim));

    this->runCalibration(TX_QUAD_CAL);

    if(res != nullptr)
    {
        *res = this->readReg((this->pdata->rx1tx1_mode_use_tx_num == 2) ? REG_QUAD_CAL_STATUS_TX2 : REG_QUAD_CAL_STATUS_TX1) & (TX1_LO_CONV | TX1_SSB_CONV);

        if(this->pdata->rx2tx2)
            *res &= this->readReg(REG_QUAD_CAL_STATUS_TX2) & (TX2_LO_CONV | TX2_SSB_CONV);
    }
}
void AD9361::searchTXQuadraturePhase(uint32_t rxnco_word, uint8_t decim)
{
    uint8_t field[64], val;
    uint32_t start, cnt;

    for(uint32_t i = 0; i < ARRAY_SIZE(field) / 2; i++)
    {
        this->__calibrateTXQuadrature(i, rxnco_word, decim, &val);

        // Handle 360/0 wrap around
        field[i] = field[i + 32] = !((val & TX1_LO_CONV) && (val & TX1_SSB_CONV));
    }

    cnt = this->findOpt(field, ARRAY_SIZE(field), &start);

    this->last_tx_quad_cal_phase = (start + cnt / 2) & 0x1F;

    this->__calibrateTXQuadrature(this->last_tx_quad_cal_phase, rxnco_word, decim, NULL);
}

void AD9361::controlVCOCalibration(bool tx, bool enable)
{
    return this->writeRegField(tx ? REG_TX_PFD_CONFIG : REG_RX_PFD_CONFIG, BYPASS_LD_SYNTH, !enable);
}

void AD9361::controlExternalLO(bool tx, bool enable)
{
    uint8_t val = enable ? ~0 : 0;

    bool mcs_rf_enable = this->readRegField(REG_MULTICHIP_SYNC_AND_TX_MON_CTRL, MCS_RF_ENABLE);

    if(tx)
    {
        this->writeRegField(REG_ENSM_CONFIG_2, POWER_DOWN_TX_SYNTH, mcs_rf_enable ? 0 : enable);
        this->writeRegField(REG_ENSM_CONFIG_2, TX_SYNTH_READY_MASK, enable);
        this->writeRegField(REG_RFPLL_DIVIDERS, TX_VCO_DIVIDER(~0), enable ? 7 : this->cached_tx_rfpll_div);

        if(enable)
            this->cached_synth_pd[0] |= TX_SYNTH_VCO_ALC_POWER_DOWN | TX_SYNTH_PTAT_POWER_DOWN | TX_SYNTH_VCO_POWER_DOWN;
        else
            this->cached_synth_pd[0] &= ~(TX_SYNTH_VCO_ALC_POWER_DOWN | TX_SYNTH_PTAT_POWER_DOWN | TX_SYNTH_VCO_POWER_DOWN);

        this->writeReg(REG_TX_SYNTH_POWER_DOWN_OVERRIDE, this->cached_synth_pd[0]);
        this->writeRegField(REG_ANALOG_POWER_DOWN_OVERRIDE, TX_EXT_VCO_BUFFER_POWER_DOWN, !enable);
        this->writeReg(REG_TX_LO_GEN_POWER_MODE, TX_LO_GEN_POWER_MODE(val));
    }
    else
    {
        this->writeRegField(REG_ENSM_CONFIG_2, POWER_DOWN_RX_SYNTH, mcs_rf_enable ? 0 : enable);
        this->writeRegField(REG_ENSM_CONFIG_2, RX_SYNTH_READY_MASK, enable);
        this->writeRegField(REG_RFPLL_DIVIDERS, RX_VCO_DIVIDER(~0), enable ? 7 : this->cached_rx_rfpll_div);

        if(enable)
            this->cached_synth_pd[1] |= RX_SYNTH_VCO_ALC_POWER_DOWN | RX_SYNTH_PTAT_POWER_DOWN | RX_SYNTH_VCO_POWER_DOWN;
        else
            this->cached_synth_pd[1] &= ~(TX_SYNTH_VCO_ALC_POWER_DOWN | RX_SYNTH_PTAT_POWER_DOWN | RX_SYNTH_VCO_POWER_DOWN);

        this->writeReg(REG_RX_SYNTH_POWER_DOWN_OVERRIDE, this->cached_synth_pd[1]);
        this->writeRegField(REG_ANALOG_POWER_DOWN_OVERRIDE, RX_EXT_VCO_BUFFER_POWER_DOWN, !enable);
        this->writeReg(REG_RX_LO_GEN_POWER_MODE, RX_LO_GEN_POWER_MODE(val));
    }
}

void AD9361::controlLOPowerDown(AD9361::SynthPDControl rx, AD9361::SynthPDControl tx)
{
    switch(rx)
    {
        case LO_OFF:
            this->cached_synth_pd[1] |= RX_LO_POWER_DOWN;
        break;
        case LO_ON:
            this->cached_synth_pd[1] &= ~RX_LO_POWER_DOWN;
        break;
        case LO_DONTCARE:
        break;
    }

    switch(tx)
    {
        case LO_OFF:
            this->cached_synth_pd[0] |= TX_LO_POWER_DOWN;
        break;
        case LO_ON:
            this->cached_synth_pd[0] &= ~TX_LO_POWER_DOWN;
        break;
        case LO_DONTCARE:
        break;
    }

    this->writeReg(REG_TX_SYNTH_POWER_DOWN_OVERRIDE, this->cached_synth_pd, 2);
}

void AD9361::controlRXTracking(bool bbdc, bool rfdc, bool quad)
{
    this->writeReg(REG_CALIBRATION_CONFIG_2, CALIBRATION_CONFIG2_DFLT | K_EXP_PHASE(0x15));
    this->writeReg(REG_CALIBRATION_CONFIG_3, PREVENT_POS_LOOP_GAIN | K_EXP_AMPLITUDE(0x15));

    this->writeReg(REG_DC_OFFSET_CONFIG2, USE_WAIT_COUNTER_FOR_RF_DC_INIT_CAL | DC_OFFSET_UPDATE(this->pdata->dc_offset_update_events) | (bbdc ? ENABLE_BB_DC_OFFSET_TRACKING : 0) | (rfdc ? ENABLE_RF_OFFSET_TRACKING : 0));

    this->writeRegField(REG_RX_QUAD_GAIN2, CORRECTION_WORD_DECIMATION_M(~0), this->pdata->qec_tracking_slow_mode_en ? 4 : 0);

    uint8_t qtrack = 0;

    if(quad)
    {
        if(this->pdata->rx2tx2)
            qtrack = ENABLE_TRACKING_MODE_CH1 | ENABLE_TRACKING_MODE_CH2;
        else
            qtrack = (this->pdata->rx1tx1_mode_use_rx_num == 1) ? ENABLE_TRACKING_MODE_CH1 : ENABLE_TRACKING_MODE_CH2;
    }

    this->writeReg(REG_CALIBRATION_CONFIG_1, ENABLE_PHASE_CORR | ENABLE_GAIN_CORR | FREE_RUN_MODE | ENABLE_CORR_WORD_DECIMATION | qtrack);
}

void AD9361::loadMixerGMSubTable()
{
    this->writeReg(REG_GM_SUB_TABLE_CONFIG, START_GM_SUB_TABLE_CLOCK); // Start Clock

    for(uint32_t i = 0, addr = ARRAY_SIZE(gm_st_ctrl); i < ARRAY_SIZE(gm_st_ctrl); i++)
    {
        this->writeReg(REG_GM_SUB_TABLE_ADDRESS, --addr); // Gain Table Index
        this->writeReg(REG_GM_SUB_TABLE_BIAS_WRITE, 0); // Bias
        this->writeReg(REG_GM_SUB_TABLE_GAIN_WRITE, gm_st_gain[i]); // Gain
        this->writeReg(REG_GM_SUB_TABLE_CTRL_WRITE, gm_st_ctrl[i]); // Control
        this->writeReg(REG_GM_SUB_TABLE_CONFIG, WRITE_GM_SUB_TABLE | START_GM_SUB_TABLE_CLOCK); // Write Words
        this->writeReg(REG_GM_SUB_TABLE_GAIN_READ, 0); // Dummy Delay
        this->writeReg(REG_GM_SUB_TABLE_GAIN_READ, 0); // Dummy Delay
    }

    this->writeReg(REG_GM_SUB_TABLE_CONFIG, START_GM_SUB_TABLE_CLOCK); // Clear Write
    this->writeReg(REG_GM_SUB_TABLE_GAIN_READ, 0); // Dummy Delay
    this->writeReg(REG_GM_SUB_TABLE_GAIN_READ, 0); // Dummy Delay
    this->writeReg(REG_GM_SUB_TABLE_CONFIG, 0); // Stop Clock
}

void AD9361::setRFBandwidth(uint32_t rx_bw, uint32_t tx_bw)
{
    this->controlRXTracking(false, false, false);

    this->forceENSMState(ENSM_STATE_ALERT);

    this->__setRFBandwidth(rx_bw, tx_bw);

    this->current_rx_bw_Hz = rx_bw;
    this->current_tx_bw_Hz = tx_bw;

    if(this->manual_tx_quad_cal_en == false)
        this->calibrateTXQuadrature(-1);

    this->controlRXTracking(this->bbdc_track_en, this->rfdc_track_en, this->quad_track_en);

    this->restorePrevENSMState();
}
void AD9361::__setRFBandwidth(uint32_t rx_bw, uint32_t tx_bw)
{
    this->calibrateRXBasebandAnalogFilter(rx_bw / 2);
    this->calibrateTXBasebandAnalogFilter(tx_bw / 2);
    this->calibrateRXTIA(rx_bw / 2);
    this->calibrateTXSecBasebandAnalogFilter(tx_bw / 2);
    this->setupRXADC();
}

void AD9361::setTXAttenuation(uint32_t atten_mdb, bool tx1, bool tx2, bool immed)
{
    uint8_t buf[2];

    if(atten_mdb > MAX_TX_ATTENUATION_DB) // 89.75 dB
        throw std::invalid_argument("AD9361: TX attenuation out of range");

    atten_mdb /= 250; // Scale to 0.25dB / LSB

    buf[0] = atten_mdb >> 8;
    buf[1] = atten_mdb & 0xFF;

    this->writeRegField(REG_TX2_DIG_ATTEN, IMMEDIATELY_UPDATE_TPC_ATTEN, 0);

    if(tx1)
        this->writeReg(REG_TX1_ATTEN_1, buf, 2);

    if(tx2)
        this->writeReg(REG_TX2_ATTEN_1, buf, 2);

    if(immed)
        this->writeRegField(REG_TX2_DIG_ATTEN, IMMEDIATELY_UPDATE_TPC_ATTEN, 1);
}
uint32_t AD9361::getTXAttenuation(uint32_t tx_num)
{
    uint8_t buf[2];
    uint32_t code;

    this->readReg((tx_num == 1) ? REG_TX1_ATTEN_1 : REG_TX2_ATTEN_1, buf, 2);

    code = (buf[0] << 8) | buf[1];
    code *= 250;

    return code;
}
void AD9361::muteTX(bool mute)
{
    if(mute)
    {
        this->tx1_atten_cached = this->getTXAttenuation(1);
        this->tx2_atten_cached = this->getTXAttenuation(2);

        this->setTXAttenuation(MAX_TX_ATTENUATION_DB, true, true, true);

        return;
    }

    if(this->tx1_atten_cached == this->tx2_atten_cached)
    {
        this->setTXAttenuation(this->tx1_atten_cached, true, true, true);

        return;
    }

    this->setTXAttenuation(this->tx1_atten_cached, true, false, true);
    this->setTXAttenuation(this->tx2_atten_cached, false, true, true);
}

void AD9361::setENSMMode(bool fdd, bool pinctrl)
{
    this->writeReg(REG_ENSM_MODE, fdd ? FDD_MODE : 0);

    uint8_t val = this->readReg(REG_ENSM_CONFIG_2);
    val &= POWER_DOWN_RX_SYNTH | POWER_DOWN_TX_SYNTH | RX_SYNTH_READY_MASK | TX_SYNTH_READY_MASK;

    if(fdd)
        this->writeReg(REG_ENSM_CONFIG_2, val | DUAL_SYNTH_MODE | (this->pdata->fdd_independent_mode ? FDD_EXTERNAL_CTRL_ENABLE : 0));
    else
        this->writeReg(REG_ENSM_CONFIG_2, val | (this->pdata->tdd_use_dual_synth ? DUAL_SYNTH_MODE : 0) | (this->pdata->tdd_use_dual_synth ? 0 : (pinctrl ? SYNTH_ENABLE_PIN_CTRL_MODE : 0)));
}
void AD9361::setENSMState(uint8_t state, bool pinctrl)
{
    if(this->curr_ensm_state == ENSM_STATE_SLEEP)
    {
        this->writeReg(REG_CLOCK_ENABLE, DIGITAL_POWER_UP | CLOCK_ENABLE_DFLT | BBPLL_ENABLE | (this->pdata->use_extclk ? XO_BYPASS : 0)); // Enable Clocks

        usleep(20);

        this->writeReg(REG_ENSM_CONFIG_1, TO_ALERT | FORCE_ALERT_STATE);
        this->controlVCOCalibration(false, true); // Enable VCO Cal
        this->controlVCOCalibration(true, true);
    }

    uint8_t val = (this->pdata->ensm_pin_pulse_mode ? 0 : LEVEL_MODE) | (pinctrl ? ENABLE_ENSM_PIN_CTRL : 0) | (this->txmon_tdd_en ? ENABLE_RX_DATA_PORT_FOR_CAL : 0) | TO_ALERT;
    std::string e = "";

    switch(state)
    {
        case ENSM_STATE_TX:
            val |= FORCE_TX_ON;

            if(this->pdata->fdd)
                e = "Cannot set ENSM to TX state while in FDD mode";
            else if(this->curr_ensm_state != ENSM_STATE_ALERT)
                e = "Cannot set ENSM to TX state while not in ALERT state";
        break;
        case ENSM_STATE_RX:
            val |= FORCE_RX_ON;

            if(this->pdata->fdd)
                e = "Cannot set ENSM to RX state while in FDD mode";
            else if(this->curr_ensm_state != ENSM_STATE_ALERT)
                e = "Cannot set ENSM to RX state while not in ALERT state";
        break;
        case ENSM_STATE_FDD:
            val |= FORCE_TX_ON;

            if(!this->pdata->fdd)
                e = "Cannot set ENSM to FDD state while not in FDD mode";
        break;
        case ENSM_STATE_ALERT:
            val &= ~(FORCE_TX_ON | FORCE_RX_ON);
            val |= TO_ALERT | FORCE_ALERT_STATE;
        break;
        case ENSM_STATE_SLEEP_WAIT:
        break;
        case ENSM_STATE_SLEEP:
            this->controlVCOCalibration(false, false); // Disable VCO Cal
            this->controlVCOCalibration(true, false);
            this->writeReg(REG_ENSM_CONFIG_1, 0); // Clear To Alert
            this->writeReg(REG_ENSM_CONFIG_1, this->pdata->fdd ? FORCE_TX_ON : FORCE_RX_ON);
            // Delay Flush Time 384 ADC clock cycles

            usleep(384000000UL / this->getClockRate(this->ref_clk_scale[ADC_CLK]));

            this->writeReg(REG_ENSM_CONFIG_1, 0); /* Move to Wait*/

            usleep(1); // Wait for ENSM settle

            this->writeReg(REG_CLOCK_ENABLE, (this->pdata->use_extclk ? XO_BYPASS : 0)); // Turn off all clocks

            this->curr_ensm_state = state;

            return;
        break;
        default:
            throw std::invalid_argument("AD9361: Invalid ENSM state");
        break;
    }

    if(e.length() > 0)
    {
        if((this->curr_ensm_state != ENSM_STATE_ALERT) && (val & (FORCE_RX_ON | FORCE_TX_ON)))
        {
            uint8_t val2 = val;

            val2 &= ~(FORCE_TX_ON | FORCE_RX_ON);
            val2 |= TO_ALERT | FORCE_ALERT_STATE;

            this->writeReg(REG_ENSM_CONFIG_1, val2);

            this->checkCalibrationDone(REG_STATE, ENSM_STATE(~0), ENSM_STATE_ALERT);
        }
        else
        {
            throw std::runtime_error("AD9361: Invalid ENSM state transition in " + std::string(this->pdata->fdd ? "FDD" : "TDD") + " mode: " + e);
        }
    }

    if(!this->pdata->fdd && !pinctrl && !this->pdata->tdd_use_dual_synth && (state == ENSM_STATE_TX || state == ENSM_STATE_RX))
    {
        uint16_t reg;
        uint8_t check;

        if(state == ENSM_STATE_TX)
        {
            reg = REG_TX_CP_OVERRANGE_VCO_LOCK;
            check = !(this->cached_synth_pd[0] & TX_SYNTH_VCO_POWER_DOWN);
        }
        else
        {
            reg = REG_RX_CP_OVERRANGE_VCO_LOCK;
            check = !(this->cached_synth_pd[1] & RX_SYNTH_VCO_POWER_DOWN);
        }

        this->writeRegField(REG_ENSM_CONFIG_2, TXNRX_SPI_CTRL, state == ENSM_STATE_TX);

        if(check)
            this->checkCalibrationDone(reg, VCO_LOCK, 1);
    }

    this->writeReg(REG_ENSM_CONFIG_1, val);

    if((val & FORCE_RX_ON) && (this->agc_mode[0] == RF_GAIN_MGC || this->agc_mode[1] == RF_GAIN_MGC))
    {
        uint8_t tmp = this->readReg(REG_SMALL_LMT_OVERLOAD_THRESH);

        this->writeReg(REG_SMALL_LMT_OVERLOAD_THRESH, (tmp & SMALL_LMT_OVERLOAD_THRESH(~0)) | (this->agc_mode[0] == RF_GAIN_MGC ? FORCE_PD_RESET_RX1 : 0) | (this->agc_mode[1] == RF_GAIN_MGC ? FORCE_PD_RESET_RX2 : 0));
        this->writeReg(REG_SMALL_LMT_OVERLOAD_THRESH, tmp & SMALL_LMT_OVERLOAD_THRESH(~0));
    }

    this->curr_ensm_state = state;
}
uint8_t AD9361::getENSMState()
{
    return this->readRegField(REG_STATE, ENSM_STATE(~0));
}
void AD9361::forceENSMState(uint8_t state)
{
    uint8_t dev_ensm_state = this->getENSMState();

    this->prev_ensm_state = dev_ensm_state;

    if(dev_ensm_state == state)
        return;

    uint8_t val = this->readReg(REG_ENSM_CONFIG_1);

    if(val & ENABLE_ENSM_PIN_CTRL)
    {
        val &= ~ENABLE_ENSM_PIN_CTRL;

        this->ensm_pin_ctl_en = true;
    }
    else
    {
        this->ensm_pin_ctl_en = false;
    }

    if(dev_ensm_state)
        val &= ~(TO_ALERT);

    switch(state)
    {
        case ENSM_STATE_TX:
        case ENSM_STATE_FDD:
            val |= FORCE_TX_ON;
        break;
        case ENSM_STATE_RX:
            val |= FORCE_RX_ON;
        break;
        case ENSM_STATE_ALERT:
            val &= ~(FORCE_TX_ON | FORCE_RX_ON);
            val |= TO_ALERT | FORCE_ALERT_STATE;
        break;
        default:
            return;
        break;
    }

    this->writeReg(REG_ENSM_CONFIG_1, TO_ALERT | FORCE_ALERT_STATE);
    this->writeReg(REG_ENSM_CONFIG_1, val);

    uint32_t timeout = 10;

    while(this->getENSMState() != state && --timeout)
        usleep(1000);
}
void AD9361::restoreENSMState(uint8_t state)
{
    uint8_t val = this->readReg(REG_ENSM_CONFIG_1);

    /* We are restoring state only, so clear State bits first
    * which might have set while forcing a particular state
    */
    val &= ~(FORCE_TX_ON | FORCE_RX_ON | FORCE_ALERT_STATE);
    val |= TO_ALERT;

    switch(state)
    {
        case ENSM_STATE_TX:
        case ENSM_STATE_FDD:
            val |= FORCE_TX_ON;
        break;
        case ENSM_STATE_RX:
            val |= FORCE_RX_ON;
        break;
        case ENSM_STATE_ALERT:
            val |= TO_ALERT;
        break;
        default:
            return;
        break;
    }

    this->writeReg(REG_ENSM_CONFIG_1, TO_ALERT | FORCE_ALERT_STATE);
    this->writeReg(REG_ENSM_CONFIG_1, val);

    if(this->ensm_pin_ctl_en)
    {
        val |= ENABLE_ENSM_PIN_CTRL;

        this->writeReg(REG_ENSM_CONFIG_1, val);
    }
}

void AD9361::loadGainTable(uint64_t freq, uint8_t dest)
{
    uint8_t band = this->findGainTableInfex(freq);

    // check if table is present
    if(this->current_table == band)
        return;

    uint8_t(* tab)[3] = this->gt_info[band].tab;
    uint8_t index_max = this->gt_info[band].max_index;

    this->writeRegField(REG_AGC_CONFIG_2, AGC_USE_FULL_GAIN_TABLE, !this->pdata->split_gt);

    this->writeReg(REG_MAX_LMT_FULL_GAIN, index_max - 1); // Max Full/LMT Gain Table Index

    int8_t rx1_gain;
    int8_t rx2_gain;

    uint8_t set_gain = this->readRegField(REG_RX1_MANUAL_LMT_FULL_GAIN, RX_FULL_TBL_IDX_MASK);

    if(this->current_table != (uint32_t)-1)
    {
        rx1_gain = this->gt_info[this->current_table].abs_gain_tbl[set_gain];
    }
    else
    {
        if(set_gain > (index_max - 1))
            set_gain = index_max - 1;

        rx1_gain = this->gt_info[band].abs_gain_tbl[set_gain];
    }

    set_gain = this->readRegField(REG_RX2_MANUAL_LMT_FULL_GAIN, RX_FULL_TBL_IDX_MASK);

    if(this->current_table != (uint32_t)-1)
    {
        rx2_gain = this->gt_info[this->current_table].abs_gain_tbl[set_gain];
    }
    else
    {
        if(set_gain > (index_max - 1))
            set_gain = index_max - 1;

        rx2_gain = this->gt_info[band].abs_gain_tbl[set_gain];
    }

    uint8_t lna = this->pdata->elna_ctrl.elna_in_gaintable_all_index_en ? EXT_LNA_CTRL : 0;

    this->writeReg(REG_GAIN_TABLE_CONFIG, START_GAIN_TABLE_CLOCK | RECEIVER_SELECT(dest)); // Start Gain Table Clock

    uint8_t lpf_tia_mask;

    // TX QUAD Calibration
    if(this->pdata->split_gt)
        lpf_tia_mask = 0x20;
    else
        lpf_tia_mask = 0x3F;

    this->tx_quad_lpf_tia_match = -1;

    for(uint8_t i = 0; i < index_max; i++)
    {
        this->writeReg(REG_GAIN_TABLE_ADDRESS, i); // Gain Table Index
        this->writeReg(REG_GAIN_TABLE_WRITE_DATA1, tab[i][0] | lna); // Ext LNA, Int LNA, & Mixer Gain Word
        this->writeReg(REG_GAIN_TABLE_WRITE_DATA2, tab[i][1]); // TIA & LPF Word
        this->writeReg(REG_GAIN_TABLE_WRITE_DATA3, tab[i][2]); // DC Cal bit & Dig Gain Word
        this->writeReg(REG_GAIN_TABLE_CONFIG, START_GAIN_TABLE_CLOCK | WRITE_GAIN_TABLE | RECEIVER_SELECT(dest)); // Gain Table Index
        this->writeReg(REG_GAIN_TABLE_READ_DATA1, 0); // Dummy Write to delay 3 ADCCLK/16 cycles
        this->writeReg(REG_GAIN_TABLE_READ_DATA1, 0); // Dummy Write to delay ~1u

        if((tab[i][1] & lpf_tia_mask) == 0x20)
            this->tx_quad_lpf_tia_match = i;
    }

    this->writeReg(REG_GAIN_TABLE_CONFIG, START_GAIN_TABLE_CLOCK | RECEIVER_SELECT(dest)); // Clear Write Bit
    this->writeReg(REG_GAIN_TABLE_READ_DATA1, 0); // Dummy Write to delay ~1u
    this->writeReg(REG_GAIN_TABLE_READ_DATA1, 0); // Dummy Write to delay ~1u
    this->writeReg(REG_GAIN_TABLE_CONFIG, 0); // Stop Gain Table Clock

    this->current_table = band;

    try
    {
        set_gain = this->findGainIndex(rx1_gain);
    }
    catch (const std::exception& e)
    {
        set_gain = index_max - 1;
    }

    this->writeRegField(REG_RX1_MANUAL_LMT_FULL_GAIN, RX_FULL_TBL_IDX_MASK, set_gain); // Rx1 Full/LMT Gain Index

    try
    {
        set_gain = this->findGainIndex(rx2_gain);
    }
    catch (const std::exception& e)
    {
        set_gain = index_max - 1;
    }

    this->writeReg(REG_RX2_MANUAL_LMT_FULL_GAIN, set_gain); // Rx2 Full/LMT Gain Index
}
uint8_t AD9361::findGainTableInfex(uint64_t freq)
{
    for(uint8_t i = 0; this->gt_info[i].tab != NULL; i++)
        if((this->pdata->split_gt == this->gt_info[i].split_table) && (this->gt_info[i].start < freq) && (freq <= this->gt_info[i].end))
            return i;

    throw std::invalid_argument("AD9361: No gain table found for " + std::to_string(freq) + " Hz");
}
uint8_t AD9361::findGainIndex(int8_t gain)
{
    for(uint8_t i = 0; i < this->gt_info[this->getCurrentGainTable()].max_index; i++)
    {
        if(this->gt_info[this->getCurrentGainTable()].abs_gain_tbl[i] >= gain)
        {
            uint8_t nm1 = abs(this->gt_info[this->getCurrentGainTable()].abs_gain_tbl[(i > 0) ? i - 1 : i] - gain);
            uint8_t n = abs(this->gt_info[this->getCurrentGainTable()].abs_gain_tbl[i] - gain);

            if(nm1 < n)
                return (i > 0) ? i - 1 : i;
            else
                return i;
        }
    }

    throw std::invalid_argument("AD9361: No gain table index found for " + std::to_string(gain) + " dB");
}

void AD9361::getSplitTableGain(uint16_t idx_reg, AD9361::RFRXGain *rx_gain)
{
    if(rx_gain == nullptr)
        throw std::invalid_argument("AD9361: RX gain structure is null");

    rx_gain->fgt_lmt_index = this->readRegField(idx_reg, FULL_TABLE_GAIN_INDEX(~0));
    uint8_t tbl_addr = this->readReg(REG_GAIN_TABLE_ADDRESS);

    this->writeReg(REG_GAIN_TABLE_ADDRESS, rx_gain->fgt_lmt_index);

    uint8_t val = this->readReg(REG_GAIN_TABLE_READ_DATA1);
    rx_gain->lna_index = TO_LNA_GAIN(val);
    rx_gain->mixer_index = TO_MIXER_GM_GAIN(val);

    rx_gain->tia_index = this->readRegField(REG_GAIN_TABLE_READ_DATA2, TIA_GAIN);

    rx_gain->lmt_gain = lna_table[this->getCurrentGainTable() - AD9361::RXGainTableName::MAX][rx_gain->lna_index] + mixer_table[this->getCurrentGainTable() - AD9361::RXGainTableName::MAX][rx_gain->mixer_index] + tia_table[rx_gain->tia_index];

    this->writeReg(REG_GAIN_TABLE_ADDRESS, tbl_addr);

    // Read LPF Index
    rx_gain->lpf_gain = this->readRegField(idx_reg + 1, LPF_GAIN_RX(~0));

    // Read Digital Gain
    rx_gain->digital_gain = this->readRegField(idx_reg + 2, DIGITAL_GAIN_RX(~0));

    rx_gain->gain_db = rx_gain->lmt_gain + rx_gain->lpf_gain + rx_gain->digital_gain;
}
void AD9361::getFullTableGain(uint16_t idx_reg, AD9361::RFRXGain *rx_gain)
{
    if(rx_gain == nullptr)
        throw std::invalid_argument("AD9361: RX gain structure is null");

    uint8_t val = this->readRegField(idx_reg, FULL_TABLE_GAIN_INDEX(~0));

    rx_gain->fgt_lmt_index = val;
    // Read Digital Gain
    rx_gain->digital_gain = this->readRegField(idx_reg + 2, DIGITAL_GAIN_RX(~0));

    rx_gain->gain_db = this->gt_info[this->getCurrentGainTable()].abs_gain_tbl[val];
}
void AD9361::getRXGain(uint8_t rx_id, AD9361::RFRXGain *rx_gain)
{
    if(rx_gain == nullptr)
        throw std::invalid_argument("AD9361: RX gain structure is null");

    uint16_t idx_reg;
    uint8_t gain_ctl_shift;
    uint8_t rx_enable_mask;
    uint8_t fast_atk_shift;

    if(rx_id == 1)
    {
        idx_reg = REG_GAIN_RX1;
        gain_ctl_shift = RX1_GAIN_CTRL_SHIFT;
        rx_enable_mask = RX_CHANNEL_ENABLE(RX_1);
        fast_atk_shift = RX1_FAST_ATK_SHIFT;
    }
    else if(rx_id == 2)
    {
        idx_reg = REG_GAIN_RX2;
        gain_ctl_shift = RX2_GAIN_CTRL_SHIFT;
        rx_enable_mask = RX_CHANNEL_ENABLE(RX_2);
        fast_atk_shift = RX2_FAST_ATK_SHIFT;
    }
    else
    {
        throw std::invalid_argument("AD9361: Unknown RX path " + std::to_string(rx_id));
    }

    uint8_t val = this->readRegField(REG_RX_ENABLE_FILTER_CTRL, rx_enable_mask);

    if(!val)
        throw std::runtime_error("AD9361: RX" + std::to_string(rx_id) + " is not enabled");

    val = this->readReg(REG_AGC_CONFIG_1);
    val = (val >> gain_ctl_shift) & RX_GAIN_CTL_MASK;

    if(val == RX_GAIN_CTL_AGC_FAST_ATK)
    {
        /* In fast attack mode check whether Fast attack state machine
        * has locked gain, if not then we can not read gain.
        */
        val = this->readReg(REG_FAST_ATTACK_STATE);
        val = (val >> fast_atk_shift) & FAST_ATK_MASK;

        if(val != FAST_ATK_GAIN_LOCKED)
            throw std::runtime_error("AD9361: RX" + std::to_string(rx_id) + " gain is not locked, state m/c at " + std::to_string(val));
    }

    if(this->pdata->split_gt)
        this->getSplitTableGain(idx_reg, rx_gain);
    else
        this->getFullTableGain(idx_reg, rx_gain);
}
void AD9361::setSplitTableGain(uint16_t idx_reg, AD9361::RFRXGain *rx_gain)
{
    if(rx_gain == nullptr)
        throw std::invalid_argument("AD9361: RX gain structure is null");

    if(rx_gain->fgt_lmt_index > MAX_LMT_INDEX) // FIXME: Is this needed?
        throw std::invalid_argument("AD9361: LMT index out of range");

    if(rx_gain->lpf_gain > MAX_LPF_GAIN)
        throw std::invalid_argument("AD9361: LPF gain out of range");

    if(rx_gain->digital_gain > MAX_DIG_GAIN)
        throw std::invalid_argument("AD9361: Digital gain out of range");


    rx_gain->fgt_lmt_index = this->findGainIndex(rx_gain->gain_db);

    this->writeRegField(idx_reg, RX_FULL_TBL_IDX_MASK, rx_gain->fgt_lmt_index);
    this->writeRegField(idx_reg + 1, RX_LPF_IDX_MASK, rx_gain->lpf_gain);

    if(rx_gain->digital_gain > 0 && !this->pdata->gain_ctrl.dig_gain_en)
        throw std::invalid_argument("AD9361: Digital gain is disabled and cannot be set (" + std::to_string(rx_gain->digital_gain) + ")");

    this->writeRegField(idx_reg + 2, RX_DIGITAL_IDX_MASK, rx_gain->digital_gain);
}
void AD9361::setFullTableGain(uint16_t idx_reg, AD9361::RFRXGain *rx_gain)
{
    if(rx_gain == nullptr)
        throw std::invalid_argument("AD9361: RX gain structure is null");

    this->writeRegField(idx_reg, RX_FULL_TBL_IDX_MASK, this->findGainIndex(rx_gain->gain_db));
}
void AD9361::setRXGain(uint8_t rx_id, AD9361::RFRXGain *rx_gain)
{
    uint16_t idx_reg;
    uint8_t gain_ctl_shift;

    if(rx_id == 1)
    {
        idx_reg = REG_RX1_MANUAL_LMT_FULL_GAIN;
        gain_ctl_shift = RX1_GAIN_CTRL_SHIFT;
    }
    else if(rx_id == 2)
    {
        idx_reg = REG_RX2_MANUAL_LMT_FULL_GAIN;
        gain_ctl_shift = RX2_GAIN_CTRL_SHIFT;
    }
    else
    {
        throw std::invalid_argument("AD9361: Unknown RX path " + std::to_string(rx_id));
    }

    uint8_t val = this->readReg(REG_AGC_CONFIG_1);
    val = (val >> gain_ctl_shift) & RX_GAIN_CTL_MASK;

    if(val != RX_GAIN_CTL_MGC)
        throw std::runtime_error("AD9361: RX" + std::to_string(rx_id) + " is not in MGC mode");

    if(this->pdata->split_gt)
        this->setSplitTableGain(idx_reg, rx_gain);
    else
        this->setFullTableGain(idx_reg, rx_gain);
}

void AD9361::initRFPLLVCO(bool tx, uint64_t freq, uint32_t ref_freq)
{
    uint8_t range;

    if(ref_freq < 50000000UL)
        range = 0;
    else if(ref_freq <= 70000000UL)
        range = 1;
    else
        range = 2;

    Utils::DoDiv(&freq, 1000000UL); // vco_freq in MHz

    const AD9361::SynthLUT *tab;

    if((this->pdata->fdd && !this->pdata->fdd_independent_mode) && (this->current_tx_lo_freq != this->current_rx_lo_freq))
    {
        tab = &SynthLUT_FDD[range][0];

        if(tx)
            this->current_tx_use_tdd_table = false;
        else
            this->current_rx_use_tdd_table = false;
    }
    else
    {
        tab = &SynthLUT_TDD[range][0];

        if(tx)
            this->current_tx_use_tdd_table = true;
        else
            this->current_rx_use_tdd_table = true;
    }

    uint16_t offs = tx ? (REG_TX_VCO_OUTPUT - REG_RX_VCO_OUTPUT) : 0;

    uint8_t i = 0;

    while(i < SYNTH_LUT_SIZE && tab[i].VCO_MHz > freq)
        i++;

    this->writeReg(REG_RX_VCO_OUTPUT + offs, VCO_OUTPUT_LEVEL(tab[i].VCO_Output_Level) | PORB_VCO_LOGIC);
    this->writeRegField(REG_RX_ALC_VARACTOR + offs, VCO_VARACTOR(~0), tab[i].VCO_Varactor);
    this->writeReg(REG_RX_VCO_BIAS_1 + offs, VCO_BIAS_REF(tab[i].VCO_Bias_Ref) | VCO_BIAS_TCF(tab[i].VCO_Bias_Tcf));

    this->writeReg(REG_RX_FORCE_VCO_TUNE_1 + offs, VCO_CAL_OFFSET(tab[i].VCO_Cal_Offset));
    this->writeReg(REG_RX_VCO_VARACTOR_CTRL_1 + offs, VCO_VARACTOR_REFERENCE(tab[i].VCO_Varactor_Reference));

    this->writeReg(REG_RX_VCO_CAL_REF + offs, VCO_CAL_REF_TCF(0));

    this->writeReg(REG_RX_VCO_VARACTOR_CTRL_0 + offs, VCO_VARACTOR_OFFSET(0) | VCO_VARACTOR_REFERENCE_TCF(7));

    this->writeRegField(REG_RX_CP_CURRENT + offs, CHARGE_PUMP_CURRENT(~0), tab[i].Charge_Pump_Current);
    this->writeReg(REG_RX_LOOP_FILTER_1 + offs, LOOP_FILTER_C2(tab[i].LF_C2) | LOOP_FILTER_C1(tab[i].LF_C1));
    this->writeReg(REG_RX_LOOP_FILTER_2 + offs, LOOP_FILTER_R1(tab[i].LF_R1) | LOOP_FILTER_C3(tab[i].LF_C3));
    this->writeReg(REG_RX_LOOP_FILTER_3 + offs, LOOP_FILTER_R3(tab[i].LF_R3));
}

uint8_t AD9361::readFastLockVal(bool tx, uint8_t profile, uint8_t word)
{
    uint16_t offs = 0;

    if(tx)
        offs = REG_TX_FAST_LOCK_SETUP - REG_RX_FAST_LOCK_SETUP;

    this->writeReg(REG_RX_FAST_LOCK_PROGRAM_ADDR + offs, RX_FAST_LOCK_PROFILE_ADDR(profile) | RX_FAST_LOCK_PROFILE_WORD(word));

    return this->readReg(REG_RX_FAST_LOCK_PROGRAM_READ + offs);
}
void AD9361::writeFastLockVal(bool tx, uint8_t profile, uint8_t word, uint8_t val, bool last)
{
    uint16_t offs = 0;

    if(tx)
        offs = REG_TX_FAST_LOCK_SETUP - REG_RX_FAST_LOCK_SETUP;

    this->writeReg(REG_RX_FAST_LOCK_PROGRAM_ADDR + offs, RX_FAST_LOCK_PROFILE_ADDR(profile) | RX_FAST_LOCK_PROFILE_WORD(word));
    this->writeReg(REG_RX_FAST_LOCK_PROGRAM_DATA + offs, val);
    this->writeReg(REG_RX_FAST_LOCK_PROGRAM_CTRL + offs, RX_FAST_LOCK_PROGRAM_WRITE | RX_FAST_LOCK_PROGRAM_CLOCK_ENABLE);

    if(last) // Stop Clocks
        this->writeReg(REG_RX_FAST_LOCK_PROGRAM_CTRL + offs, 0);
}
void AD9361::loadFastLockData(bool tx, uint8_t profile, uint8_t *values)
{
    uint16_t offs = 0;

    if(tx)
        offs = REG_TX_FAST_LOCK_SETUP - REG_RX_FAST_LOCK_SETUP;

    uint8_t buf[4];

    buf[0] = values[0];
    buf[1] = RX_FAST_LOCK_PROFILE_ADDR(profile) | RX_FAST_LOCK_PROFILE_WORD(0);

    this->writeReg(REG_RX_FAST_LOCK_PROGRAM_DATA + offs, buf, 2);

    for(uint8_t i = 1; i < RX_FAST_LOCK_CONFIG_WORD_NUM; i++)
    {
        buf[0] = RX_FAST_LOCK_PROGRAM_WRITE | RX_FAST_LOCK_PROGRAM_CLOCK_ENABLE;
        buf[1] = 0;
        buf[2] = values[i];
        buf[3] = RX_FAST_LOCK_PROFILE_ADDR(profile) | RX_FAST_LOCK_PROFILE_WORD(i);

        this->writeReg(REG_RX_FAST_LOCK_PROGRAM_CTRL + offs, buf, 4);
    }

    this->writeReg(REG_RX_FAST_LOCK_PROGRAM_CTRL + offs, RX_FAST_LOCK_PROGRAM_WRITE | RX_FAST_LOCK_PROGRAM_CLOCK_ENABLE);
    this->writeReg(REG_RX_FAST_LOCK_PROGRAM_CTRL + offs, 0);

    this->fastlock.entry[tx][profile].flags = 1;
    this->fastlock.entry[tx][profile].alc_orig = values[15];
    this->fastlock.entry[tx][profile].alc_written = values[15];
}
void AD9361::storeFastLockData(bool tx, uint8_t profile, uint8_t *values)
{
    for(uint8_t i = 0; i < RX_FAST_LOCK_CONFIG_WORD_NUM; i++)
        values[i] = this->readFastLockVal(tx, profile, i);
}
void AD9361::storeCurrentFastLockData(bool tx, uint8_t profile)
{
    uint16_t offs = 0;

    if(tx)
        offs = REG_TX_FAST_LOCK_SETUP - REG_RX_FAST_LOCK_SETUP;

    uint8_t val[16];

    val[0] = this->readReg(REG_RX_INTEGER_BYTE_0 + offs);
    val[1] = this->readReg(REG_RX_INTEGER_BYTE_1 + offs);
    val[2] = this->readReg(REG_RX_FRACT_BYTE_0 + offs);
    val[3] = this->readReg(REG_RX_FRACT_BYTE_1 + offs);
    val[4] = this->readReg(REG_RX_FRACT_BYTE_2 + offs);

    uint8_t x = this->readRegField(REG_RX_VCO_BIAS_1 + offs, VCO_BIAS_REF(~0));
    uint8_t y = this->readRegField(REG_RX_ALC_VARACTOR + offs, VCO_VARACTOR(~0));
    val[5] = (x << 4) | y;

    x = this->readRegField(REG_RX_VCO_BIAS_1 + offs, VCO_BIAS_TCF(~0));
    y = this->readRegField(REG_RX_CP_CURRENT + offs, CHARGE_PUMP_CURRENT(~0));
    /* Wide BW option: N = 1
    * Set init and steady state values to the same - let user space handle it
    */
    val[6] = (x << 6) | y;
    val[7] = y;

    x = this->readRegField(REG_RX_LOOP_FILTER_3 + offs, LOOP_FILTER_R3(~0));
    val[8] = (x << 4) | x;

    x = this->readRegField(REG_RX_LOOP_FILTER_2 + offs, LOOP_FILTER_C3(~0));
    val[9] = (x << 4) | x;

    x = this->readRegField(REG_RX_LOOP_FILTER_1 + offs, LOOP_FILTER_C1(~0));
    y = this->readRegField(REG_RX_LOOP_FILTER_1 + offs, LOOP_FILTER_C2(~0));
    val[10] = (x << 4) | y;

    x = this->readRegField(REG_RX_LOOP_FILTER_2 + offs, LOOP_FILTER_R1(~0));
    val[11] = (x << 4) | x;

    x = this->readRegField(REG_RX_VCO_VARACTOR_CTRL_0 + offs, VCO_VARACTOR_REFERENCE_TCF(~0));
    y = this->readRegField(REG_RFPLL_DIVIDERS, tx ? TX_VCO_DIVIDER(~0) : RX_VCO_DIVIDER(~0));
    val[12] = (x << 4) | y;

    x = this->readRegField(REG_RX_FORCE_VCO_TUNE_1 + offs, VCO_CAL_OFFSET(~0));
    y = this->readRegField(REG_RX_VCO_VARACTOR_CTRL_1 + offs, VCO_VARACTOR_REFERENCE(~0));
    val[13] = (x << 4) | y;

    val[14] = this->readReg(REG_RX_FORCE_VCO_TUNE_0 + offs);

    x = this->readRegField(REG_RX_FORCE_ALC + offs, FORCE_ALC_WORD(~0));
    y = this->readRegField(REG_RX_FORCE_VCO_TUNE_1 + offs, FORCE_VCO_TUNE);
    val[15] = (x << 1) | y;

    this->loadFastLockData(tx, profile, val);
}
void AD9361::prepareFastLockProfile(bool tx, uint8_t profile, bool prepare)
{
    uint16_t offs = 0;
    uint8_t ready_mask = RX_SYNTH_READY_MASK;

    if(tx)
    {
        offs = REG_TX_FAST_LOCK_SETUP - REG_RX_FAST_LOCK_SETUP;
        ready_mask = TX_SYNTH_READY_MASK;
    }

    bool is_prepared = !!this->fastlock.current_profile[tx];

    if(prepare && !is_prepared)
    {
        this->writeReg(REG_RX_FAST_LOCK_SETUP_INIT_DELAY + offs, (tx ? this->pdata->tx_fastlock_delay_ns : this->pdata->rx_fastlock_delay_ns) / 250);
        this->writeReg(REG_RX_FAST_LOCK_SETUP + offs, RX_FAST_LOCK_PROFILE(profile) | RX_FAST_LOCK_MODE_ENABLE);
        this->writeReg(REG_RX_FAST_LOCK_PROGRAM_CTRL + offs, 0);

        this->writeRegField(REG_ENSM_CONFIG_2, ready_mask, 1);
        this->controlVCOCalibration(tx, false);
    }
    else if(!prepare && is_prepared)
    {
        this->writeReg(REG_RX_FAST_LOCK_SETUP + offs, 0);

        // Workaround: Exiting Fastlock Mode
        this->writeRegField(REG_RX_FORCE_ALC + offs, FORCE_ALC_ENABLE, 1);
        this->writeRegField(REG_RX_FORCE_VCO_TUNE_1 + offs, FORCE_VCO_TUNE, 1);
        this->writeRegField(REG_RX_FORCE_ALC + offs, FORCE_ALC_ENABLE, 0);
        this->writeRegField(REG_RX_FORCE_VCO_TUNE_1 + offs, FORCE_VCO_TUNE, 0);

        this->controlVCOCalibration(tx, true);
        this->writeRegField(REG_ENSM_CONFIG_2, ready_mask, 0);

        this->fastlock.current_profile[tx] = 0;
    }
}
void AD9361::recallFastLockProfile(bool tx, uint8_t profile)
{
    uint16_t offs = 0;

    if(tx)
        offs = REG_TX_FAST_LOCK_SETUP - REG_RX_FAST_LOCK_SETUP;

    if(this->fastlock.entry[tx][profile].flags != 1)
        throw std::invalid_argument("AD9361: Fastlock profile " + std::to_string(profile) + " is not loaded");

    // Workaround: Lock problem with same ALC word
    uint8_t current_profile = this->fastlock.current_profile[tx];
    uint8_t _new = this->fastlock.entry[tx][profile].alc_written;
    uint8_t curr;

    if(current_profile == 0)
        curr = this->readRegField(REG_RX_FORCE_ALC + offs, FORCE_ALC_WORD(~0)) << 1;
    else
        curr = this->fastlock.entry[tx][current_profile - 1].alc_written;

    uint8_t orig;

    if((curr >> 1) == (_new >> 1))
    {
        orig = this->fastlock.entry[tx][profile].alc_orig;

        if((orig >> 1) == (_new >> 1))
            this->fastlock.entry[tx][profile].alc_written += 2;
        else
            this->fastlock.entry[tx][profile].alc_written = orig;

        this->writeFastLockVal(tx, profile, 0xF, this->fastlock.entry[tx][profile].alc_written, true);
    }

    this->prepareFastLockProfile(tx, profile, true);

    this->fastlock.current_profile[tx] = profile + 1;

    this->writeReg(REG_RX_FAST_LOCK_SETUP + offs, RX_FAST_LOCK_PROFILE(profile) | (this->pdata->trx_fastlock_pinctrl_en[tx] ? RX_FAST_LOCK_PROFILE_PIN_SELECT : 0) | RX_FAST_LOCK_MODE_ENABLE);
}

void AD9361::doMCSStage(uint8_t stage)
{
    uint8_t mask = MCS_RF_ENABLE | MCS_BBPLL_ENABLE | MCS_DIGITAL_CLK_ENABLE | MCS_BB_ENABLE;

    switch(stage)
    {
        case 1:
            this->writeRegField(REG_ENSM_CONFIG_2, POWER_DOWN_TX_SYNTH | POWER_DOWN_RX_SYNTH, 0);

            this->writeRegField(REG_MULTICHIP_SYNC_AND_TX_MON_CTRL, mask, MCS_BB_ENABLE | MCS_BBPLL_ENABLE | MCS_RF_ENABLE);
            this->writeRegField(REG_CP_BLEED_CURRENT, MCS_REFCLK_SCALE_EN, 1);
        break;
        case 2:
            /*
             * FIXME: This is not a regular GPIO -
             * HDL ensures Multi-chip Synchronization SYNC_IN Pulse Timing
             * relative to rising and falling edge of REF_CLK
             */

            this->sync_gpio.controller->setValue(this->sync_gpio.gpio, this->sync_gpio.invert ? AXIGPIO::Value::LOW : AXIGPIO::Value::HIGH);
            this->sync_gpio.controller->setValue(this->sync_gpio.gpio, this->sync_gpio.invert ? AXIGPIO::Value::HIGH : AXIGPIO::Value::LOW);
        break;
        case 3:
            this->writeRegField(REG_MULTICHIP_SYNC_AND_TX_MON_CTRL, mask, MCS_BB_ENABLE | MCS_DIGITAL_CLK_ENABLE | MCS_RF_ENABLE);
        break;
        case 4:
            this->sync_gpio.controller->setValue(this->sync_gpio.gpio, this->sync_gpio.invert ? AXIGPIO::Value::LOW : AXIGPIO::Value::HIGH);
            this->sync_gpio.controller->setValue(this->sync_gpio.gpio, this->sync_gpio.invert ? AXIGPIO::Value::HIGH : AXIGPIO::Value::LOW);
        break;
        case 5:
            this->writeRegField(REG_MULTICHIP_SYNC_AND_TX_MON_CTRL, mask, MCS_RF_ENABLE);
        break;
    }
}

/*
static int32_t ad9361_int_loopback_fix_ch_cross(bool enable)
{
    // Loopback works only TX1->RX1 or RX2->RX2
    if(!this->pdata->rx2tx2 && this->pdata->rx1tx1_mode_use_rx_num != this->pdata->rx1tx1_mode_use_tx_num)
        return this->enableTX(TX_1 | TX_2, enable ? this->pdata->rx1tx1_mode_use_rx_num : this->pdata->rx1tx1_mode_use_tx_num);

    return 0;
}
int32_t ad9361_bist_loopback(int32_t mode)
{
    uint32_t sp_hd, reg;

    DBGPRINTLN_CTX("BIST loopback mode %"PRId32, mode);

    reg = this->readReg(REG_OBSERVE_CONFIG);

    this->bist_loopback_mode = mode;

    switch(mode)
    {
        case 0:
            axi_ad9361_set_hdl_loopback(0);
            ad9361_int_loopback_fix_ch_cross(false);

            reg &= ~(DATA_PORT_SP_HD_LOOP_TEST_OE | DATA_PORT_LOOP_TEST_ENABLE);

            return this->writeReg(REG_OBSERVE_CONFIG, reg);
        case 1:
            // loopback (AD9361 internal) TX->RX
            axi_ad9361_set_hdl_loopback(0);
            ad9361_int_loopback_fix_ch_cross(true);

            sp_hd = this->readReg(REG_PARALLEL_PORT_CONF_3);

            if((sp_hd & SINGLE_PORT_MODE) && (sp_hd & HALF_DUPLEX_MODE))
                reg |= DATA_PORT_SP_HD_LOOP_TEST_OE;
            else
                reg &= ~DATA_PORT_SP_HD_LOOP_TEST_OE;

            reg |= DATA_PORT_LOOP_TEST_ENABLE;

            return this->writeReg(REG_OBSERVE_CONFIG, reg);
        case 2:
            // loopback (FPGA internal) RX->TX
            axi_ad9361_set_hdl_loopback(1);
            ad9361_int_loopback_fix_ch_cross(false);

            reg &= ~(DATA_PORT_SP_HD_LOOP_TEST_OE | DATA_PORT_LOOP_TEST_ENABLE);

            return this->writeReg(REG_OBSERVE_CONFIG, reg);
        default:
            return -EINVAL;
    }
}
void ad9361_get_bist_loopback(int32_t* mode)
{
    *mode = this->bist_loopback_mode;
}
int32_t ad9361_bist_prbs(enum ad9361_bist_mode mode)
{
    uint32_t reg = 0;

    DBGPRINTLN_CTX("BIST PRBS mode %"PRId32, mode);

    this->bist_prbs_mode = mode;

    switch(mode)
    {
        case BIST_DISABLE:
            reg = 0;
        break;
        case BIST_INJ_TX:
            reg = BIST_CTRL_POINT(0) | BIST_ENABLE;
        break;
        case BIST_INJ_RX:
            reg = BIST_CTRL_POINT(2) | BIST_ENABLE;
        break;
    };

    this->bist_config = reg;

    return this->writeReg(REG_BIST_CONFIG, reg);
}
void ad9361_get_bist_prbs(enum ad9361_bist_mode* mode)
{
    *mode = this->bist_prbs_mode;
}
int32_t ad9361_bist_tone(enum ad9361_bist_mode mode, uint32_t freq_Hz, uint32_t level_dB, uint32_t mask)
{
    uint32_t clk = 0;
    uint32_t reg = 0, reg1, reg_mask;

    DBGPRINTLN_CTX("BIST tone mode %"PRId32, mode);

    this->bist_tone_mode = mode;
    this->bist_tone_freq_Hz = freq_Hz;
    this->bist_tone_level_dB = level_dB;
    this->bist_tone_mask = mask;

    switch(mode)
    {
        case BIST_DISABLE:
            reg = 0;
        break;
        case BIST_INJ_TX:
            clk = this->getClockRate(this->ref_clk_scale[TX_SAMPL_CLK]);
            reg = BIST_CTRL_POINT(0) | BIST_ENABLE;
        break;
        case BIST_INJ_RX:
            clk = this->getClockRate(this->ref_clk_scale[RX_SAMPL_CLK]);
            reg = BIST_CTRL_POINT(2) | BIST_ENABLE;
        break;
    };

    reg |= TONE_PRBS;
    reg |= TONE_LEVEL(level_dB / 6);

    if(freq_Hz < 4)
        reg |= TONE_FREQ(freq_Hz);
    else if(clk)
        reg |= TONE_FREQ(DIV_ROUND(freq_Hz * 32, clk) - 1);

    reg_mask = BIST_MASK_CHANNEL_1_I_DATA | BIST_MASK_CHANNEL_1_Q_DATA | BIST_MASK_CHANNEL_2_I_DATA | BIST_MASK_CHANNEL_2_Q_DATA;

    reg1 = ((mask << 2) & reg_mask);
    this->writeReg(REG_BIST_AND_DATA_PORT_TEST_CONFIG, reg1);

    this->bist_config = reg;

    return this->writeReg(REG_BIST_CONFIG, reg);
}
void ad9361_get_bist_tone(enum ad9361_bist_mode* mode, uint32_t* freq_Hz, uint32_t* level_dB, uint32_t* mask)
{
    *mode = this->bist_tone_mode;
    *freq_Hz = this->bist_tone_freq_Hz;
    *level_dB = this->bist_tone_level_dB;
    *mask = this->bist_tone_mask;
}

int32_t ad9361_set_gain_ctrl_mode(struct ad9361_rf_gain_ctrl* gain_ctrl)
{
    int32_t rc = 0;
    uint32_t gain_ctl_shift, mode;
    uint8_t val;

    rc = this->readReg(REG_AGC_CONFIG_1, &val, 1);

    if(rc < 0)
    {
        DBGPRINTLN_CTX("Unable to read AGC_CONFIG_1 register (%"PRIX32")", REG_AGC_CONFIG_1);

        return rc;
    }

    switch(gain_ctrl->mode)
    {
        case RF_GAIN_MGC:
            mode = RX_GAIN_CTL_MGC;
        break;
        case RF_GAIN_FASTATTACK_AGC:
            mode = RX_GAIN_CTL_AGC_FAST_ATK;
        break;
        case RF_GAIN_SLOWATTACK_AGC:
            mode = RX_GAIN_CTL_AGC_SLOW_ATK;
        break;
        case RF_GAIN_HYBRID_AGC:
            mode = RX_GAIN_CTL_AGC_SLOW_ATK_HYBD;
        break;
        default:
            return -EINVAL;
        break;
    }

    if(gain_ctrl->ant == 1)
    {
        gain_ctl_shift = RX1_GAIN_CTRL_SHIFT;
    }
    else if(gain_ctrl->ant == 2)
    {
        gain_ctl_shift = RX2_GAIN_CTRL_SHIFT;
    }
    else
    {
        DBGPRINTLN_CTX("Unknown Rx path %"PRIu32, gain_ctrl->ant);

        return -EINVAL;
    }

    rc = this->enableRX(gain_ctrl->ant, RX_DISABLE);

    if(rc < 0)
    {
        DBGPRINTLN_CTX("Unable to disable Rx%"PRIu32, gain_ctrl->ant);

        return rc;
    }

    val &= ~(RX_GAIN_CTL_MASK << gain_ctl_shift);
    val |= mode << gain_ctl_shift;

    if(mode == RX_GAIN_CTL_AGC_SLOW_ATK_HYBD)
        val |= SLOW_ATTACK_HYBRID_MODE;
    else
        val &= ~SLOW_ATTACK_HYBRID_MODE;

    rc = this->writeReg(REG_AGC_CONFIG_1, val);

    if(rc < 0)
    {
        DBGPRINTLN_CTX("Unable to write AGC_CONFIG_1 register (%"PRIX32")", REG_AGC_CONFIG_1);

        return rc;
    }

    this->enableRX(gain_ctrl->ant, RX_ENABLE);

    rc = this->updateGainControl();

    return rc;
}

int32_t ad9361_read_rssi(struct ad9361_rf_rssi* rssi)
{
    uint8_t reg_val_buf[6];
    int32_t rc;

    rc = this->readReg(REG_PREAMBLE_LSB, reg_val_buf, ARRAY_SIZE(reg_val_buf));

    if(rssi->ant == 1)
    {
        rssi->symbol = RSSI_RESOLUTION * ((reg_val_buf[5] << RSSI_LSB_SHIFT) + (reg_val_buf[1] & RSSI_LSB_MASK1));
        rssi->preamble = RSSI_RESOLUTION * ((reg_val_buf[4] << RSSI_LSB_SHIFT) + (reg_val_buf[0] & RSSI_LSB_MASK1));
    }
    else if(rssi->ant == 2)
    {
        rssi->symbol = RSSI_RESOLUTION * ((reg_val_buf[3] << RSSI_LSB_SHIFT) + ((reg_val_buf[1] & RSSI_LSB_MASK2) >> 1));
        rssi->preamble = RSSI_RESOLUTION * ((reg_val_buf[2] << RSSI_LSB_SHIFT) + ((reg_val_buf[0] & RSSI_LSB_MASK2) >> 1));
    }
    else
    {
        rc = -EFAULT;
    }

    rssi->multiplier = RSSI_MULTIPLIER;

    return rc;
}

void ad9361_clear_state()
{
    this->current_table = NO_GAIN_TABLE;
    this->bypass_tx_fir = true;
    this->bypass_rx_fir = true;
    this->rate_governor = 1;
    this->rfdc_track_en = true;
    this->bbdc_track_en = true;
    this->quad_track_en = true;
    this->prev_ensm_state = 0;
    this->curr_ensm_state = 0;
    this->auto_cal_en = false;
    this->manual_tx_quad_cal_en = false;
    this->last_tx_quad_cal_freq = 0;
    this->flags = 0;
    this->current_rx_bw_Hz = 0;
    this->current_tx_bw_Hz = 0;
    this->rxbbf_div = 0;
    this->tx_fir_int = 0;
    this->tx_fir_ntaps = 0;
    this->rx_fir_dec = 0;
    this->rx_fir_ntaps = 0;
    this->ensm_pin_ctl_en = false;
    this->txmon_tdd_en = 0;
    this->current_tx_lo_freq = 0;
    this->current_rx_lo_freq = 0;
    this->current_tx_use_tdd_table = false;
    this->current_rx_use_tdd_table = false;
    this->cached_synth_pd[0] = 0;
    this->cached_synth_pd[1] = 0;

    memset(&this->fastlock, 0, sizeof(this->fastlock));
}

static int32_t ad9361_verify_fir_filter_coef(enum ad9361_fir_dest dest, uint32_t ntaps, short* coef)
{
    uint32_t val, offs = 0, gain = 0, conf, sel, cnt;
    int32_t ret = 0;

    //return 0;

    DBGPRINTLN_CTX("ntaps %"PRIu32", dest %d", ntaps, dest);

    if(dest & FIR_IS_RX)
    {
        gain = this->readReg(REG_RX_FILTER_GAIN);

        offs = REG_RX_FILTER_COEF_ADDR - REG_TX_FILTER_COEF_ADDR;

        this->writeReg(REG_RX_FILTER_GAIN, 0);
    }

    conf = this->readReg(REG_TX_FILTER_CONF + offs);

    if((dest & 3) == 3)
    {
        sel = 1;
        cnt = 2;
    }
    else
    {
        sel = (dest & 3);
        cnt = 1;
    }

    for(; cnt > 0; cnt--, sel++)
    {
        this->writeReg(REG_TX_FILTER_CONF + offs, FIR_NUM_TAPS(ntaps / 16 - 1) | FIR_SELECT(sel) | FIR_START_CLK);

        for(val = 0; val < ntaps; val++)
        {
            int16_t tmp;

            this->writeReg(REG_TX_FILTER_COEF_ADDR + offs, val);

            tmp = (this->readReg(REG_TX_FILTER_COEF_READ_DATA_1 + offs) & 0xFF) | (this->readReg(REG_TX_FILTER_COEF_READ_DATA_2 + offs) << 8);

            if(tmp != coef[val])
            {
                DBGPRINTLN_CTX("%s%"PRIu32" readback mismatch at tap %"PRIu32" (%d != %d)", (dest & FIR_IS_RX) ? "RX" : "TX", sel, val, tmp, coef[val]);

                ret = -EIO;
            }
        }
    }

    if(dest & FIR_IS_RX)
        this->writeReg(REG_RX_FILTER_GAIN, gain);

    this->writeReg(REG_TX_FILTER_CONF + offs, conf);

    return ret;
}
int32_t ad9361_load_fir_filter_coef(enum ad9361_fir_dest dest, int32_t gain_dB, uint32_t ntaps, int16_t* coef)
{
    uint32_t val, offs = 0, fir_conf = 0, fir_enable = 0;
    int32_t ret;

    DBGPRINTLN_CTX("ntaps %"PRIu32", gain %"PRId32" dB, dest %d", ntaps, gain_dB, dest);

    if(coef == NULL || !ntaps || ntaps > 128 || ntaps % 16)
    {
        DBGPRINTLN_CTX("Invalid parameters");

        return -EINVAL;
    }

    this->forceENSMState(ENSM_STATE_ALERT);

    if(dest & FIR_IS_RX)
    {
        val = 3 - (gain_dB + 12) / 6;

        this->writeReg(REG_RX_FILTER_GAIN, val & 0x3);

        offs = REG_RX_FILTER_COEF_ADDR - REG_TX_FILTER_COEF_ADDR;
        this->rx_fir_ntaps = ntaps;
        fir_enable = this->readRegField(REG_RX_ENABLE_FILTER_CTRL, RX_FIR_ENABLE_DECIMATION(~0));

        this->writeRegField(REG_RX_ENABLE_FILTER_CTRL, RX_FIR_ENABLE_DECIMATION(~0), (this->rx_fir_dec == 4) ? 3 : this->rx_fir_dec);
    }
    else
    {
        if(gain_dB == -6)
            fir_conf = TX_FIR_GAIN_6DB;

        this->tx_fir_ntaps = ntaps;

        fir_enable = this->readRegField(REG_TX_ENABLE_FILTER_CTRL, TX_FIR_ENABLE_INTERPOLATION(~0));
        this->writeRegField(REG_TX_ENABLE_FILTER_CTRL, TX_FIR_ENABLE_INTERPOLATION(~0), (this->tx_fir_int == 4) ? 3 : this->tx_fir_int);
    }

    val = ntaps / 16 - 1;

    fir_conf |= FIR_NUM_TAPS(val) | FIR_SELECT(dest) | FIR_START_CLK;

    this->writeReg(REG_TX_FILTER_CONF + offs, fir_conf);

    for(val = 0; val < ntaps; val++)
    {
        this->writeReg(REG_TX_FILTER_COEF_ADDR + offs, val);
        this->writeReg(REG_TX_FILTER_COEF_WRITE_DATA_1 + offs, coef[val] & 0xFF);
        this->writeReg(REG_TX_FILTER_COEF_WRITE_DATA_2 + offs, coef[val] >> 8);
        this->writeReg(REG_TX_FILTER_CONF + offs, fir_conf | FIR_WRITE);
        this->writeReg(REG_TX_FILTER_COEF_READ_DATA_2 + offs, 0);
        this->writeReg(REG_TX_FILTER_COEF_READ_DATA_2 + offs, 0);
    }

    this->writeReg(REG_TX_FILTER_CONF + offs, fir_conf);

    fir_conf &= ~FIR_START_CLK;

    this->writeReg(REG_TX_FILTER_CONF + offs, fir_conf);

    ret = ad9361_verify_fir_filter_coef(dest, ntaps, coef);

    if(dest & FIR_IS_RX)
        this->writeRegField(REG_RX_ENABLE_FILTER_CTRL, RX_FIR_ENABLE_DECIMATION(~0), fir_enable);
    else
        this->writeRegField(REG_TX_ENABLE_FILTER_CTRL, TX_FIR_ENABLE_INTERPOLATION(~0), fir_enable);

    this->restorePrevENSMState();

    return ret;
}
int32_t ad9361_parse_fir(char* data, uint32_t size)
{
    char* line;
    int32_t i = 0, ret, txc, rxc;
    int32_t tx = -1, tx_gain = 0, tx_int = 0;
    int32_t rx = -1, rx_gain = 0, rx_dec = 0;
    int32_t rtx = -1, rrx = -1;
    int16_t coef_tx[128];
    int16_t coef_rx[128];
    char* ptr = data;

    this->filt_rx_bw_Hz = 0;
    this->filt_tx_bw_Hz = 0;
    this->filt_valid = false;

    while((line = strsep(&ptr, "\n")))
    {
        if(line >= data + size)
        {
            break;
        }

        if(line[0] == '#')
            continue;

        if(tx < 0)
        {
            ret = sscanf(line, "TX %"PRId32" GAIN %"PRId32" INT %"PRId32, &tx, &tx_gain, &tx_int);

            if(ret == 3)
                continue;
            else
                tx = -1;
        }
        if(rx < 0)
        {
            ret = sscanf(line, "RX %"PRId32" GAIN %"PRId32" DEC %"PRId32, &rx, &rx_gain, &rx_dec);

            if(ret == 3)
                continue;
            else
                tx = -1;
        }

        if(rtx < 0)
        {
            ret = sscanf(line, "RTX %"PRIu32" %"PRIu32" %"PRIu32" %"PRIu32" %"PRIu32" %"PRIu32, &this->filt_tx_path_clks[0], &this->filt_tx_path_clks[1], &this->filt_tx_path_clks[2], &this->filt_tx_path_clks[3], &this->filt_tx_path_clks[4], &this->filt_tx_path_clks[5]);

            if(ret == 6)
            {
                rtx = 0;

                continue;
            }
            else
            {
                rtx = -1;
            }
        }

        if(rrx < 0)
        {
            ret = sscanf(line, "RRX %"PRIu32" %"PRIu32" %"PRIu32" %"PRIu32" %"PRIu32" %"PRIu32, &this->filt_rx_path_clks[0], &this->filt_rx_path_clks[1], &this->filt_rx_path_clks[2], &this->filt_rx_path_clks[3], &this->filt_rx_path_clks[4], &this->filt_rx_path_clks[5]);

            if(ret == 6)
            {
                rrx = 0;
                continue;
            }
            else
            {
                rrx = -1;
            }
        }

        if(!this->filt_rx_bw_Hz)
        {
            ret = sscanf(line, "BWRX %"PRId32, &this->filt_rx_bw_Hz);

            if(ret == 1)
                continue;
            else
                this->filt_rx_bw_Hz = 0;
        }

        if(!this->filt_tx_bw_Hz)
        {
            ret = sscanf(line, "BWTX %"PRId32, &this->filt_tx_bw_Hz);

            if(ret == 1)
                continue;
            else
                this->filt_tx_bw_Hz = 0;
        }

        ret = sscanf(line, "%"PRId32",%"PRId32, &txc, &rxc);

        if(ret == 1)
        {
            coef_tx[i] = coef_rx[i] = (int16_t)txc;

            i++;

            continue;
        }
        else if(ret == 2)
        {
            coef_tx[i] = (int16_t)txc;
            coef_rx[i] = (int16_t)rxc;

            i++;

            continue;
        }
    }

    switch(tx)
    {
        case FIR_TX1:
        case FIR_TX2:
        case FIR_TX1_TX2:
            this->tx_fir_int = tx_int;
            ret = ad9361_load_fir_filter_coef((enum ad9361_fir_dest)tx, tx_gain, i, coef_tx);
        break;
        default:
            ret = -EINVAL;
    }

    switch(rx | FIR_IS_RX)
    {
        case FIR_RX1:
        case FIR_RX2:
        case FIR_RX1_RX2:
            this->rx_fir_dec = rx_dec;
            ret = ad9361_load_fir_filter_coef((enum ad9361_fir_dest)(rx | FIR_IS_RX), rx_gain, i, coef_rx);
        break;
        default:
            ret = -EINVAL;
    }

    if(ret < 0)
        return ret;

    if(!(rrx | rtx))
        this->filt_valid = true;

    return size;
}
int32_t ad9361_validate_enable_fir()
{
    int32_t ret;
    uint32_t rx[6], tx[6];
    uint32_t max, min, valid;

    DBGPRINTLN_CTX("TX FIR - enable: %d, ntaps: %d, int: %d", !this->bypass_tx_fir, this->tx_fir_ntaps, this->tx_fir_int);
    DBGPRINTLN_CTX("RX FIR - enable: %d, ntaps: %d, dec: %d", !this->bypass_rx_fir, this->rx_fir_ntaps, this->rx_fir_dec);

    if(!this->bypass_tx_fir)
    {
        if(!(this->tx_fir_int == 1 || this->tx_fir_int == 2 || this->tx_fir_int == 4))
        {
            DBGPRINTLN_CTX("Invalid interpolation %d in filter config", this->tx_fir_int);

            return -EINVAL;
        }


        if(this->tx_fir_int == 1 && this->tx_fir_ntaps > 64)
        {
            DBGPRINTLN_CTX("Invalid: ntaps > 64 and interpolation = 1");

            return -EINVAL;
        }
    }

    if(!this->bypass_rx_fir)
    {
        if(!(this->rx_fir_dec == 1 || this->rx_fir_dec == 2 || this->rx_fir_dec == 4))
        {
            DBGPRINTLN_CTX("Invalid decimation %d in filter config", this->rx_fir_dec);

            return -EINVAL;
        }
    }

    if(!this->filt_valid || this->bypass_rx_fir || this->bypass_tx_fir)
    {
        ret = this->calcClockChain(this->getClockRate(this->ref_clk_scale[TX_SAMPL_CLK]), this->rate_governor, rx, tx);

        if(ret < 0)
        {
            min = this->rate_governor ? 1500000U : 1000000U;

            DBGPRINTLN_CTX("Calculating filter rates failed (%"PRId32"), using min frequency", ret);

            ret = this->calcClockChain(min, this->rate_governor, rx, tx);

            if(ret < 0)
                return ret;
        }

        valid = false;
    }
    else
    {
        memcpy(rx, this->filt_rx_path_clks, sizeof(rx));
        memcpy(tx, this->filt_tx_path_clks, sizeof(tx));

        valid = true;
    }

    DBGPRINTLN_CTX("RX Rates - BBPLL: %"PRIu32" Hz, ADC: %"PRIu32" Hz, R2CLK: %"PRIu32" Hz, R1CLK: %"PRIu32" Hz, CLKRF: %"PRIu32" Hz, RSAMPL: %"PRIu32" Hz", rx[BBPLL_FREQ], rx[ADC_FREQ], rx[R2_FREQ], rx[R1_FREQ], rx[CLKRF_FREQ], rx[RX_SAMPL_FREQ]);
    DBGPRINTLN_CTX("TX Rates - BBPLL: %"PRIu32" Hz, DAC: %"PRIu32" Hz, T2CLK: %"PRIu32" Hz, T1CLK: %"PRIu32" Hz, CLKTF: %"PRIu32" Hz, TSAMPL: %"PRIu32" Hz", tx[BBPLL_FREQ], tx[DAC_FREQ], tx[T2_FREQ], tx[T1_FREQ], tx[CLKTF_FREQ], tx[TX_SAMPL_FREQ]);

    if(!this->bypass_tx_fir)
    {
        max = (tx[DAC_FREQ] / tx[TX_SAMPL_FREQ]) * 16;

        if(this->tx_fir_ntaps > max)
        {
            DBGPRINTLN_CTX("Invalid: ratio DAC / TX_SAMPL * 16 > ntaps (max %"PRIu32", adc %"PRIu32", tx %"PRIu32")", max, tx[DAC_FREQ], tx[TX_SAMPL_FREQ]);

            return -EINVAL;
        }
    }

    if(!this->bypass_rx_fir)
    {
        max = ((rx[ADC_FREQ] / ((rx[ADC_FREQ] == rx[R2_FREQ]) ? 1 : 2)) / rx[RX_SAMPL_FREQ]) * 16;

        if(this->rx_fir_ntaps > max)
        {
            DBGPRINTLN_CTX("Invalid: ratio ADC/2 / RX_SAMPL * 16 > ntaps (max %"PRIu32")", max);

            return -EINVAL;
        }
    }

    ret = this->setClockChain(rx, tx);

    if(ret < 0)
        return ret;

    // See also: this->setClockChain()
    if(!this->pdata->dig_interface_tune_fir_disable && this->bypass_tx_fir && this->bypass_rx_fir)
        ad9361_util_dig_tune(0, RESTORE_PREVIOUS);

    return ad9361_update_rf_bandwidth(valid ? this->filt_rx_bw_Hz : this->current_rx_bw_Hz, valid ? this->filt_tx_bw_Hz : this->current_tx_bw_Hz);
}

int32_t ad9361_rssi_gain_step_calib()
{
    uint32_t lna_error[4];
    uint32_t mixer_error[15];
    uint64_t lo_freq_hz;
    uint8_t lo_index;

    lo_freq_hz = ad9361_from_clk(this->getClockRate(this->ref_clk_scale[RX_RFPLL]));

    if(lo_freq_hz < 1300000000ULL)
        lo_index = 0;
    else if(lo_freq_hz < 3300000000ULL)
        lo_index = 1;
    else if(lo_freq_hz < 4100000000ULL)
        lo_index = 2;
    else
        lo_index = 3;

    // Put the AD9361 into the Alert state.
    this->forceENSMState(ENSM_STATE_ALERT);

    // Program the directly-addressable register values.
    this->writeReg(REG_MAX_MIXER_CALIBRATION_GAIN_INDEX, MAX_MIXER_CALIBRATION_GAIN_INDEX(0x0F));
    this->writeReg(REG_MEASURE_DURATION, GAIN_CAL_MEAS_DURATION(0x0E));
    this->writeReg(REG_SETTLE_TIME, SETTLE_TIME(0x3F));
    this->writeReg(REG_RSSI_CONFIG, RSSI_MODE_SELECT(0x3) | DEFAULT_RSSI_MEAS_MODE);
    this->writeReg(REG_MEASURE_DURATION_01, MEASUREMENT_DURATION_0(0x0E));
    this->writeReg(REG_LNA_GAIN, gain_step_calib_reg_val[lo_index][0]);

    // Program the LNA gain step words into the internal table.
    this->writeReg(REG_CONFIG, CALIB_TABLE_SELECT(0x3) | START_CALIB_TABLE_CLOCK);

    for(uint8_t i = 0; i < 4; i++)
    {
        this->writeReg(REG_WORD_ADDRESS, i);
        this->writeReg(REG_GAIN_DIFF_WORDERROR_WRITE, gain_step_calib_reg_val[lo_index][i + 1]);
        this->writeReg(REG_CONFIG, CALIB_TABLE_SELECT(0x3) | WRITE_LNA_GAIN_DIFF | START_CALIB_TABLE_CLOCK);

        usleep(3);    //Wait for data to fully write to internal table
    }

    this->writeReg(REG_CONFIG, START_CALIB_TABLE_CLOCK);
    this->writeReg(REG_CONFIG, 0x00);

    // Run and wait until the calibration completes.
    this->runCalibration(RX_GAIN_STEP_CAL);

    // Read the LNA and Mixer error terms into nonvolatile memory.
    this->writeReg(REG_CONFIG, CALIB_TABLE_SELECT(0x1) | READ_SELECT);

    for(uint8_t i = 0; i < 4; i++)
    {
        this->writeReg(REG_WORD_ADDRESS, i);

        lna_error[i] = this->readReg(REG_GAIN_ERROR_READ);
    }

    this->writeReg(REG_CONFIG, CALIB_TABLE_SELECT(0x1));

    for(uint8_t i = 0; i < 15; i++)
    {
        this->writeReg(REG_WORD_ADDRESS, i);
        mixer_error[i] = this->readReg(REG_GAIN_ERROR_READ);
    }

    this->writeReg(REG_CONFIG, 0x00);

    // Programming gain step errors into the AD9361 in the field
    this->writeReg(REG_CONFIG, CALIB_TABLE_SELECT(0x3) | START_CALIB_TABLE_CLOCK);

    for(uint8_t i = 0; i < 4; i++)
    {
        this->writeReg(REG_WORD_ADDRESS, i);
        this->writeReg(REG_GAIN_DIFF_WORDERROR_WRITE, lna_error[i]);
        this->writeReg(REG_CONFIG, CALIB_TABLE_SELECT(0x3) | WRITE_LNA_ERROR_TABLE | START_CALIB_TABLE_CLOCK);
    }

    this->writeReg(REG_CONFIG, CALIB_TABLE_SELECT(0x3) | START_CALIB_TABLE_CLOCK);

    for(uint8_t i = 0; i < 15; i++)
    {
        this->writeReg(REG_WORD_ADDRESS, i);
        this->writeReg(REG_GAIN_DIFF_WORDERROR_WRITE, mixer_error[i]);
        this->writeReg(REG_CONFIG, CALIB_TABLE_SELECT(0x3) | WRITE_MIXER_ERROR_TABLE | START_CALIB_TABLE_CLOCK);
    }

    this->writeReg(REG_CONFIG, 0x00);

    this->restorePrevENSMState();

    return 0;
}

*/